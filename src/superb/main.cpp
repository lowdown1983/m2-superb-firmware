// SuperB (ESP32-WROOM-32D) firmware — Phase 2: wireless bridge + web GUI.
//
// Bridge (Phase 1, kept):
//   - Bluetooth Classic SPP ("M2-SuperB"): raw byte pipe to the Bee UART.
//   - WiFi AP+STA. Phase 2: AP is WPA2 (password in NVS, changeable via the
//     web GUI); STA credentials come from NVS (web GUI), no placeholders.
//   - TCP server on port 23: raw byte pipe to the Bee UART (SavvyCAN
//     GVRET-TCP target).
//
// Control channel (Phase 2, NEW):
//   The M2's multimode channel is framed as F1 7E LEN PAYLOAD XOR on the Bee
//   UART (see src/m2/mm_channel.h). Two proxy duties here:
//   1. TX FILTER (app -> M2): a connected app must never inject a control
//      frame. Any F1 7E byte pair from BT/TCP clients is dropped (1-byte
//      hold-back, flushed on client disconnect or 50 ms quiet). Legitimate
//      GVRET/AT traffic never contains this pair (SavvyCAN commands are
//      0-14/0xE7; AT is text), so the filter is transparent to real apps.
//   2. RX DIVERTER (M2 -> apps): F1 7E frames from the M2 are extracted and
//      routed to the pending web-GUI request instead of being broadcast to
//      apps. Everything else broadcasts as before.
//   The web GUI sends commands with mmTransact() and matches replies by
//   command byte.
//
// Web GUI (Phase 2, NEW): HTTP on port 80. Hand-written HTML, no framework.
//   /            status (M2 mode, buses, features, network, clients)
//   /mode        mode-switch form (implemented modes only)
//   /mode_set    POST: executes the switch via the control channel (confirm)
//   /settings    bus settings + feature toggles form
//   /settings_set POST: applies via the control channel
//   /wifi        AP password + STA credentials form (NVS)
//   /wifi_set    POST: saves to NVS and restarts
//   /api/status  JSON status for polling
//
// HARDWARE RULE (verified, immutable): the Bee link is Serial (UART0,
// GPIO3=RX, GPIO1=TX) at 115200 bps. Never parameterized.
// DIAGNOSTICS: no USB debug on the socketed SuperB; GPIO26 heartbeat LED
// only (INFERRED from Macchina's flashing docs).

#include <Arduino.h>
#include <BluetoothSerial.h>
#include <WiFi.h>
#include <WebServer.h>
#include <Preferences.h>
// Phase 11: appliance (communications appliance).
#include <WebSocketsServer.h>   // links2004/WebSockets (lib_deps)
#include <Update.h>             // ESP32 Arduino OTA
#include <mbedtls/sha256.h>    // password hashing, OTA stream hash
#include <mbedtls/ecdsa.h>     // OTA signature verification
#include <mbedtls/ecp.h>
#include "ota_pubkey.h"         // generated by scripts/ota_keygen.py
#ifndef SIM_SUPERB
#include <esp_system.h>         // esp_random()
#include <esp_sleep.h>          // light sleep / wake sources
#endif
#include <SPIFFS.h>             // Phase 12: log sink (sim: host-backed shim)

namespace {

// ---- identity / network config
const char* BT_DEVICE_NAME = "M2-SuperB";
const char* AP_SSID = "M2-SuperB";
const char* NVS_NS = "m2sb";
const uint16_t TCP_PORT = 23;   // SavvyCAN GVRET-TCP default (PHASE1_NOTES.md)
const uint16_t WEB_PORT = 80;

constexpr uint8_t SUPERB_LED = 26;   // INFERRED SuperB LED (Macchina docs)
constexpr int MAX_TCP_CLIENTS = 3;   // INFERRED: small, RAM-cheap
constexpr size_t PIPE_CHUNK = 256;

BluetoothSerial SerialBT;
WiFiServer tcpServer(TCP_PORT);
WiFiClient tcpClients[MAX_TCP_CLIENTS];
WebServer webServer(WEB_PORT);
Preferences prefs;
// Phase 11: WebSocket server (raw stream + GVRET framing) on port 81.
WebSocketsServer webSocket(81);

uint8_t pipeBuf[PIPE_CHUNK];

// ============ control channel (mirrors src/m2/mm_channel.h) ============
namespace mmc {
constexpr uint8_t SYNC = 0xF1;
constexpr uint8_t CH = 0x7E;
enum : uint8_t {
    CMD_SET_MODE = 0x01,
    CMD_GET_STATUS = 0x02,
    CMD_SET_CAN_BAUD = 0x03,
    CMD_SET_SWCAN_SPEED = 0x04,
    CMD_SET_FEATURE = 0x05,
    CMD_UDS_TX = 0x06,
    CMD_UDS_CFG = 0x07,
    CMD_OBD2_CFG = 0x08,
    CMD_OBD2_CTL = 0x09,
    CMD_UDS_STATUS = 0x0A,
    CMD_OBD2_STATUS = 0x0B,
    // Phase 4: MITM supervision (see src/m2/mm_channel.h for payloads).
    CMD_MITM_RULE_ADD = 0x0C,
    CMD_MITM_RULE_DEL = 0x0D,
    CMD_MITM_RULE_LIST = 0x0E,
    CMD_MITM_STATS = 0x0F,
    CMD_MITM_CFG = 0x10,
    // Phase 5: PROG (programming) supervision (see src/m2/mm_channel.h).
    CMD_PROG_CFG = 0x11,
    CMD_PROG_TX = 0x12,
    CMD_PROG_DATA = 0x13,
    CMD_PROG_DONE = 0x14,
    CMD_PROG_STATUS = 0x15,
    CMD_PROG_ABORT = 0x16,
    CMD_PROG_ARM = 0x17,
    CMD_PROG_DL = 0x18,
    CMD_PROG_VERIFY = 0x19,
    // Phase 10: gateway supervision (see src/m2/mm_channel.h for payloads).
    CMD_GW_MAP_ADD = 0x29,
    CMD_GW_MAP_DEL = 0x2A,
    CMD_GW_MAP_LIST = 0x2B,
    CMD_GW_STATS = 0x2C,
    CMD_GW_CFG = 0x2D,
    // Phase 11: vehicle voltage for the sleep/wake manager.
    // req: [] -> [status, mV LE16].
    CMD_GET_VOLTAGE = 0x2E,
    // Phase 12: profiles / auto-detect / logging / harness / DBC.
    CMD_LOG_POLL = 0x2F,
    CMD_LOG_CTL = 0x30,
    CMD_PROFILE_SAVE = 0x31,
    CMD_PROFILE_LOAD = 0x32,
    CMD_PROFILE_INFO = 0x33,
    CMD_AUTODET_START = 0x34,
    CMD_AUTODET_STATUS = 0x35,
    CMD_HARNESS_RUN = 0x36,
    CMD_HARNESS_STATUS = 0x37,
    CMD_DBC_INFO = 0x38,
    CMD_DBC_DECODE = 0x39,
};
enum : uint8_t { ST_OK = 0 };
constexpr uint8_t MAXP = 48;

struct Pending {
    bool active = false;
    uint8_t cmd = 0;
    uint8_t resp[64];
    uint8_t respLen = 0;
    bool got = false;
};
Pending pending;

// RX diverter state (M2 -> us).
enum class DState : uint8_t { IDLE, GOT_F1, LEN, PAYLOAD, XOR };
DState ds = DState::IDLE;
uint8_t dLen = 0, dPos = 0, dXor = 0;
uint8_t dBuf[64];

void handleReply()
{
    if (dLen < 2) return;
    // S3: require the exact reply opcode (request | 0x80). The old
    // (dBuf[0] & 0x7F) comparison also accepted a bare request opcode,
    // letting a checksum-valid false candidate complete a transaction.
    if (pending.active && dBuf[0] == (uint8_t)(pending.cmd | 0x80) && !pending.got) {
        pending.respLen = (dLen <= sizeof(pending.resp)) ? dLen : sizeof(pending.resp);
        for (uint8_t i = 0; i < pending.respLen; i++) pending.resp[i] = dBuf[i];
        pending.got = true;
    }
}

// Process one Bee-UART byte. Non-diverted bytes accumulate in outBuf for
// broadcast; returns via outN. Diverted control frames are consumed.
void rxByte(uint8_t c, uint8_t* outBuf, size_t& outN, size_t outCap)
{
    switch (ds) {
        case DState::IDLE:
            if (c == SYNC) ds = DState::GOT_F1;
            else if (outN < outCap) outBuf[outN++] = c;
            break;
        case DState::GOT_F1:
            if (c == CH) { ds = DState::LEN; }
            else if (c == SYNC) {
                // F1 F1 7E edge: emit the held F1, keep holding the new one.
                if (outN < outCap) outBuf[outN++] = SYNC;
            } else {
                // Not a control frame: emit the held F1 + this byte.
                if (outN + 2 <= outCap) { outBuf[outN++] = SYNC; outBuf[outN++] = c; }
                ds = DState::IDLE;
            }
            break;
        case DState::LEN:
            dLen = c; dPos = 0; dXor = 0;
            ds = (dLen == 0 || dLen > sizeof(dBuf)) ? DState::IDLE : DState::PAYLOAD;
            break;
        case DState::PAYLOAD:
            dBuf[dPos++] = c; dXor ^= c;
            if (dPos >= dLen) ds = DState::XOR;
            break;
        case DState::XOR:
            if (c == dXor) handleReply();  // bad XOR: drop silently
            ds = DState::IDLE;
            break;
    }
}

// TX filter state (apps -> M2): 1-byte hold-back so an F1 7E pair can be
// dropped before it hits the wire.
bool txHoldF1 = false;
uint32_t txHoldSince = 0;

void uartWriteFiltered(const uint8_t* data, size_t len)
{
    for (size_t i = 0; i < len; i++) {
        uint8_t c = data[i];
        if (txHoldF1) {
            txHoldF1 = false;
            if (c == CH) continue;  // drop the pair: injection attempt
            Serial.write(SYNC);     // lone F1: emit it now
        }
        if (c == SYNC) { txHoldF1 = true; txHoldSince = millis(); continue; }
        Serial.write(c);
    }
}

void txFilterIdle()
{
    // Flush a held F1 after 50 ms of client quiet (INFERRED; closes the
    // split-packet race without delaying normal traffic).
    if (txHoldF1 && (uint32_t)(millis() - txHoldSince) > 50) {
        txHoldF1 = false;
        Serial.write(SYNC);
    }
}

void txFilterReset()  // client disconnect: don't hold a byte forever
{
    if (txHoldF1) { txHoldF1 = false; Serial.write(SYNC); }
}
} // namespace mmc

// Forward: defined below (used by pwr::fetchVolt). Signature must match
// the definition exactly (including the default arg) — else ambiguity.
bool mmcTransact(uint8_t cmd, const uint8_t* payload, uint8_t plen,
                 uint8_t* resp, uint8_t outCap, uint8_t& rlen,
                 uint16_t timeoutMs = 800);

// ============ Phase 11: SuperB as communications appliance ============
// The M2 keeps all vehicle logic (standing architecture). The SuperB owns
// wireless, UI, updates, and power — the appliance half.
//
// Work items:
//   1. WebSocket transport (raw stream + GVRET framing) alongside TCP:23.
//   2. Multi-client policy: ONE control owner (may transmit); everyone
//      else is a passive monitor (receives, cannot transmit).
//   3. Authentication + roles mapped to the M2 capability gates (Phase 9),
//      secure pairing with physical authorization, unique device identity.
//   4. Signed OTA firmware updates with anti-rollback.
//   5. Sleep/wake manager (voltage via M2 V_SENSE, engine-off detect,
//      inactivity timer, modem sleep, wake on vehicle/UART/button).
// Deferred (decision): BLE GATT — Classic SPP serves all current apps.
//
// Evidence: VERIFIED = compiles. INFERRED = untested on hardware
// (pairing button path, sleep/wake timings, OTA on live partitions).

namespace appl {

// ---- unique device identity (Phase 11.3)
// Derived from the ESP32 eFuse MAC; shown in the web UI, logs, and the
// /api/status JSON. The AP SSID and BT name stay "M2-SuperB" (stable for
// already-paired phones); the identity disambiguates multiple units.
String devIdStr;
void initIdentity()
{
    uint64_t mac = ESP.getEfuseMac();
    char id[16];
    snprintf(id, sizeof(id), "M2SB-%02X%02X%02X",
             (unsigned)((mac >> 16) & 0xFF), (unsigned)((mac >> 8) & 0xFF),
             (unsigned)(mac & 0xFF));
    devIdStr = id;
}

}  // namespace appl

// ---- multi-client ownership policy (Phase 11.2)
//
// One control owner holds transmit authority: only its bytes reach the
// M2's command paths. All other connected clients are passive monitors
// (they receive the broadcast stream; their TX is dropped, counted, and
// logged — never silent). Applies uniformly to TCP:23, BT SPP, and the
// WebSocket raw stream. The web UI's own mm commands are SuperB-
// originated and gated by web auth roles instead (see auth::).
//
// Claim rules: first TX wins when no owner; owner idle longer than the
// timeout releases; owner disconnect releases; the web UI (operator+)
// can release explicitly. There is no silent preemption.
namespace own {

enum class T : uint8_t { NONE = 0, TCP, BT, WS };

struct Owner {
    T t = T::NONE;
    uint8_t idx = 0;
    uint32_t lastTx = 0;
};
Owner owner;
uint32_t droppedTx = 0;  // monitor TX bytes dropped by policy
uint32_t timeoutMs = 5UL * 60UL * 1000UL;

const char* tname(T t)
{
    switch (t) {
        case T::TCP: return "tcp";
        case T::BT: return "bt";
        case T::WS: return "ws";
        default: return "none";
    }
}

String desc()
{
    if (owner.t == T::NONE) return "none";
    String s = tname(owner.t);
    if (owner.t != T::BT) {
        s += String(owner.idx);
    }
    s += " (idle " + String((millis() - owner.lastTx) / 1000) + "s)";
    return s;
}

// Report bytes dropped by the monitor policy (never silent).
void dropped(uint32_t n) { droppedTx += n; }

// Returns true when this client's TX may go to the M2. First TX claims
// an empty ownership; the owner's TX refreshes the idle timer.
// Drop accounting is the caller's job (via dropped()) so every path
// counts bytes, not calls.
bool txAllowed(T t, uint8_t idx)
{
    uint32_t now = millis();
    if (owner.t == T::NONE) {
        owner.t = t;
        owner.idx = idx;
        owner.lastTx = now;
        return true;
    }
    if (owner.t == t && owner.idx == idx) {
        owner.lastTx = now;
        return true;
    }
    return false;
}

void onDisconnect(T t, uint8_t idx)
{
    if (owner.t == t && owner.idx == idx) owner.t = T::NONE;
}

void release() { owner.t = T::NONE; }

void poll()
{
    if (owner.t != T::NONE &&
        (uint32_t)(millis() - owner.lastTx) > timeoutMs) {
        owner.t = T::NONE;  // idle timeout: no silent preemption, just release
    }
}

void loadCfg() { timeoutMs = (uint32_t)prefs.getUInt("own_tmo", 300) * 1000UL; }

}  // namespace own

// ---- authentication + roles (Phase 11.3)
//
// Roles are the remote half of the M2 capability gates (Phase 9 capgate):
//   VIEWER   (1) == READ_ONLY:            web read-only; raw-pipe TX dropped
//   OPERATOR (2) == ALLOW_TRANSMIT:       diagnostics, mode/config, PASS maps
//   ADMIN    (3) == ALLOW_DIAGNOSTIC_WRITE+: PROG destructive, MODIFY maps,
//              OTA, WiFi, auth management, power config
// (The M2 still enforces its own per-mode grants; the SuperB role decides
// what the SuperB will even forward/issue. Unauthenticated web clients are
// VIEWER. Raw pipes (TCP:23/BT) have no app-layer login — their perimeter
// is WPA2/BT-pairing + the single-owner policy; see SAFETY_REVIEW.md.)
//
// Passwords are salted SHA-256 (salt in NVS, never the password). Sessions
// are 16-hex-char tokens in RAM (4 slots, sliding expiry), carried in the
// M2SB_SESS cookie. Pairing (first admin / reset) needs physical
// authorization: hold the M2's Button2 (SuperB GPIO0 via Bee pin 7) for
// 3 s to open a 120 s pairing window; before any admin exists, /pair is
// open but every page carries an UNSECURED banner.
namespace auth {

enum class Role : uint8_t { NONE = 0, VIEWER = 1, OPERATOR = 2, ADMIN = 3 };

const char* roleName(Role r)
{
    switch (r) {
        case Role::ADMIN: return "admin";
        case Role::OPERATOR: return "operator";
        default: return "viewer";
    }
}

struct Sess {
    bool used = false;
    char tok[17];
    Role role = Role::VIEWER;
    uint32_t exp = 0;
};
Sess sess_[4];

bool configured() { return prefs.getBool("adm_set", false); }

void shaSalted(const uint8_t* salt, const String& pw, uint8_t* out32)
{
    mbedtls_sha256_context c;
    mbedtls_sha256_init(&c);
    mbedtls_sha256_starts_ret(&c, 0);
    mbedtls_sha256_update_ret(&c, salt, 16);
    mbedtls_sha256_update_ret(&c, (const uint8_t*)pw.c_str(), pw.length());
    mbedtls_sha256_finish_ret(&c, out32);
    mbedtls_sha256_free(&c);
}

bool eq32(const uint8_t* a, const uint8_t* b)
{
    uint8_t d = 0;
    for (int i = 0; i < 32; i++) d |= (uint8_t)(a[i] ^ b[i]);
    return d == 0;
}

// Check a password against the stored salted hash ("adm" or "opr").
bool checkPw(const char* which, const String& pw)
{
    char skey[16], hkey[16], fkey[16];
    snprintf(skey, sizeof(skey), "%s_salt", which);
    snprintf(hkey, sizeof(hkey), "%s_hash", which);
    snprintf(fkey, sizeof(fkey), "%s_set", which);
    if (!prefs.getBool(fkey, false)) return false;
    if (pw.length() < 1 || pw.length() > 64) return false;
    uint8_t salt[16], want[32], got[32];
    if (prefs.getBytes(skey, salt, sizeof(salt)) != sizeof(salt)) return false;
    if (prefs.getBytes(hkey, want, sizeof(want)) != sizeof(want)) return false;
    shaSalted(salt, pw, got);
    bool ok = eq32(want, got);
    memset(salt, 0, sizeof(salt));
    memset(got, 0, sizeof(got));
    return ok;
}

// Store a salted hash for "adm"/"opr". Empty password clears the account.
void setPw(const char* which, const String& pw)
{
    char skey[16], hkey[16], fkey[16];
    snprintf(skey, sizeof(skey), "%s_salt", which);
    snprintf(hkey, sizeof(hkey), "%s_hash", which);
    snprintf(fkey, sizeof(fkey), "%s_set", which);
    if (pw.length() == 0) {
        prefs.putBool(fkey, false);
        return;
    }
    uint8_t salt[16], h[32];
    for (int i = 0; i < 16; i += 4) {
        uint32_t r = esp_random();
        salt[i] = (uint8_t)(r & 0xFF);
        salt[i + 1] = (uint8_t)((r >> 8) & 0xFF);
        salt[i + 2] = (uint8_t)((r >> 16) & 0xFF);
        salt[i + 3] = (uint8_t)((r >> 24) & 0xFF);
    }
    shaSalted(salt, pw, h);
    prefs.putBytes(skey, salt, sizeof(salt));
    prefs.putBytes(hkey, h, sizeof(h));
    prefs.putBool(fkey, true);
    memset(salt, 0, sizeof(salt));
    memset(h, 0, sizeof(h));
}

String newSession(Role r)
{
    uint32_t now = millis();
    uint32_t tmo = prefs.getUInt("sess_tmo", 1800);
    int slot = -1;
    for (int i = 0; i < 4; i++) {
        if (!sess_[i].used ||
            (int32_t)(now - sess_[i].exp) >= 0) {
            slot = i;
            break;
        }
    }
    if (slot < 0) slot = 0;  // evict oldest slot
    static const char* H = "0123456789abcdef";
    for (int i = 0; i < 8; i++) {
        uint32_t rr = esp_random();
        sess_[slot].tok[2 * i] = H[(rr >> 4) & 0xF];
        sess_[slot].tok[2 * i + 1] = H[rr & 0xF];
    }
    sess_[slot].tok[16] = '\0';
    sess_[slot].used = true;
    sess_[slot].role = r;
    sess_[slot].exp = now + tmo * 1000UL;
    return String(sess_[slot].tok);
}

// Role of the current web request from the M2SB_SESS cookie.
// Unauthenticated (or expired) -> VIEWER.
Role webRole()
{
    String c = webServer.header("Cookie");
    int at = c.indexOf("M2SB_SESS=");
    if (at < 0) return Role::VIEWER;
    String tok = c.substring(at + 10, at + 26);
    uint32_t now = millis();
    for (int i = 0; i < 4; i++) {
        if (sess_[i].used && tok == sess_[i].tok) {
            if ((int32_t)(now - sess_[i].exp) >= 0) {
                sess_[i].used = false;
                return Role::VIEWER;
            }
            sess_[i].exp = now + prefs.getUInt("sess_tmo", 1800) * 1000UL;
            return sess_[i].role;
        }
    }
    return Role::VIEWER;
}

void logoutWeb()
{
    String c = webServer.header("Cookie");
    int at = c.indexOf("M2SB_SESS=");
    if (at < 0) return;
    String tok = c.substring(at + 10, at + 26);
    for (int i = 0; i < 4; i++)
        if (sess_[i].used && tok == sess_[i].tok) sess_[i].used = false;
}

}  // namespace auth

// ---- secure pairing with physical authorization (Phase 11.3)
//
// Pairing window: hold the M2's Button2 for 3 s at runtime. Button2 drives
// SuperB GPIO0 low via Bee pin 7 (XB_MULT4) — the same path the
// Button2 download-boot sequence uses (INFERRED for the runtime read;
// strapping pins are readable as GPIO after boot on ESP32 silicon).
// The window lasts 120 s (LED fast-blinks); during it /pair may set or
// reset the admin password. Do NOT hold Button2 across a SuperB reboot —
// GPIO0 low at boot enters the ESP32 download mode (documented).
namespace pair_ {

constexpr uint8_t PIN = 0;  // GPIO0 <- M2 Button2 via Bee pin 7
uint32_t lowSince = 0;
bool window = false;
uint32_t windowUntil = 0;

void poll()
{
    uint32_t now = millis();
    if (digitalRead(PIN) == LOW) {
        if (lowSince == 0) lowSince = now;
    } else {
        lowSince = 0;
    }
    if (!window && lowSince != 0 && (now - lowSince) > 3000) {
        window = true;
        windowUntil = now + 120000UL;
        lowSince = 0;
    }
    if (window && (int32_t)(now - windowUntil) >= 0) window = false;
}

bool open() { return window; }

}  // namespace pair_

// ---- signed OTA firmware updates with anti-rollback (Phase 11.4)
//
// Package format (uploaded to /ota_upload):
//   header (16B): magic "M2SBOTA1" | version u32 LE | image_len u32 LE
//   sig    (64B): ECDSA P-256 raw r||s over SHA256(header || image)
//   image (image_len bytes): raw app .bin
// Built by scripts/sign_ota.py; keypair by scripts/ota_keygen.py.
//
// Verify-then-commit: the upload streams into a running SHA-256 while
// Update.write() stages bytes into the inactive OTA slot; the ECDSA
// signature is checked BEFORE Update.end() — a bad signature calls
// Update.abort() and the image never becomes bootable. Anti-rollback:
// version must exceed the NVS-stored "ota_ver" (fresh NVS = 0).
// Recovery: USB reflash with esptool.py (documented on the /ota page).
// The PRIVATE key never lives in this tree (~/workspace/.ota-keys/).
namespace ota {

constexpr size_t HDR_LEN = 16;
constexpr size_t SIG_LEN = 64;
constexpr uint32_t MAX_IMG = 0x1E0000;  // app slot (partitions/superb_ota_4m.csv)
constexpr uint32_t MIN_IMG = 65536;

struct Up {
    bool active = false;
    bool error = false;
    String msg;
    uint8_t head[HDR_LEN + SIG_LEN];
    uint8_t headN = 0;
    bool begun = false;
    uint32_t version = 0;
    uint32_t imgLen = 0;
    uint32_t got = 0;
    mbedtls_sha256_context sha;
};
Up up;

uint32_t storedVer() { return prefs.getUInt("ota_ver", 0); }

bool verifySig(const uint8_t* hash32, const uint8_t* sig64)
{
    mbedtls_ecdsa_context ctx;
    mbedtls_ecdsa_init(&ctx);
    int rc = mbedtls_ecp_group_load(&ctx.grp, MBEDTLS_ECP_DP_SECP256R1);
    uint8_t pub[65];
    pub[0] = 0x04;
    memcpy(pub + 1, OTA_PUBKEY, 64);
    if (rc == 0)
        rc = mbedtls_ecp_point_read_binary(&ctx.grp, &ctx.Q, pub, sizeof(pub));
    if (rc == 0)
        rc = mbedtls_ecdsa_read_signature(&ctx, hash32, 32, sig64, 64);
    mbedtls_ecdsa_free(&ctx);
    return rc == 0;
}

void fail(const char* m)
{
    up.error = true;
    up.msg = m;
    if (up.begun) Update.abort();
    up.begun = false;
    up.active = false;
    prefs.putUInt("ota_last", 2);  // 2 = failed
}

}  // namespace ota

// ---- sleep/wake manager (Phase 11.5)
//
// Vehicle voltage comes from the M2's V_SENSE divider over the Bee mm
// channel (CMD_GET_VOLTAGE; INFERRED calibration until per-unit
// measured). Engine-off = voltage below v_off sustained off_min minutes
// (defaults 12.9 V / 10 min — INFERRED thresholds for a 12 V system).
// Inactivity = no client TX and no web POST for idle_min minutes
// (default 15). Engine-off AND idle -> light sleep.
//
// Sleep: WiFi/BT stopped, ESP32 light sleep with three wake sources —
// 60 s timer (re-poll voltage), GPIO0 (M2 Button2 press), UART0 RX (any
// M2 traffic on the Bee link). Wake re-inits the radios. A lighter
// "modem doze" (WiFi.setSleep(true)) applies on idleness alone while the
// engine is still on.
//
// NO sleep-current claims: currents are unmeasured (pack rule); all
// timings/thresholds are INFERRED and configurable via /power.
namespace pwr {

uint16_t lastMV = 0;
bool voltOk = false;
uint32_t lastPollMs = 0;
uint32_t lowSinceMs = 0;
uint32_t lastActMs = 0;
uint32_t wakeCause = 0;  // esp_sleep_wakeup_cause_t, for /power

uint16_t vOff() { return prefs.getUShort("v_off", 12900); }
uint16_t vOn() { return prefs.getUShort("v_on", 13200); }
uint16_t offMin() { return prefs.getUShort("off_min", 10); }
uint16_t idleMin() { return prefs.getUShort("idle_min", 15); }
bool enabled() { return prefs.getBool("sleep_en", true); }

void markActivity() { lastActMs = millis(); }

bool fetchVolt()
{
    uint8_t resp[64];
    uint8_t rlen = 0;
    if (!mmcTransact(mmc::CMD_GET_VOLTAGE, nullptr, 0, resp, sizeof(resp), rlen))
        return false;
    if (rlen < 4 || resp[0] != (mmc::CMD_GET_VOLTAGE | 0x80) ||
        resp[1] != mmc::ST_OK)
        return false;
    lastMV = (uint16_t)resp[2] | ((uint16_t)resp[3] << 8);
    voltOk = true;
    return true;
}

void netDown()
{
    // Reviewer m5: dropping the sockets must also drop ownership, or a
    // dead TCP client stays owner until the idle timeout.
    for (int i = 0; i < MAX_TCP_CLIENTS; i++) {
        if (tcpClients[i]) {
            tcpClients[i].stop();
            own::onDisconnect(own::T::TCP, (uint8_t)i);
        }
    }
    webSocket.disconnect();  // fires WStype_DISCONNECTED per client
    SerialBT.end();
    WiFi.disconnect(true);
    WiFi.mode(WIFI_OFF);
}

// Forward declaration: defined after setup() (it re-runs setup's net init).
void netInit();

void enterSleep()
{
#ifdef SIM_SUPERB
    // Sim: no real sleep — log the decision and stay up (test harness).
    fprintf(stderr, "[sim] pwr: would enter light sleep now (skipped)\n");
    lowSinceMs = 0;  // don't spin
    return;
#else
    netDown();
    esp_sleep_enable_timer_wakeup(60ULL * 1000000ULL);
    esp_sleep_enable_ext0_wakeup(GPIO_NUM_0, 0);  // Button2 press
    esp_sleep_enable_uart_wakeup(0);              // M2 traffic on Bee link
    esp_light_sleep_start();
    wakeCause = (uint32_t)esp_sleep_get_wakeup_cause();
    netInit();  // radios back up
    lastPollMs = 0;
    lowSinceMs = 0;
    markActivity();
#endif
}

void poll()
{
    if (!enabled()) return;
    uint32_t now = millis();
    if ((uint32_t)(now - lastPollMs) < 5000) return;
    lastPollMs = now;
    // Voltage poll every ~30 s (6 polls).
    static uint8_t div = 0;
    if (++div >= 6) {
        div = 0;
        fetchVolt();
    }
    // Modem doze on idleness alone (engine may still be on).
    bool idle =
        (uint32_t)(now - lastActMs) > (uint32_t)idleMin() * 60000UL;
    static bool dozing = false;
    if (idle && !dozing) {
        WiFi.setSleep(true);
        dozing = true;
    } else if (!idle && dozing) {
        WiFi.setSleep(false);
        dozing = false;
    }
    // Engine-off detection -> light sleep needs both conditions.
    if (voltOk && lastMV < vOff()) {
        if (lowSinceMs == 0) lowSinceMs = now;
    } else {
        lowSinceMs = 0;
    }
    bool engineOff = lowSinceMs != 0 &&
                     (uint32_t)(now - lowSinceMs) >
                         (uint32_t)offMin() * 60000UL;
    if (engineOff && idle) enterSleep();
}

}  // namespace pwr

// ---- WebSocket transport (Phase 11.1)
//
// WebSocketsServer on port 81 (port 80 is the web GUI). Binary frames are
// the raw byte stream — the same bytes as TCP:23 (GVRET-capable apps can
// use ws://host:81 the way they use TCP:23). Text frames carry a tiny
// JSON control protocol: {"t":"status"} {"t":"claim"} {"t":"release"}
// {"t":"auth","pw":"..."}. Binary TX follows the single-owner policy and
// (when auth is configured) needs an authed role >= OPERATOR on that WS
// client; text auth elevates the client without breaking raw-pipe apps.
namespace ws {

constexpr uint8_t MAXW = 4;
struct Slot {
    bool used = false;
    uint8_t num = 0;
    auth::Role role = auth::Role::VIEWER;
};
Slot slots[MAXW];

int8_t byNum(uint8_t num)
{
    for (int8_t i = 0; i < MAXW; i++)
        if (slots[i].used && slots[i].num == num) return i;
    return -1;
}

uint8_t nClients()
{
    uint8_t n = 0;
    for (uint8_t i = 0; i < MAXW; i++)
        if (slots[i].used) n++;
    return n;
}

void sendText(int8_t s, String j)  // by value: real lib takes String&
{
    if (s >= 0) webSocket.sendTXT(slots[s].num, j);
}

// Minimal JSON field extract: "key":"value" or "key":value.
// Works straight on the byte buffer (no String API assumptions).
String jfield(const uint8_t* p, size_t n, const char* key)
{
    if (!p || !key || n == 0) return String("");
    size_t kl = strlen(key);
    // Find "key"
    size_t i = 0;
    bool found = false;
    for (; i + kl + 2 < n; i++) {
        if (p[i] == '"' && memcmp(p + i + 1, key, kl) == 0 &&
            p[i + 1 + kl] == '"') {
            i += kl + 2;
            found = true;
            break;
        }
    }
    if (!found) return String("");
    while (i < n && (p[i] == ' ' || p[i] == ':')) i++;
    bool quoted = i < n && p[i] == '"';
    if (quoted) i++;
    String v;
    while (i < n) {
        char c = (char)p[i];
        if (quoted && c == '"') break;
        if (!quoted && (c == ',' || c == '}' || c == ' ')) break;
        v += c;
        i++;
        if (v.length() > 64) break;  // sanity cap
    }
    return v;
}

void onEvent(uint8_t num, WStype_t type, uint8_t* payload, size_t len)
{
    switch (type) {
        case WStype_CONNECTED: {
            int8_t s = -1;
            for (int8_t i = 0; i < MAXW; i++)
                if (!slots[i].used) {
                    s = i;
                    break;
                }
            if (s < 0) {
                webSocket.disconnect(num);  // full
                return;
            }
            slots[s].used = true;
            slots[s].num = num;
            slots[s].role = auth::Role::VIEWER;
            break;
        }
        case WStype_DISCONNECTED: {
            int8_t s = byNum(num);
            if (s >= 0) {
                slots[s].used = false;
                own::onDisconnect(own::T::WS, (uint8_t)s);
            }
            break;
        }
        case WStype_BIN: {
            int8_t s = byNum(num);
            if (s < 0 || len == 0) break;
            bool roleOk = !auth::configured() ||
                          slots[s].role >= auth::Role::OPERATOR;
            if (roleOk && own::txAllowed(own::T::WS, (uint8_t)s)) {
                pwr::markActivity();
                mmc::uartWriteFiltered(payload, len);
            } else {
                own::dropped((uint32_t)len);
            }
            break;
        }
        case WStype_TEXT: {
            int8_t s = byNum(num);
            if (s < 0) break;
            String t = jfield(payload, len, "t");
            // Reviewer m7: status polls are passive — they must not pin
            // the device awake. Only explicit actions mark activity.
            if (t != "status") pwr::markActivity();
            if (t == "status") {
                String j = "{\"t\":\"status\",\"dev\":\"" + appl::devIdStr +
                           "\",\"owner\":\"" + own::desc() + "\",\"role\":" +
                           String((int)slots[s].role) + ",\"volt\":" +
                           String(pwr::lastMV) + ",\"ota\":" +
                           String(ota::storedVer()) + "}";
                sendText(s, j);
            } else if (t == "claim") {
                // Reviewer M1: claiming control is a control-plane op —
                // unauthenticated viewers must not squat ownership (DoS:
                // the real owner's TX would drop until the idle timeout).
                bool roleOk = !auth::configured() ||
                              slots[s].role >= auth::Role::OPERATOR;
                bool ok = roleOk && own::txAllowed(own::T::WS, (uint8_t)s);
                sendText(s, ok ? "{\"t\":\"claimed\"}"
                               : "{\"t\":\"denied\",\"why\":\"owned\"}");
            } else if (t == "release") {
                if (own::owner.t == own::T::WS &&
                    own::owner.idx == (uint8_t)s)
                    own::release();
                sendText(s, "{\"t\":\"released\"}");
            } else if (t == "auth") {
                String pw = jfield(payload, len, "pw");
                if (auth::checkPw("adm", pw))
                    slots[s].role = auth::Role::ADMIN;
                else if (auth::checkPw("opr", pw))
                    slots[s].role = auth::Role::OPERATOR;
                else {
                    sendText(s, "{\"t\":\"auth\",\"ok\":false}");
                    break;
                }
                sendText(s, "{\"t\":\"auth\",\"ok\":true,\"role\":" +
                                String((int)slots[s].role) + "}");
            }
            break;
        }
        default:
            break;
    }
}

}  // namespace ws



// Forward: pumpBeeRx is defined below; mmcTransact needs it.
void pumpBeeRx();

// ---- mmcTransact: sends a control frame DIRECTLY (bypasses the TX filter
// ---- the SuperB is the legitimate sender) and waits for the reply.
bool mmcTransact(uint8_t cmd, const uint8_t* payload, uint8_t plen,
                 uint8_t* resp, uint8_t outCap, uint8_t& rlen,
                 uint16_t timeoutMs)
{
    using namespace mmc;
    if (plen > MAXP - 1) return false;
    uint8_t f[4 + MAXP];
    f[0] = SYNC; f[1] = CH; f[2] = (uint8_t)(1 + plen); f[3] = cmd;
    uint8_t x = cmd;
    for (uint8_t i = 0; i < plen; i++) { f[4 + i] = payload[i]; x ^= payload[i]; }
    f[4 + plen] = x;
    pending.active = true; pending.cmd = cmd; pending.got = false;
    pending.respLen = 0;
    Serial.write(f, (size_t)(5 + plen));  // direct: bypasses TX filter
    uint32_t deadline = millis() + timeoutMs;
    while (!pending.got && (int32_t)(millis() - deadline) < 0) {
        pumpBeeRx();
        delay(1);
    }
    pending.active = false;
    if (!pending.got) return false;
    // Audit fix C1 (2026-10-08): never copy more than the caller can hold.
    // respLen is clamped to sizeof(pending.resp)=64 by handleReply(); outCap
    // is the caller's buffer size (pass sizeof(resp) at every call site).
    rlen = (pending.respLen <= outCap) ? pending.respLen : outCap;
    for (uint8_t i = 0; i < rlen; i++) resp[i] = pending.resp[i];
    return true;
}

// M2 status snapshot for the web GUI.
struct M2Status {
    bool ok = false;
    uint8_t mode = 0;
    uint32_t can0 = 0, can1 = 0, swcan = 0;
    uint8_t features = 0;
};
M2Status m2status;

bool fetchM2Status()
{
    uint8_t resp[64]; uint8_t rlen = 0;
    if (!mmcTransact(mmc::CMD_GET_STATUS, nullptr, 0, resp, sizeof(resp), rlen)) {
        m2status.ok = false;
        return false;
    }
    if (rlen < 16 || resp[0] != (mmc::CMD_GET_STATUS | 0x80) || resp[1] != mmc::ST_OK) {
        m2status.ok = false;
        return false;
    }
    m2status.ok = true;
    m2status.mode = resp[2];
    m2status.can0 = (uint32_t)resp[3] | ((uint32_t)resp[4] << 8) |
                    ((uint32_t)resp[5] << 16) | ((uint32_t)resp[6] << 24);
    m2status.can1 = (uint32_t)resp[7] | ((uint32_t)resp[8] << 8) |
                    ((uint32_t)resp[9] << 16) | ((uint32_t)resp[10] << 24);
    m2status.swcan = (uint32_t)resp[11] | ((uint32_t)resp[12] << 8) |
                     ((uint32_t)resp[13] << 16) | ((uint32_t)resp[14] << 24);
    m2status.features = resp[15];
    return true;
}

const char* modeName(uint8_t m)
{
    switch (m) {
        case 0: return "m2ret";
        case 1: return "elm327";
        case 2: return "stn";
        case 3: return "uds";
        case 4: return "mitm";
        case 5: return "obd2";
        case 6: return "prog";
        case 7: return "gateway";
        case 8: return "slcan";
        case 9: return "harness";
        default: return "?";
    }
}

// ============ web GUI ============
const char HTML_HEAD[] =
    "<!DOCTYPE html><html><head><meta charset='utf-8'>"
    "<meta name='viewport' content='width=device-width,initial-scale=1'>"
    "<title>M2-SuperB</title>"
    "<style>body{font-family:sans-serif;max-width:640px;margin:1em auto;padding:0 1em}"
    "h1{font-size:1.3em}table{border-collapse:collapse;width:100%}"
    "td,th{border:1px solid #ccc;padding:.4em;text-align:left}"
    "input,select{font-size:1em;margin:.2em 0}button{font-size:1em;padding:.4em 1em;margin:.2em}"
    ".warn{color:#a00;font-weight:bold}</style></head><body>";
const char HTML_NAV[] =
    "<p><a href='/'>Status</a> | <a href='/mode'>Mode</a> | "
    "<a href='/settings'>Settings</a> | <a href='/uds'>UDS</a> | "
    "<a href='/obd2'>OBD2</a> | <a href='/mitm'>MITM</a> | "
    "<a href='/gateway'>Gateway</a> | "
    "<a href='/prog'>PROG</a> | <a href='/clients'>Clients</a> | "
    "<a href='/ota'>OTA</a> | <a href='/power'>Power</a> | "
    "<a href='/auth'>Auth</a> | <a href='/wifi'>WiFi</a> | "
    "<a href='/phase12'>P12</a> | <a href='/logs'>Logs</a></p>";

void pageHead(const char* title)
{
    webServer.sendHeader("Cache-Control", "no-cache");
    String h = HTML_HEAD;
    h += "<h1>M2-SuperB — ";
    h += title;
    h += "</h1>";
    h += HTML_NAV;
    // Phase 11: identity + role badge on every page.
    h += "<p style='font-size:.85em;color:#555'>Device <b>";
    h += appl::devIdStr;
    h += "</b> · web role <b>";
#ifndef SIM_SUPERB
    h += auth::configured() ? auth::roleName(auth::webRole()) : "setup";
#else
    h += "sim";
#endif
    h += "</b>";
#ifndef SIM_SUPERB
    if (!auth::configured())
        h += " · <span class='warn'>UNSECURED — complete pairing "
             "(hold the M2's Button2 3 s, then open /pair)</span>";
    else if (pair_::open())
        h += " · <span class='warn'>PAIRING WINDOW OPEN (120 s)</span>";
#endif
    h += "</p>";
    webServer.sendContent(h);
}
void pageFoot() { webServer.sendContent("</body></html>"); }

// ---- Phase 11: web role gating helpers ----
//
// requireRole(): true when this request may perform the action.
// Sim builds bypass (test harness, no security boundary — documented).
// Before any admin exists, everything is allowed but every page carries
// an UNSECURED banner (setup mode). After configuration, unauthenticated
// requests are VIEWER (read-only): GET pages render, POSTs are refused.
// Forward: sleep/wake manager (defined with the Phase 11 web UI below).
namespace pwr {
void markActivity();
}

bool requireRole(auth::Role need)
{
#ifdef SIM_SUPERB
    (void)need;
    return true;  // sim: no security boundary on loopback (documented)
#else
    if (!auth::configured()) return true;  // setup mode (banner warns)
    bool ok = (uint8_t)auth::webRole() >= (uint8_t)need;
    if (ok) pwr::markActivity();  // any authorized web action = activity
    return ok;
#endif
}

void denyPage(auth::Role need)
{
    webServer.setContentLength(CONTENT_LENGTH_UNKNOWN);
    webServer.send(200, "text/html", "");
    pageHead("Access denied");
    webServer.sendContent(
        String("<p class='warn'>This action needs the <b>") +
        auth::roleName(need) +
        "</b> role. <a href='/auth'>Log in</a>.</p>");
    pageFoot();
    webServer.sendContent("");
}

void handleRoot()
{
    fetchM2Status();
    webServer.setContentLength(CONTENT_LENGTH_UNKNOWN);
    webServer.send(200, "text/html", "");
    pageHead("Status");
    String b;
    b += "<table>";
    b += "<tr><th>Item</th><th>Value</th></tr>";
    b += "<tr><td>M2 mode</td><td>";
    b += m2status.ok ? modeName(m2status.mode) : "<span class='warn'>unreachable</span>";
    b += "</td></tr>";
    if (m2status.ok) {
        b += "<tr><td>CAN0 baud</td><td>" + String(m2status.can0) + "</td></tr>";
        b += "<tr><td>CAN1 baud</td><td>" + String(m2status.can1) + "</td></tr>";
        b += "<tr><td>SWCAN speed</td><td>" + String(m2status.swcan) + "</td></tr>";
        b += "<tr><td>Features</td><td>J1850 ";
        b += (m2status.features & 0x01) ? "on" : "off";
        b += " / SWCAN ";
        b += (m2status.features & 0x02) ? "on" : "off";
        b += "</td></tr>";
    }
    b += "<tr><td>AP IP</td><td>" + WiFi.softAPIP().toString() + "</td></tr>";
    b += "<tr><td>STA</td><td>";
    b += (WiFi.status() == WL_CONNECTED)
             ? ("connected, " + WiFi.localIP().toString())
             : "not connected";
    b += "</td></tr>";
    int tcpN = 0;
    for (int i = 0; i < MAX_TCP_CLIENTS; i++)
        if (tcpClients[i] && tcpClients[i].connected()) tcpN++;
    b += "<tr><td>TCP clients (:23)</td><td>" + String(tcpN) + "</td></tr>";
    b += "<tr><td>Bluetooth</td><td>";
    b += SerialBT.hasClient() ? "client connected" : "no client";
    b += "</td></tr></table>";
    b += "<p>Mode switches always quiesce the vehicle buses first "
         "(safe-switch rule).</p>";
    webServer.sendContent(b);
    pageFoot();
    webServer.sendContent("");
}

void handleMode()
{
    webServer.setContentLength(CONTENT_LENGTH_UNKNOWN);
    webServer.send(200, "text/html", "");
    pageHead("Switch mode");
    webServer.sendContent(
        "<p class='warn'>Switching mode quiesces all vehicle buses first. "
        "Do not switch while driving.</p>"
        "<form method='POST' action='/mode_set'>"
        "<button name='mode' value='0'>M2RET (SavvyCAN)</button><br>"
        "<button name='mode' value='1'>ELM327 (Torque/FORScan)</button><br>"
        "<button name='mode' value='2'>STN (STN11xx command set)</button><br>"
        "<button name='mode' value='3'>UDS (diagnostics)</button><br>"
        "<button name='mode' value='4'>MITM (CAN bridge)</button><br>"
        "<button name='mode' value='5'>OBD2 (PID poller)</button><br>"
        "<button name='mode' value='6'>PROG (ECU flashing — read the /prog safety box first)</button><br>"
        "<button name='mode' value='7'>GATEWAY (CAN &lt;-&gt; SWCAN translation)</button><br>"
        "<button name='mode' value='8'>SLCAN (Lawicel ASCII transport)</button><br>"
        "<button name='mode' value='9'>HARNESS (virtual-ECU self-test)</button><br>"
        "<p class='warn'>HARNESS mode precondition: wire a <b>CAN0 &lt;-&gt; CAN1 physical "
        "loopback pair</b> (CAN0H to CAN1H, CAN0L to CAN1L) and NOTHING else. "
        "The self-test suite refuses to run without a passing loopback self-check, "
        "but do not enter HARNESS mode with the M2 connected to a vehicle.</p>"
        "<label><input type='checkbox' name='confirm' value='1'> I confirm the bus will be quiesced</label><br>"
        "<label><input type='checkbox' name='confirm_harness' value='1'> HARNESS only: the CAN0&lt;-&gt;CAN1 loopback pair is wired, no vehicle attached</label><br>"
        "</form>");
    pageFoot();
    webServer.sendContent("");
}

void handleModeSet()
{
    if (!requireRole(auth::Role::OPERATOR)) {
        denyPage(auth::Role::OPERATOR);
        return;
    }
    bool confirmed = webServer.hasArg("confirm");
    bool harnessConfirmed = webServer.hasArg("confirm_harness");
    int mode = webServer.hasArg("mode") ? webServer.arg("mode").toInt() : -1;
    webServer.setContentLength(CONTENT_LENGTH_UNKNOWN);
    webServer.send(200, "text/html", "");
    pageHead("Switch mode");
    String b;
    // HARNESS (9) needs the extra loopback confirmation on top of the
    // general one; the M2-side suite additionally refuses without a
    // passing loopback self-check.
    bool harnessGate = (mode != 9) || harnessConfirmed;
    if (!confirmed || !harnessGate || mode < 0 || mode > 9) {
        b = "<p class='warn'>Not executed: confirm the checkbox and pick an implemented mode "
            "(HARNESS also needs the loopback-pair confirmation).</p>";
    } else {
        uint8_t m = (uint8_t)mode;
        uint8_t resp[64]; uint8_t rlen = 0;
        bool ok = mmcTransact(mmc::CMD_SET_MODE, &m, 1, resp, sizeof(resp), rlen);
        if (ok && rlen >= 2 && resp[1] == mmc::ST_OK)
            b = "<p>Switched to <b>" + String(modeName(m)) + "</b>. Buses were quiesced first.</p>";
        else
            b = "<p class='warn'>Switch failed or M2 did not answer.</p>";
    }
    webServer.sendContent(b);
    pageFoot();
    webServer.sendContent("");
}

String baudSelect(const char* name, uint32_t cur)
{
    const uint32_t opts[] = { 100000, 125000, 250000, 500000, 1000000 };
    String s = "<select name='";
    s += name;
    s += "'>";
    for (uint8_t i = 0; i < 5; i++) {
        s += "<option value='" + String(opts[i]) + "'";
        if (opts[i] == cur) s += " selected";
        s += ">" + String(opts[i]) + "</option>";
    }
    return s + "</select>";
}

void handleSettings()
{
    fetchM2Status();
    webServer.setContentLength(CONTENT_LENGTH_UNKNOWN);
    webServer.send(200, "text/html", "");
    pageHead("Settings");
    String b = "<form method='POST' action='/settings_set'>";
    b += "CAN0 baud: " + baudSelect("can0", m2status.can0) + "<br>";
    b += "CAN1 baud: " + baudSelect("can1", m2status.can1) + "<br>";
    b += "SWCAN speed: <select name='swcan'>"
         "<option value='33333'" + String(m2status.swcan == 33333 ? " selected" : "") + ">33333</option>"
         "<option value='83333'" + String(m2status.swcan == 83333 ? " selected" : "") + ">83333</option></select><br>";
    b += "<label><input type='checkbox' name='j1850' value='1'" +
         String((m2status.features & 0x01) ? " checked" : "") + "> J1850 rail/protocols</label><br>";
    b += "<label><input type='checkbox' name='swcanen' value='1'" +
         String((m2status.features & 0x02) ? " checked" : "") + "> SWCAN bus</label><br>";
    b += "<p>Baud/speed changes apply live in M2RET mode; in ELM mode they "
         "are staged for the next protocol activation.</p>";
    b += "<button>Apply</button></form>";
    webServer.sendContent(b);
    pageFoot();
    webServer.sendContent("");
}

bool setCanBaudWeb(uint8_t bus, const String& v, String& log)
{
    uint8_t req[5] = { bus, 0, 0, 0, 0 };
    uint32_t b = (uint32_t)v.toInt();
    req[1] = (uint8_t)(b & 0xFF); req[2] = (uint8_t)((b >> 8) & 0xFF);
    req[3] = (uint8_t)((b >> 16) & 0xFF); req[4] = (uint8_t)((b >> 24) & 0xFF);
    uint8_t resp[64]; uint8_t rlen = 0;
    bool ok = mmcTransact(mmc::CMD_SET_CAN_BAUD, req, 5, resp, sizeof(resp), rlen);
    bool applied = ok && rlen >= 3 && resp[1] == mmc::ST_OK && resp[2];
    log += "CAN" + String(bus) + " -> " + v +
           (ok && rlen >= 2 && resp[1] == mmc::ST_OK
                ? (applied ? " (live)<br>" : " (staged)<br>")
                : " <span class='warn'>failed</span><br>");
    return ok;
}

void handleSettingsSet()
{
    if (!requireRole(auth::Role::OPERATOR)) {
        denyPage(auth::Role::OPERATOR);
        return;
    }
    webServer.setContentLength(CONTENT_LENGTH_UNKNOWN);
    webServer.send(200, "text/html", "");
    pageHead("Settings");
    String b;
    if (webServer.hasArg("can0")) setCanBaudWeb(0, webServer.arg("can0"), b);
    if (webServer.hasArg("can1")) setCanBaudWeb(1, webServer.arg("can1"), b);
    if (webServer.hasArg("swcan")) {
        uint32_t s = (uint32_t)webServer.arg("swcan").toInt();
        uint8_t req[4] = { (uint8_t)(s & 0xFF), (uint8_t)((s >> 8) & 0xFF),
                           (uint8_t)((s >> 16) & 0xFF), (uint8_t)((s >> 24) & 0xFF) };
        uint8_t resp[64]; uint8_t rlen = 0;
        bool ok = mmcTransact(mmc::CMD_SET_SWCAN_SPEED, req, 4, resp, sizeof(resp), rlen);
        b += "SWCAN -> " + webServer.arg("swcan") +
             (ok && rlen >= 2 && resp[1] == mmc::ST_OK ? " ok<br>" : " <span class='warn'>failed</span><br>");
    }
    auto feat = [&](uint8_t id, const char* arg, const char* name) {
        uint8_t req[2] = { id, (uint8_t)(webServer.hasArg(arg) ? 1 : 0) };
        uint8_t resp[64]; uint8_t rlen = 0;
        bool ok = mmcTransact(mmc::CMD_SET_FEATURE, req, 2, resp, sizeof(resp), rlen);
        b += String(name) + (webServer.hasArg(arg) ? " on" : " off") +
             (ok && rlen >= 2 && resp[1] == mmc::ST_OK ? " ok<br>" : " <span class='warn'>failed</span><br>");
    };
    feat(0x01, "j1850", "J1850");
    feat(0x02, "swcanen", "SWCAN");
    webServer.sendContent(b);
    pageFoot();
    webServer.sendContent("");
}

void handleWifi()
{
    webServer.setContentLength(CONTENT_LENGTH_UNKNOWN);
    webServer.send(200, "text/html", "");
    pageHead("WiFi");
    String b = "<form method='POST' action='/wifi_set'>";
    b += "AP password (WPA2): <input name='ap_pass' type='password' minlength='8'><br>";
    b += "STA SSID: <input name='sta_ssid'><br>";
    b += "STA password: <input name='sta_pass' type='password'><br>";
    b += "<p>Saving restarts the SuperB. Leave a field empty to keep its current value.</p>";
    b += "<button>Save &amp; restart</button></form>";
    webServer.sendContent(b);
    pageFoot();
    webServer.sendContent("");
}

void handleWifiSet()
{
    if (!requireRole(auth::Role::ADMIN)) {
        denyPage(auth::Role::ADMIN);
        return;
    }
    bool changed = false;
    if (webServer.hasArg("ap_pass") && webServer.arg("ap_pass").length() >= 8) {
        prefs.putString("ap_pass", webServer.arg("ap_pass"));
        changed = true;
    }
    if (webServer.hasArg("sta_ssid") && webServer.arg("sta_ssid").length() > 0) {
        prefs.putString("sta_ssid", webServer.arg("sta_ssid"));
        prefs.putString("sta_pass", webServer.arg("sta_pass"));
        changed = true;
    }
    webServer.setContentLength(CONTENT_LENGTH_UNKNOWN);
    webServer.send(200, "text/html", "");
    pageHead("WiFi");
    webServer.sendContent(changed
        ? "<p>Saved. Restarting…</p>"
        : "<p>Nothing changed (AP password needs 8+ chars).</p>");
    pageFoot();
    webServer.sendContent("");
    delay(500);
    if (changed) ESP.restart();
}

void handleApiStatus()
{
    fetchM2Status();
    String j = "{";
    j += "\"m2_ok\":" + String(m2status.ok ? "true" : "false") + ",";
    j += "\"mode\":\"" + String(modeName(m2status.mode)) + "\",";
    j += "\"can0\":" + String(m2status.can0) + ",";
    j += "\"can1\":" + String(m2status.can1) + ",";
    j += "\"swcan\":" + String(m2status.swcan) + ",";
    j += "\"features\":" + String(m2status.features) + ",";
    j += "\"ap_ip\":\"" + WiFi.softAPIP().toString() + "\",";
    j += "\"sta_connected\":" + String(WiFi.status() == WL_CONNECTED ? "true" : "false");
    // Phase 11: appliance identity/state (additive; existing keys unchanged).
    j += ",\"dev_id\":\"" + appl::devIdStr + "\"";
    j += ",\"owner\":\"" + own::desc() + "\"";
    j += ",\"dropped_tx\":" + String(own::droppedTx);
    j += ",\"ws_clients\":" + String(ws::nClients());
    j += ",\"volt_mv\":" + String(pwr::lastMV);
    j += ",\"volt_ok\":" + String(pwr::voltOk ? "true" : "false");
    j += ",\"ota_ver\":" + String(ota::storedVer());
    j += ",\"auth\":" + String(auth::configured() ? "true" : "false");
    j += "}";
    webServer.send(200, "application/json", j);
}

// ============ Phase 3: UDS + OBD2 pages ============

const char* nrcText(uint8_t nrc)  // ISO 14229-1 (mirrors src/m2/mode_uds.h)
{
    switch (nrc) {
        case 0x10: return "generalReject";
        case 0x11: return "serviceNotSupported";
        case 0x12: return "subFunctionNotSupported";
        case 0x13: return "incorrectMessageLengthOrInvalidFormat";
        case 0x21: return "busyRepeatRequest";
        case 0x22: return "conditionsNotCorrect";
        case 0x24: return "requestSequenceError";
        case 0x25: return "noResponseFromSubnetComponent";
        case 0x26: return "failurePreventsExecutionOfRequestedAction";
        case 0x31: return "requestOutOfRange";
        case 0x33: return "securityAccessDenied";
        case 0x35: return "invalidKey";
        case 0x36: return "exceedNumberOfAttempts";
        case 0x37: return "requiredTimeDelayNotExpired";
        case 0x70: return "uploadDownloadNotAccepted";
        case 0x71: return "transferDataSuspended";
        case 0x72: return "generalProgrammingFailure";
        case 0x73: return "wrongBlockSequenceCounter";
        case 0x78: return "requestCorrectlyReceived_ResponsePending";
        case 0x7E: return "subFunctionNotSupportedInActiveSession";
        case 0x7F: return "serviceNotSupportedInActiveSession";
        default:   return "unknown NRC";
    }
}

// Parse "22 F190" / "22F190" / "22 f1 90" into bytes. Returns count or -1.
int hexToBytes(const String& s, uint8_t* out, uint8_t cap)
{
    uint8_t n = 0;
    int i = 0, L = s.length();
    while (i < L) {
        while (i < L && (s[i] == ' ' || s[i] == '\t' || s[i] == ',')) i++;
        if (i >= L) break;
        if (i + 1 >= L || n >= cap) return -1;
        char tmp[3] = { s[i], s[i + 1], '\0' };
        char* e; long v = strtol(tmp, &e, 16);
        if (*e != '\0' || v < 0 || v > 0xFF) return -1;
        out[n++] = (uint8_t)v;
        i += 2;
    }
    return n;
}

String hexStr(const uint8_t* d, uint8_t n)
{
    static const char* H = "0123456789ABCDEF";
    String s;
    for (uint8_t i = 0; i < n; i++) {
        if (i) s += ' ';
        s += H[(d[i] >> 4) & 0xF];
        s += H[d[i] & 0xF];
    }
    return s;
}

struct UdsStatus {
    bool ok = false;
    uint8_t session = 1, bus = 0, func = 0, tpOn = 0;
    uint32_t baud = 500000, txId = 0x7E0, rxId = 0x7E8;
};
UdsStatus udsSt;

bool fetchUdsStatus()
{
    uint8_t resp[64]; uint8_t rlen = 0;
    if (!mmcTransact(mmc::CMD_UDS_STATUS, nullptr, 0, resp, sizeof(resp), rlen) ||
        rlen < 18 || resp[0] != (mmc::CMD_UDS_STATUS | 0x80) || resp[1] != mmc::ST_OK) {
        udsSt.ok = false;
        return false;
    }
    udsSt.ok = true;
    udsSt.session = resp[2]; udsSt.bus = resp[3];
    udsSt.baud = (uint32_t)resp[4] | ((uint32_t)resp[5] << 8) |
                 ((uint32_t)resp[6] << 16) | ((uint32_t)resp[7] << 24);
    udsSt.txId = (uint32_t)resp[8] | ((uint32_t)resp[9] << 8) |
                 ((uint32_t)resp[10] << 16) | ((uint32_t)resp[11] << 24);
    udsSt.rxId = (uint32_t)resp[12] | ((uint32_t)resp[13] << 8) |
                 ((uint32_t)resp[14] << 16) | ((uint32_t)resp[15] << 24);
    udsSt.func = resp[16]; udsSt.tpOn = resp[17];
    return true;
}

struct Obd2Status {
    bool ok = false;
    uint8_t running = 0, bus = 0, nPids = 0;
    uint16_t interval = 1000;
};
Obd2Status obd2St;

bool fetchObd2Status()
{
    uint8_t resp[64]; uint8_t rlen = 0;
    if (!mmcTransact(mmc::CMD_OBD2_STATUS, nullptr, 0, resp, sizeof(resp), rlen) ||
        rlen < 7 || resp[0] != (mmc::CMD_OBD2_STATUS | 0x80) || resp[1] != mmc::ST_OK) {
        obd2St.ok = false;
        return false;
    }
    obd2St.ok = true;
    obd2St.running = resp[2]; obd2St.bus = resp[3];
    obd2St.interval = (uint16_t)resp[4] | ((uint16_t)resp[5] << 8);
    obd2St.nPids = resp[6];
    return true;
}

// Send one raw UDS service; returns true and fills out with a human-
// readable result. needsConfirm: caller already checked the web checkbox.
bool udsSendRaw(uint8_t svc, const uint8_t* params, uint8_t nParams, String& out)
{
    uint8_t req[1 + 1 + 32];
    req[0] = (uint8_t)(1 + nParams);
    req[1] = svc;
    for (uint8_t i = 0; i < nParams; i++) req[2 + i] = params[i];
    uint8_t resp[64]; uint8_t rlen = 0;
    // F-03-02: the frame is [svcLen][svc][params...] = 2 + nParams bytes.
    // The old (1 + nParams) omitted the svcLen byte itself, so the M2
    // rejected every request (rxLen < 3, or svcLen > rxLen - 2).
    bool ok = mmcTransact(mmc::CMD_UDS_TX, req, (uint8_t)(2 + nParams), resp, sizeof(resp), rlen);
    if (!ok) { out = "<span class='warn'>M2 did not answer.</span>"; return false; }
    if (rlen < 2 || resp[1] != mmc::ST_OK) {
        out = "<span class='warn'>Rejected: switch the M2 to UDS mode first.</span>";
        return false;
    }
    uint8_t nResp = (rlen > 2) ? resp[2] : 0;
    uint8_t dlen = (rlen > 3) ? resp[3] : 0;
    out = "TX: " + hexStr(&svc, 1);
    if (nParams) out += " " + hexStr(params, nParams);
    out += "<br>";
    if (nResp == 0) {
        out += "NO DATA (no ECU answered)";
        return true;
    }
    out += "RX (" + String(nResp) + " ECU(s), first shown): " + hexStr(resp + 4, dlen);
    if (dlen >= 3 && resp[4] == 0x7F && resp[5] == svc) {
        uint8_t nrc = resp[6];
        out += "<br><span class='warn'>Negative response: " + String(nrcText(nrc)) +
               " (NRC 0x" + String(nrc, HEX) + ")</span>";
    } else if (dlen >= 1 && resp[4] == (uint8_t)(svc + 0x40)) {
        out += "<br>Positive response.";
    }
    return true;
}

void handleUds()
{
    fetchUdsStatus();
    webServer.setContentLength(CONTENT_LENGTH_UNKNOWN);
    webServer.send(200, "text/html", "");
    pageHead("UDS diagnostics");
    String b;
    if (!udsSt.ok) {
        b = "<p class='warn'>M2 unreachable.</p>";
    } else {
        b += "<table><tr><th>Item</th><th>Value</th></tr>";
        b += "<tr><td>Session</td><td>0x" + String(udsSt.session, HEX) + "</td></tr>";
        b += "<tr><td>Bus</td><td>CAN" + String(udsSt.bus) + " @ " + String(udsSt.baud) + "</td></tr>";
        b += "<tr><td>Addressing</td><td>" +
             String(udsSt.func ? "functional 0x7DF" :
                    "physical TX 0x" + String(udsSt.txId, HEX) + " RX 0x" + String(udsSt.rxId, HEX)) +
             "</td></tr>";
        b += "<tr><td>Tester-present</td><td>" + String(udsSt.tpOn ? "on" : "off") + "</td></tr></table>";

        b += "<h2>Session</h2>"
             "<form method='POST' action='/uds_session' style='display:inline'>"
             "<button name='sub' value='1'>Default</button></form> "
             "<form method='POST' action='/uds_session' style='display:inline'>"
             "<button name='sub' value='3'>Extended</button></form> "
             "<form method='POST' action='/uds_session' style='display:inline'>"
             "<button name='sub' value='2'>Programming</button></form>"
             "<form method='POST' action='/uds_tp' style='display:inline'>"
             "<button name='on' value='" + String(udsSt.tpOn ? "0" : "1") + "'>Tester-present " +
             String(udsSt.tpOn ? "off" : "on") + "</button></form>";

        b += "<h2>Send service</h2>"
             "<form method='POST' action='/uds_send'>"
             "Service: <select name='svc'>"
             "<option value='10'>10 session control</option>"
             "<option value='11'>11 ECU reset</option>"
             "<option value='14'>14 clear DTC</option>"
             "<option value='19'>19 read DTC</option>"
             "<option value='22'>22 read data by ID</option>"
             "<option value='27'>27 security access (stub)</option>"
             "<option value='28'>28 communication control</option>"
             "<option value='2E'>2E write data by ID</option>"
             "<option value='3E'>3E tester present</option>"
             "<option value='85'>85 control DTC setting</option>"
             "</select><br>"
             "Params (hex bytes, e.g. subfunction + DID): <input name='params' size='24' placeholder='03 or F190'><br>"
             "<label><input type='checkbox' name='confirm' value='1'> I confirm (required for 0x11 / 0x2E)</label><br>"
             "<button>Send</button></form>"
             "<p>0x27 is a stub: the seed is shown but no key algorithm exists "
             "(OEM algorithms are proprietary and are never invented here).</p>";

        b += "<h2>Addressing / bus</h2>"
             "<form method='POST' action='/uds_cfg'>"
             "Bus: <select name='bus'>"
             "<option value='0'" + String(udsSt.bus == 0 ? " selected" : "") + ">CAN0</option>"
             "<option value='1'" + String(udsSt.bus == 1 ? " selected" : "") + ">CAN1</option></select><br>"
             "Baud: " + baudSelect("baud", udsSt.baud) + "<br>"
             "TX ID (hex): <input name='txid' size='8' value='" + String(udsSt.txId, HEX) + "'><br>"
             "RX ID (hex): <input name='rxid' size='8' value='" + String(udsSt.rxId, HEX) + "'><br>"
             "<label><input type='checkbox' name='func' value='1'" +
             String(udsSt.func ? " checked" : "") + "> Functional addressing (0x7DF)</label><br>"
             "<button>Apply</button></form>";
    }
    webServer.sendContent(b);
    pageFoot();
    webServer.sendContent("");
}

void handleUdsSend()
{
    if (!requireRole(auth::Role::OPERATOR)) {
        denyPage(auth::Role::OPERATOR);
        return;
    }
    webServer.setContentLength(CONTENT_LENGTH_UNKNOWN);
    webServer.send(200, "text/html", "");
    pageHead("UDS diagnostics");
    String b;
    uint8_t svc = 0;
    {
        String s = webServer.hasArg("svc") ? webServer.arg("svc") : "";
        char* e; long v = strtol(s.c_str(), &e, 16);
        if (*e == '\0' && v >= 0 && v <= 0xFF) svc = (uint8_t)v;
    }
    uint8_t params[32]; int nParams = 0;
    if (webServer.hasArg("params"))
        nParams = hexToBytes(webServer.arg("params"), params, sizeof(params));
    bool confirmed = webServer.hasArg("confirm");
    if (svc == 0) {
        b = "<p class='warn'>Bad service.</p>";
    } else if (nParams < 0) {
        b = "<p class='warn'>Bad params hex.</p>";
    } else if ((svc == 0x11 || svc == 0x2E) && !confirmed) {
        b = "<p class='warn'>0x11 / 0x2E need the confirm checkbox — they can "
            "change vehicle behavior.</p>";
    } else if (svc == 0x34 || svc == 0x36 || svc == 0x37) {
        b = "<p class='warn'>0x34 / 0x36 / 0x37 are refused here — flashing "
            "goes only through the M2 console download engine "
            "('uds dl' / 'uds ul' / 'uds xferdone').</p>";
    } else {
        String out;
        udsSendRaw(svc, params, (uint8_t)nParams, out);
        b = "<p>" + out + "</p>";
    }
    b += "<p><a href='/uds'>Back</a></p>";
    webServer.sendContent(b);
    pageFoot();
    webServer.sendContent("");
}

void handleUdsSession()
{
    if (!requireRole(auth::Role::OPERATOR)) {
        denyPage(auth::Role::OPERATOR);
        return;
    }
    int sub = webServer.hasArg("sub") ? webServer.arg("sub").toInt() : 1;
    if (sub != 1 && sub != 2 && sub != 3) sub = 1;
    uint8_t p[1] = { (uint8_t)sub };
    String out;
    webServer.setContentLength(CONTENT_LENGTH_UNKNOWN);
    webServer.send(200, "text/html", "");
    pageHead("UDS diagnostics");
    udsSendRaw(0x10, p, 1, out);
    webServer.sendContent("<p>" + out + "</p><p><a href='/uds'>Back</a></p>");
    pageFoot();
    webServer.sendContent("");
}

void handleUdsTp()
{
    if (!requireRole(auth::Role::OPERATOR)) {
        denyPage(auth::Role::OPERATOR);
        return;
    }
    // Toggle tester-present via UDS_CFG, preserving the current addressing.
    // req: [bus][baud LE32][txId LE32][rxId LE32][func][tpMs LE16] (16 bytes).
    fetchUdsStatus();
    uint8_t req[16];
    req[0] = udsSt.bus;
    uint32_t v = udsSt.baud;
    req[1] = (uint8_t)(v & 0xFF); req[2] = (uint8_t)((v >> 8) & 0xFF);
    req[3] = (uint8_t)((v >> 16) & 0xFF); req[4] = (uint8_t)((v >> 24) & 0xFF);
    v = udsSt.txId;
    req[5] = (uint8_t)(v & 0xFF); req[6] = (uint8_t)((v >> 8) & 0xFF);
    req[7] = (uint8_t)((v >> 16) & 0xFF); req[8] = (uint8_t)((v >> 24) & 0xFF);
    v = udsSt.rxId;
    req[9] = (uint8_t)(v & 0xFF); req[10] = (uint8_t)((v >> 8) & 0xFF);
    req[11] = (uint8_t)((v >> 16) & 0xFF); req[12] = (uint8_t)((v >> 24) & 0xFF);
    req[13] = udsSt.func;
    bool want = webServer.hasArg("on") && webServer.arg("on") == "1";
    uint16_t tpMs = want ? 2000 : 0;
    req[14] = (uint8_t)(tpMs & 0xFF); req[15] = (uint8_t)((tpMs >> 8) & 0xFF);
    uint8_t resp[64]; uint8_t rlen = 0;
    bool ok = mmcTransact(mmc::CMD_UDS_CFG, req, 16, resp, sizeof(resp), rlen);
    webServer.setContentLength(CONTENT_LENGTH_UNKNOWN);
    webServer.send(200, "text/html", "");
    pageHead("UDS diagnostics");
    webServer.sendContent(
        (ok && rlen >= 2 && resp[1] == mmc::ST_OK)
            ? "<p>Tester-present " + String(want ? "on" : "off") + ".</p>"
            : "<p class='warn'>Failed.</p>");
    webServer.sendContent("<p><a href='/uds'>Back</a></p>");
    pageFoot();
    webServer.sendContent("");
}

void handleUdsCfg()
{
    if (!requireRole(auth::Role::OPERATOR)) {
        denyPage(auth::Role::OPERATOR);
        return;
    }
    uint8_t req[16];
    req[0] = webServer.hasArg("bus") ? (uint8_t)webServer.arg("bus").toInt() : 0;
    uint32_t baud = webServer.hasArg("baud") ? (uint32_t)webServer.arg("baud").toInt() : 500000;
    req[1] = (uint8_t)(baud & 0xFF); req[2] = (uint8_t)((baud >> 8) & 0xFF);
    req[3] = (uint8_t)((baud >> 16) & 0xFF); req[4] = (uint8_t)((baud >> 24) & 0xFF);
    uint32_t txId = 0x7E0, rxId = 0x7E8;
    if (webServer.hasArg("txid")) txId = (uint32_t)strtoul(webServer.arg("txid").c_str(), nullptr, 16);
    if (webServer.hasArg("rxid")) rxId = (uint32_t)strtoul(webServer.arg("rxid").c_str(), nullptr, 16);
    req[5] = (uint8_t)(txId & 0xFF); req[6] = (uint8_t)((txId >> 8) & 0xFF);
    req[7] = (uint8_t)((txId >> 16) & 0xFF); req[8] = (uint8_t)((txId >> 24) & 0xFF);
    req[9] = (uint8_t)(rxId & 0xFF); req[10] = (uint8_t)((rxId >> 8) & 0xFF);
    req[11] = (uint8_t)((rxId >> 16) & 0xFF); req[12] = (uint8_t)((rxId >> 24) & 0xFF);
    req[13] = webServer.hasArg("func") ? 1 : 0;
    fetchUdsStatus();  // preserve tester-present interval
    uint16_t tpMs = (udsSt.ok && udsSt.tpOn) ? 2000 : 0;
    req[14] = (uint8_t)(tpMs & 0xFF); req[15] = (uint8_t)((tpMs >> 8) & 0xFF);
    uint8_t resp[64]; uint8_t rlen = 0;
    bool ok = mmcTransact(mmc::CMD_UDS_CFG, req, 16, resp, sizeof(resp), rlen);
    webServer.setContentLength(CONTENT_LENGTH_UNKNOWN);
    webServer.send(200, "text/html", "");
    pageHead("UDS diagnostics");
    webServer.sendContent(
        (ok && rlen >= 2 && resp[1] == mmc::ST_OK)
            ? "<p>Addressing applied (bus re-acquires lazily).</p>"
            : "<p class='warn'>Failed (bad args?).</p>");
    webServer.sendContent("<p><a href='/uds'>Back</a></p>");
    pageFoot();
    webServer.sendContent("");
}

// ---- OBD2 poller page ----

// Recent CSV lines sniffed from the Bee link (M2 OBD2 mode only).
constexpr uint8_t CSV_LINES = 24;
constexpr uint8_t CSV_LEN = 56;
char csvRing[CSV_LINES][CSV_LEN];
uint8_t csvHead = 0;
uint8_t csvCount = 0;
char csvAcc[CSV_LEN];
uint8_t csvAccN = 0;

void csvFeed(const uint8_t* data, size_t n)
{
    for (size_t i = 0; i < n; i++) {
        char c = (char)data[i];
        if (c == '\n') {
            if (csvAccN > 0) {
                csvAcc[csvAccN] = '\0';
                strncpy(csvRing[csvHead], csvAcc, CSV_LEN - 1);
                csvRing[csvHead][CSV_LEN - 1] = '\0';
                csvHead = (uint8_t)((csvHead + 1) % CSV_LINES);
                if (csvCount < CSV_LINES) csvCount++;
                csvAccN = 0;
            }
        } else if (c != '\r' && csvAccN < CSV_LEN - 1) {
            csvAcc[csvAccN++] = c;
        }
    }
}

void handleObd2()
{
    fetchObd2Status();
    webServer.setContentLength(CONTENT_LENGTH_UNKNOWN);
    webServer.send(200, "text/html", "");
    pageHead("OBD2 poller");
    String b;
    if (!obd2St.ok) {
        b = "<p class='warn'>M2 unreachable.</p>";
    } else {
        b += "<p>Poller: <b>" + String(obd2St.running ? "running" : "stopped") +
             "</b> — CAN" + String(obd2St.bus) + ", interval " +
             String(obd2St.interval) + " ms, " + String(obd2St.nPids) + " PID(s).</p>";
        b += "<form method='POST' action='/obd2_ctl' style='display:inline'>"
             "<button name='start' value='1'>Start</button></form> "
             "<form method='POST' action='/obd2_ctl' style='display:inline'>"
             "<button name='start' value='0'>Stop</button></form>";
        b += "<h2>Configuration</h2>"
             "<form method='POST' action='/obd2_cfg'>"
             "PIDs (hex, comma-separated, max 16): <input name='pids' size='32' "
             "placeholder='0C,0D,05,0F,11,42'><br>"
             "Interval ms (100..60000): <input name='interval' size='8' value='" +
             String(obd2St.interval) + "'><br>"
             "Bus: <select name='bus'>"
             "<option value='0'" + String(obd2St.bus == 0 ? " selected" : "") + ">CAN0</option>"
             "<option value='1'" + String(obd2St.bus == 1 ? " selected" : "") + ">CAN1</option></select><br>"
             "Baud: " + baudSelect("baud", 500000) + "<br>"
             "<p>Reconfiguring stops a running poller (safe).</p>"
             "<button>Apply</button></form>";
        b += "<h2>Live data</h2><pre id='csv'><i>waiting…</i></pre>"
             "<script>setInterval(function(){"
             "fetch('/api/obd2').then(function(r){return r.json();}).then(function(j){"
             "var h='';for(var i=0;i<j.lines.length;i++){h+=j.lines[i]+'<br>';}"
             "document.getElementById('csv').innerHTML=h||'<i>no data yet</i>';});"
             "},1000);</script>"
             "<p>CSV format: <code>ts_ms,mode,pid,value</code> — also streamed "
             "live on TCP:23 and Bluetooth.</p>";
    }
    webServer.sendContent(b);
    pageFoot();
    webServer.sendContent("");
}

void handleObd2Cfg()
{
    if (!requireRole(auth::Role::OPERATOR)) {
        denyPage(auth::Role::OPERATOR);
        return;
    }
    uint8_t pids[16]; uint8_t nPids = 0;
    bool bad = false;
    if (webServer.hasArg("pids")) {
        String s = webServer.arg("pids");
        int st = 0, L = s.length();
        while (st < L && nPids < 16) {
            int en = s.indexOf(',', st);
            if (en < 0) en = L;
            String tok = s.substring(st, en);
            tok.trim();
            // Take the last two hex digits ("010C" -> "0C").
            if (tok.length() > 2) tok = tok.substring(tok.length() - 2);
            char* e; long v = strtol(tok.c_str(), &e, 16);
            if (*e != '\0' || v < 0 || v > 0xFF) { bad = true; break; }
            pids[nPids++] = (uint8_t)v;
            st = en + 1;
        }
    }
    uint16_t interval = webServer.hasArg("interval")
        ? (uint16_t)webServer.arg("interval").toInt() : 1000;
    uint8_t bus = webServer.hasArg("bus") ? (uint8_t)webServer.arg("bus").toInt() : 0;
    uint32_t baud = webServer.hasArg("baud") ? (uint32_t)webServer.arg("baud").toInt() : 500000;
    webServer.setContentLength(CONTENT_LENGTH_UNKNOWN);
    webServer.send(200, "text/html", "");
    pageHead("OBD2 poller");
    String b;
    if (bad || nPids == 0) {
        b = "<p class='warn'>Bad PID list.</p>";
    } else {
        uint8_t req[8 + 16];
        req[0] = bus;
        req[1] = (uint8_t)(baud & 0xFF); req[2] = (uint8_t)((baud >> 8) & 0xFF);
        req[3] = (uint8_t)((baud >> 16) & 0xFF); req[4] = (uint8_t)((baud >> 24) & 0xFF);
        req[5] = (uint8_t)(interval & 0xFF); req[6] = (uint8_t)((interval >> 8) & 0xFF);
        req[7] = nPids;
        for (uint8_t i = 0; i < nPids; i++) req[8 + i] = pids[i];
        uint8_t resp[64]; uint8_t rlen = 0;
        bool ok = mmcTransact(mmc::CMD_OBD2_CFG, req, (uint8_t)(8 + nPids), resp, sizeof(resp), rlen);
        b = (ok && rlen >= 2 && resp[1] == mmc::ST_OK)
            ? "<p>Config applied (" + String(nPids) + " PIDs). Poller stopped — press Start.</p>"
            : "<p class='warn'>Failed (bad args?).</p>";
    }
    b += "<p><a href='/obd2'>Back</a></p>";
    webServer.sendContent(b);
    pageFoot();
    webServer.sendContent("");
}

void handleObd2Ctl()
{
    if (!requireRole(auth::Role::OPERATOR)) {
        denyPage(auth::Role::OPERATOR);
        return;
    }
    uint8_t start = (webServer.hasArg("start") && webServer.arg("start") == "1") ? 1 : 0;
    uint8_t req[1] = { start };
    uint8_t resp[64]; uint8_t rlen = 0;
    bool ok = mmcTransact(mmc::CMD_OBD2_CTL, req, 1, resp, sizeof(resp), rlen);
    webServer.setContentLength(CONTENT_LENGTH_UNKNOWN);
    webServer.send(200, "text/html", "");
    pageHead("OBD2 poller");
    String b;
    if (ok && rlen >= 2 && resp[1] == mmc::ST_OK)
        b = "<p>Poller " + String(resp[2] ? "started" : "stopped") + ".</p>";
    else
        b = "<p class='warn'>Failed — is the M2 in OBD2 mode?</p>";
    b += "<p><a href='/obd2'>Back</a></p>";
    webServer.sendContent(b);
    pageFoot();
    webServer.sendContent("");
}

void handleApiObd2()
{
    fetchObd2Status();
    String j = "{\"running\":";
    j += (obd2St.ok && obd2St.running) ? "true" : "false";
    j += ",\"lines\":[";
    for (uint8_t i = 0; i < csvCount; i++) {
        uint8_t idx = (uint8_t)((csvHead + CSV_LINES - csvCount + i) % CSV_LINES);
        if (i) j += ",";
        j += "\"";
        j += csvRing[idx];  // CSV is digits/hex/commas/dots — no escaping needed
        j += "\"";
    }
    j += "]}";
    webServer.send(200, "application/json", j);
}

// ============ MITM bridge page (Phase 4) ============

// Recent MITMLOG lines sniffed from the Bee link (M2 MITM mode only).
// Format from the M2: MITMLOG,<A2B|B2A>,<id hex>,<ext>,<len>,<data hex>
constexpr uint8_t MITMLOG_LINES = 24;
constexpr uint8_t MITMLOG_LEN = 56;
char mitmLogRing[MITMLOG_LINES][MITMLOG_LEN];
uint8_t mitmLogHead = 0;
uint8_t mitmLogCount = 0;
char mitmLogAcc[MITMLOG_LEN];
uint8_t mitmLogAccN = 0;

void mitmLogFeed(const uint8_t* data, size_t n)
{
    for (size_t i = 0; i < n; i++) {
        char c = (char)data[i];
        if (c == '\n') {
            if (mitmLogAccN > 0) {
                mitmLogAcc[mitmLogAccN] = '\0';
                if (!strncmp(mitmLogAcc, "MITMLOG,", 8)) {
                    strncpy(mitmLogRing[mitmLogHead], mitmLogAcc, MITMLOG_LEN - 1);
                    mitmLogRing[mitmLogHead][MITMLOG_LEN - 1] = '\0';
                    mitmLogHead = (uint8_t)((mitmLogHead + 1) % MITMLOG_LINES);
                    if (mitmLogCount < MITMLOG_LINES) mitmLogCount++;
                }
                mitmLogAccN = 0;
            }
        } else if (c != '\r' && mitmLogAccN < MITMLOG_LEN - 1) {
            mitmLogAcc[mitmLogAccN++] = c;
        }
    }
}

struct MitmRule {
    uint8_t idx = 0;
    uint32_t id = 0, mask = 0;
    uint8_t dir = 2, action = 0, modOff = 0, modMask = 0, modVal = 0;
    uint16_t rateLim = 0;
    uint32_t hits = 0;
};

struct MitmStatus {
    bool ok = false;
    uint32_t fwdAB = 0, fwdBA = 0, dropAB = 0, dropBA = 0;
    uint32_t modAB = 0, modBA = 0, loopSupp = 0, rateDrop = 0;
    uint8_t loadA = 0, loadB = 0, dir = 2, stealth = 1, nRules = 0;
    uint32_t baudA = 500000, baudB = 500000;
    uint16_t loopWin = 5, defRate = 0;
    uint8_t active = 0;
    MitmRule rules[8];
    uint8_t nRulesGot = 0;
};
MitmStatus mitmSt;

static uint32_t le32(const uint8_t* p)
{
    return (uint32_t)p[0] | ((uint32_t)p[1] << 8) |
           ((uint32_t)p[2] << 16) | ((uint32_t)p[3] << 24);
}

bool fetchMitmStats()
{
    uint8_t resp[64]; uint8_t rlen = 0;
    if (!mmcTransact(mmc::CMD_MITM_STATS, nullptr, 0, resp, sizeof(resp), rlen) ||
        rlen < 39 || resp[0] != (mmc::CMD_MITM_STATS | 0x80) ||
        resp[1] != mmc::ST_OK) {
        mitmSt.ok = false;
        return false;
    }
    mitmSt.ok = true;
    mitmSt.fwdAB = le32(resp + 2);  mitmSt.fwdBA = le32(resp + 6);
    mitmSt.dropAB = le32(resp + 10); mitmSt.dropBA = le32(resp + 14);
    mitmSt.modAB = le32(resp + 18); mitmSt.modBA = le32(resp + 22);
    mitmSt.loopSupp = le32(resp + 26); mitmSt.rateDrop = le32(resp + 30);
    mitmSt.loadA = resp[34]; mitmSt.loadB = resp[35];
    mitmSt.dir = resp[36]; mitmSt.stealth = resp[37]; mitmSt.nRules = resp[38];
    // Config readback (prefill the form honestly).
    if (mmcTransact(mmc::CMD_MITM_CFG, nullptr, 0, resp, sizeof(resp), rlen) &&
        rlen >= 17 && resp[0] == (mmc::CMD_MITM_CFG | 0x80) &&
        resp[1] == mmc::ST_OK) {
        mitmSt.baudA = le32(resp + 2); mitmSt.baudB = le32(resp + 6);
        mitmSt.dir = resp[10]; mitmSt.stealth = resp[11];
        mitmSt.loopWin = (uint16_t)resp[12] | ((uint16_t)resp[13] << 8);
        mitmSt.defRate = (uint16_t)resp[14] | ((uint16_t)resp[15] << 8);
        mitmSt.active = resp[16];
    }
    // Rule list (2 per reply).
    mitmSt.nRulesGot = 0;
    for (uint8_t start = 0; start < 8; start += 2) {
        uint8_t req[1] = { start };
        if (!mmcTransact(mmc::CMD_MITM_RULE_LIST, req, 1, resp, sizeof(resp), rlen) ||
            rlen < 4 || resp[0] != (mmc::CMD_MITM_RULE_LIST | 0x80) ||
            resp[1] != mmc::ST_OK)
            break;
        uint8_t nTotal = resp[2], nRet = resp[3];
        if (nRet > 2) nRet = 2;
        for (uint8_t i = 0; i < nRet && mitmSt.nRulesGot < 8; i++) {
            const uint8_t* e = resp + 4 + i * 20;
            MitmRule& r = mitmSt.rules[mitmSt.nRulesGot++];
            r.idx = e[0];
            r.id = le32(e + 1); r.mask = le32(e + 5);
            r.dir = e[9]; r.action = e[10];
            r.modOff = e[11]; r.modMask = e[12]; r.modVal = e[13];
            r.rateLim = (uint16_t)e[14] | ((uint16_t)e[15] << 8);
            r.hits = le32(e + 16);
        }
        if (start + nRet >= nTotal) break;
    }
    return true;
}

const char* mitmDirName(uint8_t d)
{
    return d == 0 ? "a2b" : d == 1 ? "b2a" : "both";
}

const char* mitmActName(uint8_t a)
{
    switch (a) {
        case 0: return "pass";
        case 1: return "drop";
        case 2: return "modify";
        case 3: return "count";
        case 4: return "log";
        default: return "?";
    }
}

void handleMitm()
{
    fetchMitmStats();
    webServer.setContentLength(CONTENT_LENGTH_UNKNOWN);
    webServer.send(200, "text/html", "");
    pageHead("MITM bridge");
    String b;
    if (!mitmSt.ok) {
        b = "<p class='warn'>M2 unreachable.</p>";
    } else {
        b += "<p>Bridge: <b>" + String(mitmSt.active ? "ACTIVE" : "inactive (staged)") +
             "</b> — the bridge runs only when the M2 is in MITM mode; "
             "rules/config can be staged any time.</p>";
        b += "<table><tr><th></th><th>A&rarr;B</th><th>B&rarr;A</th></tr>";
        b += "<tr><td>Forwarded</td><td>" + String(mitmSt.fwdAB) + "</td><td>" +
             String(mitmSt.fwdBA) + "</td></tr>";
        b += "<tr><td>Dropped</td><td>" + String(mitmSt.dropAB) + "</td><td>" +
             String(mitmSt.dropBA) + "</td></tr>";
        b += "<tr><td>Modified</td><td>" + String(mitmSt.modAB) + "</td><td>" +
             String(mitmSt.modBA) + "</td></tr></table>";
        b += "<p>Loop-suppressed: <b>" + String(mitmSt.loopSupp) +
             "</b> &nbsp; Rate-limited: <b>" + String(mitmSt.rateDrop) + "</b></p>";
        b += "<p>Bus load: A <b>" + String(mitmSt.loadA) + "%</b>, B <b>" +
             String(mitmSt.loadB) + "%</b> (estimated)</p>";
        b += "<p>Direction: <b>" + String(mitmDirName(mitmSt.dir)) +
             "</b> &nbsp; Stealth: <b>" + String(mitmSt.stealth ? "on" : "off") +
             "</b> (pure forward; CAN ACK is physical-layer, see docs)</p>";
        b += "<h2>Rules (" + String(mitmSt.nRules) + "/8, first match wins)</h2>";
        b += "<table><tr><th>#</th><th>ID</th><th>Mask</th><th>Dir</th><th>Action</th>"
             "<th>Modify</th><th>Rate/s</th><th>Hits</th><th></th></tr>";
        for (uint8_t i = 0; i < mitmSt.nRulesGot; i++) {
            const MitmRule& r = mitmSt.rules[i];
            char idh[12], mkh[12];
            snprintf(idh, sizeof(idh), "%lX", (unsigned long)r.id);
            snprintf(mkh, sizeof(mkh), "%lX", (unsigned long)r.mask);
            b += "<tr><td>" + String(r.idx) + "</td><td>0x" + String(idh) +
                 "</td><td>0x" + String(mkh) + "</td><td>" +
                 String(mitmDirName(r.dir)) + "</td><td>" +
                 String(mitmActName(r.action)) + "</td><td>";
            if (r.action == 2) {
                char mm[4], mv[4];
                snprintf(mm, sizeof(mm), "%02X", r.modMask);
                snprintf(mv, sizeof(mv), "%02X", r.modVal);
                b += "off " + String(r.modOff) + " mask 0x" + String(mm) +
                     " val 0x" + String(mv);
            } else b += "-";
            b += "</td><td>" + String(r.rateLim ? String(r.rateLim) : "-") +
                 "</td><td>" + String(r.hits) + "</td>";
            b += "<td><form method='POST' action='/mitm_rule_del' style='display:inline'>"
                 "<input type='hidden' name='idx' value='" + String(r.idx) + "'>"
                 "<button>Delete</button></form></td></tr>";
        }
        b += "</table>";
        b += "<form method='POST' action='/mitm_rule_del' style='display:inline'>"
             "<input type='hidden' name='idx' value='255'>"
             "<button>Clear all rules</button></form>";
        b += "<h2>Add rule</h2><form method='POST' action='/mitm_rule_add'>"
             "ID (hex): <input name='id' size='10' placeholder='7E8'><br>"
             "Mask (hex): <input name='mask' size='10' placeholder='7FF'><br>"
             "Direction: <select name='dir'><option value='0'>a2b</option>"
             "<option value='1'>b2a</option><option value='2' selected>both</option></select><br>"
             "Action: <select name='action'><option value='0'>pass</option>"
             "<option value='1'>drop</option><option value='2'>modify</option>"
             "<option value='3'>count</option><option value='4'>log</option></select><br>"
             "Modify params (action=modify): byte offset (0-7) <input name='modoff' size='3' value='0'> "
             "mask <input name='modmask' size='4' value='FF'> value <input name='modval' size='4' value='00'><br>"
             "Rate limit (frames/s, 0=unlimited): <input name='rate' size='6' value='0'><br>"
             "<button>Add rule</button></form>";
        b += "<h2>Bridge config</h2><form method='POST' action='/mitm_cfg'>"
             "Baud A (CAN0): " + baudSelect("bauda", mitmSt.baudA) + "<br>"
             "Baud B (CAN1): " + baudSelect("baudb", mitmSt.baudB) + "<br>"
             "Direction: <select name='dir'>"
             "<option value='0'" + String(mitmSt.dir == 0 ? " selected" : "") + ">a2b</option>"
             "<option value='1'" + String(mitmSt.dir == 1 ? " selected" : "") + ">b2a</option>"
             "<option value='2'" + String(mitmSt.dir == 2 ? " selected" : "") + ">both</option></select><br>"
             "Stealth (pure forward): <select name='stealth'>"
             "<option value='1'" + String(mitmSt.stealth ? " selected" : "") + ">on</option>"
             "<option value='0'" + String(mitmSt.stealth ? "" : " selected") + ">off</option></select><br>"
             "<span class='warn'>Experimental:</span> loop-suppression window ms (0=off): "
             "<input name='loopwin' size='5' value='" + String(mitmSt.loopWin) + "'><br>"
             "<span class='warn'>Experimental:</span> default-rule rate limit/s (0=unlimited): "
             "<input name='defrate' size='6' value='" + String(mitmSt.defRate) + "'><br>"
             "<p>Apply re-inits the bridge buses live when MITM is active, else stages.</p>"
             "<button>Apply</button></form>";
        b += "<h2>Live LOG frames</h2><pre id='mitmlog'><i>waiting…</i></pre>"
             "<script>setInterval(function(){"
             "fetch('/api/mitm').then(function(r){return r.json();}).then(function(j){"
             "var h='fwd '+j.fwdAB+'/'+j.fwdBA+' drop '+j.dropAB+'/'+j.dropBA+"
             "' mod '+j.modAB+'/'+j.modBA+' loop '+j.loop+' rate '+j.rate+"
             "' load '+j.loadA+'%/'+j.loadB+'%<br>';"
             "for(var i=0;i<j.log.length;i++){h+=j.log[i]+'<br>';}"
             "document.getElementById('mitmlog').innerHTML=h||'<i>no data yet</i>';});"
             "},1000);</script>"
             "<p>Only frames matching a rule with action <code>log</code> appear here.</p>";
    }
    webServer.sendContent(b);
    pageFoot();
    webServer.sendContent("");
}

static bool parseHexArg(const char* name, uint32_t max, uint32_t& out)
{
    if (!webServer.hasArg(name)) return false;
    String s = webServer.arg(name);
    s.trim();
    char* e; unsigned long v = strtoul(s.c_str(), &e, 16);
    if (*e != '\0' || v > max) return false;
    out = (uint32_t)v;
    return true;
}

static bool parseDecArg(const char* name, long lo, long hi, long& out)
{
    if (!webServer.hasArg(name)) return false;
    String s = webServer.arg(name);
    s.trim();
    char* e; long v = strtol(s.c_str(), &e, 10);
    if (*e != '\0' || v < lo || v > hi) return false;
    out = v;
    return true;
}

void handleMitmRuleAdd()
{
    if (!requireRole(auth::Role::OPERATOR)) {
        denyPage(auth::Role::OPERATOR);
        return;
    }
    uint32_t id, mask, mm, mv;
    long dir, action, modoff, rate;
    bool bad = !parseHexArg("id", 0x1FFFFFFFUL, id) ||
               !parseHexArg("mask", 0x1FFFFFFFUL, mask) ||
               !parseDecArg("dir", 0, 2, dir) ||
               !parseDecArg("action", 0, 4, action) ||
               !parseHexArg("modmask", 0xFF, mm) ||
               !parseHexArg("modval", 0xFF, mv) ||
               !parseDecArg("modoff", 0, 7, modoff) ||
               !parseDecArg("rate", 0, 60000, rate);
    webServer.setContentLength(CONTENT_LENGTH_UNKNOWN);
    webServer.send(200, "text/html", "");
    pageHead("MITM bridge");
    String b;
    if (bad) {
        b = "<p class='warn'>Bad rule parameters.</p>";
    } else {
        uint8_t req[15];
        req[0] = (uint8_t)(id & 0xFF); req[1] = (uint8_t)((id >> 8) & 0xFF);
        req[2] = (uint8_t)((id >> 16) & 0xFF); req[3] = (uint8_t)((id >> 24) & 0xFF);
        req[4] = (uint8_t)(mask & 0xFF); req[5] = (uint8_t)((mask >> 8) & 0xFF);
        req[6] = (uint8_t)((mask >> 16) & 0xFF); req[7] = (uint8_t)((mask >> 24) & 0xFF);
        req[8] = (uint8_t)dir; req[9] = (uint8_t)action;
        req[10] = (uint8_t)modoff; req[11] = (uint8_t)mm; req[12] = (uint8_t)mv;
        req[13] = (uint8_t)(rate & 0xFF); req[14] = (uint8_t)((rate >> 8) & 0xFF);
        uint8_t resp[64]; uint8_t rlen = 0;
        bool ok = mmcTransact(mmc::CMD_MITM_RULE_ADD, req, 15, resp, sizeof(resp), rlen);
        if (ok && rlen >= 3 && resp[0] == (mmc::CMD_MITM_RULE_ADD | 0x80) &&
            resp[1] == mmc::ST_OK)
            b = "<p>Rule added at index " + String(resp[2]) + ".</p>";
        else if (ok && rlen >= 2)
            b = "<p class='warn'>Rejected (status " + String(resp[1]) +
                " — table full?).</p>";
        else
            b = "<p class='warn'>Failed — M2 did not answer.</p>";
    }
    b += "<p><a href='/mitm'>Back</a></p>";
    webServer.sendContent(b);
    pageFoot();
    webServer.sendContent("");
}

void handleMitmRuleDel()
{
    if (!requireRole(auth::Role::OPERATOR)) {
        denyPage(auth::Role::OPERATOR);
        return;
    }
    long idx = 0;  // F6 (2026-10-08): was uninitialized on parse failure
    bool bad = !parseDecArg("idx", 0, 255, idx);
    uint8_t req[1] = { (uint8_t)idx };
    uint8_t resp[64]; uint8_t rlen = 0;
    webServer.setContentLength(CONTENT_LENGTH_UNKNOWN);
    webServer.send(200, "text/html", "");
    pageHead("MITM bridge");
    String b;
    bool ok = !bad && mmcTransact(mmc::CMD_MITM_RULE_DEL, req, 1, resp, sizeof(resp), rlen);
    if (ok && rlen >= 3 && resp[0] == (mmc::CMD_MITM_RULE_DEL | 0x80) &&
        resp[1] == mmc::ST_OK)
        b = (idx == 255) ? "<p>All rules cleared.</p>"
                         : "<p>Rule deleted (" + String(resp[2]) + " remaining).</p>";
    else
        b = "<p class='warn'>Failed — bad index or M2 did not answer.</p>";
    b += "<p><a href='/mitm'>Back</a></p>";
    webServer.sendContent(b);
    pageFoot();
    webServer.sendContent("");
}

bool validMitmBaud(uint32_t b)
{
    return b == 100000 || b == 125000 || b == 250000 || b == 500000 ||
           b == 800000 || b == 1000000;
}

void handleMitmCfg()
{
    if (!requireRole(auth::Role::OPERATOR)) {
        denyPage(auth::Role::OPERATOR);
        return;
    }
    long lBaudA = 0, lBaudB = 0, dir = 0, stealth = 0, loopWin = 0, defRate = 0;  // F6: init (short-circuit could leave these unset)
    bool bad = !parseDecArg("bauda", 0, 1000000, lBaudA) ||
               !parseDecArg("baudb", 0, 1000000, lBaudB) ||
               !parseDecArg("dir", 0, 2, dir) ||
               !parseDecArg("stealth", 0, 1, stealth) ||
               !parseDecArg("loopwin", 0, 60000, loopWin) ||
               !parseDecArg("defrate", 0, 60000, defRate);
    uint32_t baudA = (uint32_t)lBaudA, baudB = (uint32_t)lBaudB;
    webServer.setContentLength(CONTENT_LENGTH_UNKNOWN);
    webServer.send(200, "text/html", "");
    pageHead("MITM bridge");
    String b;
    if (bad || !validMitmBaud(baudA) || !validMitmBaud(baudB)) {
        b = "<p class='warn'>Bad config parameters.</p>";
    } else {
        uint8_t req[14];
        req[0] = (uint8_t)(baudA & 0xFF); req[1] = (uint8_t)((baudA >> 8) & 0xFF);
        req[2] = (uint8_t)((baudA >> 16) & 0xFF); req[3] = (uint8_t)((baudA >> 24) & 0xFF);
        req[4] = (uint8_t)(baudB & 0xFF); req[5] = (uint8_t)((baudB >> 8) & 0xFF);
        req[6] = (uint8_t)((baudB >> 16) & 0xFF); req[7] = (uint8_t)((baudB >> 24) & 0xFF);
        req[8] = (uint8_t)dir; req[9] = (uint8_t)stealth;
        req[10] = (uint8_t)(loopWin & 0xFF); req[11] = (uint8_t)((loopWin >> 8) & 0xFF);
        req[12] = (uint8_t)(defRate & 0xFF); req[13] = (uint8_t)((defRate >> 8) & 0xFF);
        uint8_t resp[64]; uint8_t rlen = 0;
        bool ok = mmcTransact(mmc::CMD_MITM_CFG, req, 14, resp, sizeof(resp), rlen);
        if (ok && rlen >= 3 && resp[0] == (mmc::CMD_MITM_CFG | 0x80) &&
            resp[1] == mmc::ST_OK)
            b = "<p>Config applied (" +
                String(resp[2] ? "live: buses re-inited" : "staged: takes effect on mode entry") +
                ").</p>";
        else
            b = "<p class='warn'>Failed — M2 did not answer.</p>";
    }
    b += "<p><a href='/mitm'>Back</a></p>";
    webServer.sendContent(b);
    pageFoot();
    webServer.sendContent("");
}

// ---- Phase 10: gateway (CAN0 <-> SWCAN) web UI ----
struct GwMap {
    uint8_t idx = 0, srcBus = 0, srcExt = 0, dstBus = 1, dstExt = 0;
    uint8_t action = 0, modOff = 0, modMask = 0, modVal = 0, dropPolicy = 2;
    uint32_t srcId = 0, srcMask = 0, dstId = 0;
};
struct GwState {
    bool ok = false;
    uint32_t fwdCS = 0, fwdSC = 0, dropCS = 0, dropSC = 0, modCS = 0, modSC = 0;
    uint16_t version = 0;
    uint8_t nMaps = 0, suspended = 0, active = 0;
    uint32_t canBaud = 500000, swcanSpeed = 33333;
    uint8_t dropPolicy = 0, drainPerLoop = 4;
    GwMap maps[8];
    uint8_t nMapsGot = 0;
};
GwState gwSt;

bool fetchGwState()
{
    uint8_t resp[64]; uint8_t rlen = 0;
    if (!mmcTransact(mmc::CMD_GW_STATS, nullptr, 0, resp, sizeof(resp), rlen) ||
        rlen < 31 || resp[0] != (mmc::CMD_GW_STATS | 0x80) ||
        resp[1] != mmc::ST_OK) {
        gwSt.ok = false;
        return false;
    }
    gwSt.ok = true;
    gwSt.fwdCS = le32(resp + 2);  gwSt.fwdSC = le32(resp + 6);
    gwSt.dropCS = le32(resp + 10); gwSt.dropSC = le32(resp + 14);
    gwSt.modCS = le32(resp + 18); gwSt.modSC = le32(resp + 22);
    gwSt.version = (uint16_t)resp[26] | ((uint16_t)resp[27] << 8);
    gwSt.nMaps = resp[28]; gwSt.suspended = resp[29]; gwSt.active = resp[30];
    // Config readback (prefill the form honestly).
    if (mmcTransact(mmc::CMD_GW_CFG, nullptr, 0, resp, sizeof(resp), rlen) &&
        rlen >= 14 && resp[0] == (mmc::CMD_GW_CFG | 0x80) &&
        resp[1] == mmc::ST_OK) {
        gwSt.canBaud = le32(resp + 2); gwSt.swcanSpeed = le32(resp + 6);
        gwSt.dropPolicy = resp[10]; gwSt.drainPerLoop = resp[11];
        gwSt.active = resp[12]; gwSt.suspended = resp[13];
    }
    // Mapping list (1 per reply).
    gwSt.nMapsGot = 0;
    for (uint8_t start = 0; start < 8; start++) {
        uint8_t req[1] = { start };
        if (!mmcTransact(mmc::CMD_GW_MAP_LIST, req, 1, resp, sizeof(resp), rlen) ||
            rlen < 6 || resp[0] != (mmc::CMD_GW_MAP_LIST | 0x80) ||
            resp[1] != mmc::ST_OK)
            break;
        uint8_t nTotal = resp[2], nRet = resp[3];
        if (nRet > 1) nRet = 1;
        for (uint8_t i = 0; i < nRet && gwSt.nMapsGot < 8; i++) {
            const uint8_t* e = resp + 6 + i * 22;
            GwMap& m = gwSt.maps[gwSt.nMapsGot++];
            m.idx = e[0]; m.srcBus = e[1];
            m.srcId = le32(e + 2); m.srcMask = le32(e + 6);
            m.srcExt = e[10]; m.dstBus = e[11];
            m.dstId = le32(e + 12); m.dstExt = e[16];
            m.action = e[17]; m.modOff = e[18]; m.modMask = e[19];
            m.modVal = e[20]; m.dropPolicy = e[21];
        }
        if (start + nRet >= nTotal) break;
    }
    return true;
}

const char* gwBusName(uint8_t b) { return b == 0 ? "can0" : "swcan"; }
const char* gwPolName(uint8_t p)
{
    return p == 0 ? "oldest" : p == 1 ? "newest" : "global";
}

void handleGateway()
{
    fetchGwState();
    webServer.setContentLength(CONTENT_LENGTH_UNKNOWN);
    webServer.send(200, "text/html", "");
    pageHead("Gateway (CAN0 &harr; SWCAN)");
    String b;
    if (!gwSt.ok) {
        b = "<p class='warn'>M2 unreachable.</p>";
    } else {
        b += "<p>Gateway: <b>" + String(gwSt.active ? "ACTIVE" : "inactive (staged)") +
             "</b>";
        if (gwSt.suspended)
            b += " <span class='warn'>SUSPENDED on PROG entry — add a mapping to re-enable.</span>";
        b += "<br>Table version: <b>" + String(gwSt.version) + "</b></p>";
        b += "<table><tr><th></th><th>CAN&rarr;SW</th><th>SW&rarr;CAN</th></tr>"
             "<tr><td>Forwarded</td><td>" + String(gwSt.fwdCS) + "</td><td>" +
             String(gwSt.fwdSC) + "</td></tr>"
             "<tr><td>Dropped (overflow policy)</td><td>" + String(gwSt.dropCS) +
             "</td><td>" + String(gwSt.dropSC) + "</td></tr>"
             "<tr><td>Modified</td><td>" + String(gwSt.modCS) + "</td><td>" +
             String(gwSt.modSC) + "</td></tr></table>";
        b += "<h2>Mappings (" + String(gwSt.nMaps) + "/8, first match wins)</h2>";
        b += "<table><tr><th>#</th><th>Source</th><th>Destination</th><th>Action</th>"
             "<th>Policy</th><th></th></tr>";
        for (uint8_t i = 0; i < gwSt.nMapsGot; i++) {
            const GwMap& m = gwSt.maps[i];
            char sh[12], mh[12], dh[12];
            snprintf(sh, sizeof(sh), "%lX", (unsigned long)m.srcId);
            snprintf(mh, sizeof(mh), "%lX", (unsigned long)m.srcMask);
            snprintf(dh, sizeof(dh), "%lX", (unsigned long)m.dstId);
            b += "<tr><td>" + String(m.idx) + "</td><td>" + gwBusName(m.srcBus) +
                 ":0x" + String(sh);
            if (m.srcMask) b += "/0x" + String(mh);
            if (m.srcExt) b += "/ext";
            b += "</td><td>" + String(gwBusName(m.dstBus)) + ":0x" + String(dh);
            if (m.dstExt) b += "/ext";
            b += "</td><td>";
            if (m.action == 1) {
                char mm[4], mv[4];
                snprintf(mm, sizeof(mm), "%02X", m.modMask);
                snprintf(mv, sizeof(mv), "%02X", m.modVal);
                b += "modify off " + String(m.modOff) + " mask 0x" + String(mm) +
                     " val 0x" + String(mv);
            } else b += "pass";
            b += "</td><td>" + String(gwPolName(m.dropPolicy)) + "</td>";
            b += "<td><form method='POST' action='/gw_map_del' style='display:inline'>"
                 "<input type='hidden' name='idx' value='" + String(m.idx) + "'>"
                 "<button>Delete</button></form></td></tr>";
        }
        b += "</table>";
        b += "<form method='POST' action='/gw_map_del' style='display:inline'>"
             "<input type='hidden' name='idx' value='255'>"
             "<button>Clear all mappings</button></form>";
        b += "<h2>Add mapping</h2><form method='POST' action='/gw_map_add'>"
             "Source bus: <select name='srcbus'><option value='0'>can0</option>"
             "<option value='1'>swcan</option></select> "
             "ID (hex): <input name='srcid' size='10' placeholder='7E8'> "
             "Mask (hex, 0=exact): <input name='srcmask' size='10' value='0'> "
             "Ext: <select name='srcext'><option value='0'>11-bit</option>"
             "<option value='1'>29-bit</option></select><br>"
             "Dest bus: <select name='dstbus'><option value='1'>swcan</option>"
             "<option value='0'>can0</option></select> "
             "ID (hex): <input name='dstid' size='10' placeholder='100'> "
             "Ext: <select name='dstext'><option value='0'>11-bit</option>"
             "<option value='1'>29-bit</option></select><br>"
             "Action: <select name='action'><option value='0'>pass</option>"
             "<option value='1'>modify (payload fabricate — needs arm-confirm)</option></select><br>"
             "Modify params: byte offset (0-7) <input name='modoff' size='3' value='0'> "
             "mask <input name='modmask' size='4' value='FF'> value <input name='modval' size='4' value='00'><br>"
             "Overflow policy: <select name='policy'><option value='2'>global</option>"
             "<option value='0'>drop-oldest</option><option value='1'>drop-newest</option></select><br>"
             "<button>Add mapping</button></form>";
        b += "<h2>Gateway config</h2><form method='POST' action='/gw_cfg'>"
             "CAN0 baud: <input name='canbaud' size='8' value='" + String(gwSt.canBaud) + "'><br>"
             "SWCAN speed: <input name='swcanspeed' size='8' value='" + String(gwSt.swcanSpeed) + "'><br>"
             "Global overflow policy: <select name='policy'>"
             "<option value='0'" + String(gwSt.dropPolicy == 0 ? " selected" : "") + ">drop-oldest</option>"
             "<option value='1'" + String(gwSt.dropPolicy == 1 ? " selected" : "") + ">drop-newest</option></select><br>"
             "TX drain per loop (1-16): <input name='drain' size='4' value='" + String(gwSt.drainPerLoop) + "'><br>"
             "<p>Apply re-inits the gateway buses live when active, else stages.</p>"
             "<button>Apply</button></form>";
    }
    webServer.sendContent(b);
    pageFoot();
    webServer.sendContent("");
}

// Shared: build the 21-byte map payload from form args. Returns false on
// bad args.
bool gwBuildPayload(uint8_t* req)
{
    long srcbus, dstbus, srcext, dstext, action, policy;
    long modoff = 0;
    uint32_t srcid, srcmask, dstid, modmask = 0, modval = 0;
    bool bad = !parseDecArg("srcbus", 0, 1, srcbus) ||
               !parseHexArg("srcid", 0x1FFFFFFFUL, srcid) ||
               !parseHexArg("srcmask", 0x1FFFFFFFUL, srcmask) ||
               !parseDecArg("srcext", 0, 1, srcext) ||
               !parseDecArg("dstbus", 0, 1, dstbus) ||
               !parseHexArg("dstid", 0x1FFFFFFFUL, dstid) ||
               !parseDecArg("dstext", 0, 1, dstext) ||
               !parseDecArg("action", 0, 1, action) ||
               !parseDecArg("policy", 0, 2, policy);
    if (!bad && action == 1) {
        long mo = 0;
        bad = !parseDecArg("modoff", 0, 7, mo);
        modoff = (uint32_t)mo;
        bad = bad || !parseHexArg("modmask", 0xFF, modmask) ||
              !parseHexArg("modval", 0xFF, modval);
    }
    if (bad || srcbus == dstbus) return false;
    req[0] = (uint8_t)srcbus;
    req[1] = (uint8_t)(srcid & 0xFF); req[2] = (uint8_t)((srcid >> 8) & 0xFF);
    req[3] = (uint8_t)((srcid >> 16) & 0xFF); req[4] = (uint8_t)((srcid >> 24) & 0xFF);
    req[5] = (uint8_t)(srcmask & 0xFF); req[6] = (uint8_t)((srcmask >> 8) & 0xFF);
    req[7] = (uint8_t)((srcmask >> 16) & 0xFF); req[8] = (uint8_t)((srcmask >> 24) & 0xFF);
    req[9] = (uint8_t)srcext;
    req[10] = (uint8_t)dstbus;
    req[11] = (uint8_t)(dstid & 0xFF); req[12] = (uint8_t)((dstid >> 8) & 0xFF);
    req[13] = (uint8_t)((dstid >> 16) & 0xFF); req[14] = (uint8_t)((dstid >> 24) & 0xFF);
    req[15] = (uint8_t)dstext;
    req[16] = (uint8_t)action;
    req[17] = (uint8_t)modoff; req[18] = (uint8_t)modmask; req[19] = (uint8_t)modval;
    req[20] = (uint8_t)policy;
    return true;
}

void handleGwMapAdd()
{
    auth::Role need_ = (webServer.hasArg("action") && webServer.arg("action") == "1")
                         ? auth::Role::ADMIN : auth::Role::OPERATOR;
    if (!requireRole(need_)) { denyPage(need_); return; }
    uint8_t req[21];
    webServer.setContentLength(CONTENT_LENGTH_UNKNOWN);
    webServer.send(200, "text/html", "");
    pageHead("Gateway");
    String b;
    if (!gwBuildPayload(req)) {
        b = "<p class='warn'>Bad mapping parameters.</p>";
    } else {
        uint8_t resp[64]; uint8_t rlen = 0;
        bool ok = mmcTransact(mmc::CMD_GW_MAP_ADD, req, 21, resp, sizeof(resp), rlen);
        if (ok && rlen >= 3 && resp[0] == (mmc::CMD_GW_MAP_ADD | 0x80) &&
            resp[1] == mmc::ST_OK && resp[2] == 0xFE) {
            // Arm-confirm staged: render a confirmation page that re-posts
            // the identical fields.
            b = "<p class='warn'>This mapping FABRICATES payload bytes on the destination bus.</p>"
                "<p>Press Confirm within 10 s to install it.</p>"
                "<form method='POST' action='/gw_map_add_confirm'>";
            const char* names[] = {"srcbus","srcid","srcmask","srcext","dstbus",
                                   "dstid","dstext","action","modoff","modmask",
                                   "modval","policy"};
            for (uint8_t i = 0; i < 12; i++)
                b += "<input type='hidden' name='" + String(names[i]) + "' value='" +
                     webServer.arg(names[i]) + "'>";
            b += "<button>Confirm mapping</button></form>";
        } else if (ok && rlen >= 3 && resp[0] == (mmc::CMD_GW_MAP_ADD | 0x80) &&
                   resp[1] == mmc::ST_OK) {
            b = "<p>Mapping added at index " + String(resp[2]) + ".</p>";
        } else if (ok && rlen >= 2) {
            b = "<p class='warn'>Rejected (status " + String(resp[1]) +
                " — table full, bad args, or missing grant/arm).</p>";
        } else {
            b = "<p class='warn'>Failed — M2 did not answer.</p>";
        }
    }
    b += "<p><a href='/gateway'>Back</a></p>";
    webServer.sendContent(b);
    pageFoot();
    webServer.sendContent("");
}

void handleGwMapAddConfirm()
{
    auth::Role need_ = (webServer.hasArg("action") && webServer.arg("action") == "1")
                         ? auth::Role::ADMIN : auth::Role::OPERATOR;
    if (!requireRole(need_)) { denyPage(need_); return; }
    // Re-posts the identical fields, producing the identical 21-byte
    // payload the M2 staged — this is the arm-confirm second factor.
    handleGwMapAdd();
}

void handleGwMapDel()
{
    if (!requireRole(auth::Role::OPERATOR)) {
        denyPage(auth::Role::OPERATOR);
        return;
    }
    long idx = 0;
    bool bad = !parseDecArg("idx", 0, 255, idx);
    uint8_t req[1] = { (uint8_t)idx };
    uint8_t resp[64]; uint8_t rlen = 0;
    webServer.setContentLength(CONTENT_LENGTH_UNKNOWN);
    webServer.send(200, "text/html", "");
    pageHead("Gateway");
    String b;
    bool ok = !bad && mmcTransact(mmc::CMD_GW_MAP_DEL, req, 1, resp, sizeof(resp), rlen);
    if (ok && rlen >= 3 && resp[0] == (mmc::CMD_GW_MAP_DEL | 0x80) &&
        resp[1] == mmc::ST_OK)
        b = (idx == 255) ? "<p>All mappings cleared.</p>"
                         : "<p>Mapping deleted (" + String(resp[2]) + " remaining).</p>";
    else
        b = "<p class='warn'>Failed — bad index or M2 did not answer.</p>";
    b += "<p><a href='/gateway'>Back</a></p>";
    webServer.sendContent(b);
    pageFoot();
    webServer.sendContent("");
}

void handleGwCfg()
{
    if (!requireRole(auth::Role::OPERATOR)) {
        denyPage(auth::Role::OPERATOR);
        return;
    }
    long lCanBaud = 0, lSwSpeed = 0, policy = 0, drain = 0;
    bool bad = !parseDecArg("canbaud", 0, 1000000, lCanBaud) ||
               !parseDecArg("swcanspeed", 0, 100000, lSwSpeed) ||
               !parseDecArg("policy", 0, 1, policy) ||
               !parseDecArg("drain", 1, 16, drain);
    webServer.setContentLength(CONTENT_LENGTH_UNKNOWN);
    webServer.send(200, "text/html", "");
    pageHead("Gateway");
    String b;
    if (bad) {
        b = "<p class='warn'>Bad config parameters.</p>";
    } else {
        uint32_t canBaud = (uint32_t)lCanBaud, swSpeed = (uint32_t)lSwSpeed;
        bool validBaud = (canBaud == 125000 || canBaud == 250000 ||
                          canBaud == 500000 || canBaud == 1000000);
        bool validSw = (swSpeed == 33333 || swSpeed == 50000 ||
                        swSpeed == 83333 || swSpeed == 100000);
        if (!validBaud || !validSw) {
            b = "<p class='warn'>Unsupported baud/speed.</p>";
        } else {
            uint8_t req[10];
            req[0] = (uint8_t)(canBaud & 0xFF); req[1] = (uint8_t)((canBaud >> 8) & 0xFF);
            req[2] = (uint8_t)((canBaud >> 16) & 0xFF); req[3] = (uint8_t)((canBaud >> 24) & 0xFF);
            req[4] = (uint8_t)(swSpeed & 0xFF); req[5] = (uint8_t)((swSpeed >> 8) & 0xFF);
            req[6] = (uint8_t)((swSpeed >> 16) & 0xFF); req[7] = (uint8_t)((swSpeed >> 24) & 0xFF);
            req[8] = (uint8_t)policy; req[9] = (uint8_t)drain;
            uint8_t resp[64]; uint8_t rlen = 0;
            bool ok = mmcTransact(mmc::CMD_GW_CFG, req, 10, resp, sizeof(resp), rlen);
            if (ok && rlen >= 3 && resp[0] == (mmc::CMD_GW_CFG | 0x80) &&
                resp[1] == mmc::ST_OK)
                b = "<p>Config applied (" +
                    String(resp[2] ? "live: buses re-inited" : "staged: takes effect on mode entry") +
                    ").</p>";
            else
                b = "<p class='warn'>Failed — M2 did not answer.</p>";
        }
    }
    b += "<p><a href='/gateway'>Back</a></p>";
    webServer.sendContent(b);
    pageFoot();
    webServer.sendContent("");
}

void handleApiMitm()
{
    fetchMitmStats();
    String j = "{\"ok\":";
    j += mitmSt.ok ? "true" : "false";
    if (mitmSt.ok) {
        j += ",\"fwdAB\":" + String(mitmSt.fwdAB);
        j += ",\"fwdBA\":" + String(mitmSt.fwdBA);
        j += ",\"dropAB\":" + String(mitmSt.dropAB);
        j += ",\"dropBA\":" + String(mitmSt.dropBA);
        j += ",\"modAB\":" + String(mitmSt.modAB);
        j += ",\"modBA\":" + String(mitmSt.modBA);
        j += ",\"loop\":" + String(mitmSt.loopSupp);
        j += ",\"rate\":" + String(mitmSt.rateDrop);
        j += ",\"loadA\":" + String(mitmSt.loadA);
        j += ",\"loadB\":" + String(mitmSt.loadB);
        j += ",\"rules\":[";
        for (uint8_t i = 0; i < mitmSt.nRulesGot; i++) {
            const MitmRule& r = mitmSt.rules[i];
            if (i) j += ",";
            char idh[12], mkh[12];
            snprintf(idh, sizeof(idh), "%lX", (unsigned long)r.id);
            snprintf(mkh, sizeof(mkh), "%lX", (unsigned long)r.mask);
            j += "[" + String(r.idx) + ",\"0x" + String(idh) + "\",\"0x" + String(mkh) +
                 "\",\"" + String(mitmDirName(r.dir)) + "\",\"" +
                 String(mitmActName(r.action)) + "\"," + String(r.hits) + "]";
        }
        j += "],\"log\":[";
        for (uint8_t i = 0; i < mitmLogCount; i++) {
            uint8_t idx = (uint8_t)((mitmLogHead + MITMLOG_LINES - mitmLogCount + i) % MITMLOG_LINES);
            if (i) j += ",";
            j += "\"";
            j += mitmLogRing[idx];  // MITMLOG is ASCII hex/csv — no escaping needed
            j += "\"";
        }
        j += "]";
    }
    j += "}";
    webServer.send(200, "application/json", j);
}

// ---- PROG (programming) mode page ----
// READ docs/SAFETY_REVIEW.md. Web half of the interlocks: per-step confirm
// checkboxes (+ power attestation), arm-before-action via CMD_PROG_ARM,
// streaming chunked upload (CRC16 per chunk, CRC32 end-to-end).
// NOTE: the ESP32 WebServer handles one client at a time, so the upload
// uses XHR with client-side progress events — the server cannot serve
// /api/prog polls mid-upload (single-threaded by library design).

uint16_t progCrc16(const uint8_t* d, uint16_t n)
{
    uint16_t c = 0xFFFF;
    for (uint16_t i = 0; i < n; i++) {
        c ^= (uint16_t)d[i] << 8;
        for (uint8_t b = 0; b < 8; b++)
            c = (c & 0x8000) ? (uint16_t)((c << 1) ^ 0x1021) : (uint16_t)(c << 1);
    }
    return c;
}

uint32_t progCrcTab[256];
bool progCrcTabOk = false;
void progCrcInit()
{
    if (progCrcTabOk) return;
    for (uint32_t i = 0; i < 256; i++) {
        uint32_t c = i;
        for (uint8_t b = 0; b < 8; b++)
            c = (c & 1) ? (0xEDB88320UL ^ (c >> 1)) : (c >> 1);
        progCrcTab[i] = c;
    }
    progCrcTabOk = true;
}
uint32_t progCrc32feed(uint32_t crc, const uint8_t* d, size_t n)
{
    for (size_t i = 0; i < n; i++)
        crc = progCrcTab[(crc ^ d[i]) & 0xFF] ^ (crc >> 8);
    return crc;
}

struct ProgStatus {
    bool ok = false;
    uint8_t state = 0, session = 1, bus = 0;
    uint32_t baud = 500000, txId = 0x7E0, rxId = 0x7E8;
    uint8_t configured = 0, powerOk = 0, armed = 0;
    uint32_t bytesRx = 0;
    uint16_t chunksRx = 0;
    uint32_t txCrc = 0;
    uint8_t mitmSuspended = 0;
};
ProgStatus progSt;

const char* progStateName(uint8_t s)
{
    switch (s) {
        case 0: return "IDLE";
        case 1: return "SESSION";
        case 2: return "UNLOCKED";
        case 3: return "ERASED";
        case 4: return "DOWNLOADING";
        case 5: return "STREAM_DONE";
        case 6: return "DONE";
        case 7: return "ABORTED";
        case 8: return "ERROR";
        default: return "?";
    }
}

bool fetchProgStatus()
{
    uint8_t resp[64]; uint8_t rlen = 0;
    if (!mmcTransact(mmc::CMD_PROG_STATUS, nullptr, 0, resp, sizeof(resp), rlen) ||
        rlen < 31 || resp[0] != (mmc::CMD_PROG_STATUS | 0x80) ||
        resp[1] != mmc::ST_OK) {
        progSt.ok = false;
        return false;
    }
    progSt.ok = true;
    progSt.state = resp[2]; progSt.session = resp[3]; progSt.bus = resp[4];
    progSt.baud = (uint32_t)resp[5] | ((uint32_t)resp[6] << 8) |
                  ((uint32_t)resp[7] << 16) | ((uint32_t)resp[8] << 24);
    progSt.txId = (uint32_t)resp[9] | ((uint32_t)resp[10] << 8) |
                  ((uint32_t)resp[11] << 16) | ((uint32_t)resp[12] << 24);
    progSt.rxId = (uint32_t)resp[13] | ((uint32_t)resp[14] << 8) |
                  ((uint32_t)resp[15] << 16) | ((uint32_t)resp[16] << 24);
    progSt.configured = resp[17]; progSt.powerOk = resp[18]; progSt.armed = resp[19];
    progSt.bytesRx = (uint32_t)resp[20] | ((uint32_t)resp[21] << 8) |
                     ((uint32_t)resp[22] << 16) | ((uint32_t)resp[23] << 24);
    progSt.chunksRx = (uint16_t)resp[24] | ((uint16_t)resp[25] << 8);
    progSt.txCrc = (uint32_t)resp[26] | ((uint32_t)resp[27] << 8) |
                   ((uint32_t)resp[28] << 16) | ((uint32_t)resp[29] << 24);
    progSt.mitmSuspended = resp[30];
    return true;
}

// ---- upload streaming state ----
struct ProgUpload {
    bool active = false;
    bool error = false;
    bool done = false;
    String errorMsg;
    uint32_t bytes = 0;
    uint32_t total = 0;   // Content-Length when the client sent one
    uint16_t chunks = 0;
    uint16_t seq = 0;
    uint32_t crc32 = 0xFFFFFFFFUL;
    uint8_t acc[41];
    uint8_t accN = 0;
};
ProgUpload progUp;

bool progSendChunk(const uint8_t* data, uint8_t len, bool last)
{
    uint8_t req[6 + 41];
    req[0] = (uint8_t)(progUp.seq & 0xFF);
    req[1] = (uint8_t)((progUp.seq >> 8) & 0xFF);
    req[2] = last ? 1 : 0;
    req[3] = len;
    for (uint8_t i = 0; i < len; i++) req[4 + i] = data[i];
    uint16_t c = progCrc16(data, len);
    req[4 + len] = (uint8_t)(c & 0xFF);
    req[5 + len] = (uint8_t)((c >> 8) & 0xFF);
    uint8_t resp[64]; uint8_t rlen = 0;
    // The M2 turns each chunk into one 0x36 with a long ECU timeout.
    bool ok = mmcTransact(mmc::CMD_PROG_DATA, req, (uint8_t)(6 + len),
                          resp, sizeof(resp), rlen, 8000);
    if (!ok || rlen < 4 || resp[0] != (mmc::CMD_PROG_DATA | 0x80) ||
        resp[1] != mmc::ST_OK)
        return false;
    uint16_t ack = (uint16_t)resp[2] | ((uint16_t)resp[3] << 8);
    if (ack != progUp.seq) return false;
    progUp.seq++;
    progUp.chunks++;
    return true;
}

void handleProgUploadData()
{
    HTTPUpload& up = webServer.upload();
    if (up.status == UPLOAD_FILE_START) {
        // Phase 11: refuse the stream itself when not admin
        // (the M2's arm state is the backstop, not the gate).
        if (!requireRole(auth::Role::ADMIN)) {
            progUp.active = false; progUp.error = true; progUp.done = false;
            progUp.errorMsg = "login required (admin)";
            return;
        }
        progUp.active = true; progUp.error = false; progUp.done = false;
        progUp.errorMsg = "";
        progUp.bytes = 0; progUp.chunks = 0; progUp.seq = 0;
        progUp.crc32 = 0xFFFFFFFFUL; progUp.accN = 0;
        progUp.total = up.totalSize;
        progCrcInit();
    } else if (up.status == UPLOAD_FILE_WRITE) {
        if (progUp.error) return;
        pwr::markActivity();  // Phase 11: an in-progress upload is activity
        progUp.crc32 = progCrc32feed(progUp.crc32, up.buf, up.currentSize);
        for (size_t i = 0; i < up.currentSize; i++) {
            progUp.acc[progUp.accN++] = up.buf[i];
            progUp.bytes++;
            if (progUp.accN == 41) {
                if (!progSendChunk(progUp.acc, 41, false)) {
                    progUp.error = true;
                    progUp.errorMsg =
                        "chunk rejected by M2 (state/sequence/CRC) — transfer aborted";
                    return;
                }
                progUp.accN = 0;
            }
        }
    } else if (up.status == UPLOAD_FILE_END) {
        if (!progUp.error) {
            // Final partial chunk — or a zero-length LAST if the file
            // ended exactly on a chunk boundary (the M2 treats an empty
            // LAST chunk as end-of-stream with no 0x36).
            if (!progSendChunk(progUp.acc, progUp.accN, true)) {
                progUp.error = true;
                progUp.errorMsg = "final chunk rejected by M2";
            }
        }
        progUp.active = false;
        progUp.done = !progUp.error;
    }
}

void handleProgUpload()
{
    if (!requireRole(auth::Role::ADMIN)) {
        denyPage(auth::Role::ADMIN);
        return;
    }
    // Runs after the upload finished (or failed to start).
    char ch[9];
    snprintf(ch, sizeof(ch), "%08lX",
             (unsigned long)(progUp.crc32 ^ 0xFFFFFFFFUL));
    String j = "{\"ok\":";
    j += (!progUp.error && progUp.done) ? "true" : "false";
    j += ",\"bytes\":" + String(progUp.bytes);
    j += ",\"chunks\":" + String(progUp.chunks);
    j += ",\"crc32\":\"" + String(ch) + "\"";
    j += ",\"error\":\"" + progUp.errorMsg + "\"}";
    webServer.send(200, "application/json", j);
}

// Arm destructive PROG steps from a web checkbox. power=true also records
// the stable-12V+ attestation (a human promise, NOT a measurement).
bool progArmWeb(bool power, String& why)
{
    uint8_t req[1] = { (uint8_t)(power ? 1 : 0) };
    uint8_t resp[64]; uint8_t rlen = 0;
    bool ok = mmcTransact(mmc::CMD_PROG_ARM, req, 1, resp, sizeof(resp), rlen);
    if (!ok || rlen < 3 || resp[1] != mmc::ST_OK || resp[2] == 0) {
        why = "M2 refused to arm (is PROG mode active?)";
        return false;
    }
    return true;
}

// Send one raw PROG service; human-readable result in out. The caller must
// have armed first for destructive services (web checkbox -> progArmWeb).
bool progSendRaw(uint8_t svc, const uint8_t* params, uint8_t nParams,
                 String& out, uint16_t timeoutMs = 2000)
{
    // F2 (2026-10-08): req is 34B; reject oversized params instead of
    // overflowing the stack (handleProgKey could pass up to 65B).
    if (nParams > 32) {
        out = "<span class='warn'>Params too long (max 32).</span>";
        return false;
    }
    uint8_t req[1 + 1 + 32];
    req[0] = (uint8_t)(1 + nParams);
    req[1] = svc;
    for (uint8_t i = 0; i < nParams; i++) req[2 + i] = params[i];
    uint8_t resp[64]; uint8_t rlen = 0;
    bool ok = mmcTransact(mmc::CMD_PROG_TX, req, (uint8_t)(1 + nParams),
                          resp, sizeof(resp), rlen, timeoutMs);
    if (!ok) { out = "<span class='warn'>M2 did not answer.</span>"; return false; }
    if (rlen < 2 || resp[1] != mmc::ST_OK) {
        out = "<span class='warn'>Rejected: switch the M2 to PROG mode first.</span>";
        return false;
    }
    uint8_t nResp = (rlen > 2) ? resp[2] : 0;
    uint8_t dlen = (rlen > 3) ? resp[3] : 0;
    out = "TX: " + hexStr(&svc, 1);
    if (nParams) out += " " + hexStr(params, nParams);
    out += "<br>";
    if (nResp == 0) {
        out += "NO DATA (no ECU answered)";
        return true;
    }
    out += "RX: " + hexStr(resp + 4, dlen);
    if (dlen >= 3 && resp[4] == 0x7F && resp[5] == svc) {
        uint8_t nrc = resp[6];
        out += "<br><span class='warn'>Negative response: " + String(nrcText(nrc)) +
               " (NRC 0x" + String(nrc, HEX) + ")</span>";
    } else if (dlen >= 1 && resp[4] == (uint8_t)(svc + 0x40)) {
        out += "<br>Positive response.";
    }
    return true;
}

void progResultPage(const char* title, const String& body)
{
    webServer.setContentLength(CONTENT_LENGTH_UNKNOWN);
    webServer.send(200, "text/html", "");
    pageHead(title);
    webServer.sendContent(body);
    webServer.sendContent("<p><a href='/prog'>Back to PROG</a></p>");
    pageFoot();
    webServer.sendContent("");
}

void handleProg()
{
    fetchProgStatus();
    fetchM2Status();
    webServer.setContentLength(CONTENT_LENGTH_UNKNOWN);
    webServer.send(200, "text/html", "");
    pageHead("PROG — ECU flashing");
    String b;
    // Safety summary: impossible to miss, on the page itself (not buried).
    b += "<div style='border:2px solid #a00;padding:.6em;background:#fee'>"
         "<b>READ BEFORE FLASHING</b> (full case: docs/SAFETY_REVIEW.md)<br>"
         "&bull; A wrong image, wrong address, power loss, or bus disruption can "
         "<b>brick the ECU</b>. First flash against a spare/bench ECU.<br>"
         "&bull; Entering PROG auto-suspends the MITM rule table (a bridge that "
         "rewrites flash bytes is a brick vector). Rules are <b>not</b> restored "
         "on exit — re-add them deliberately.<br>"
         "&bull; Every destructive step needs its confirm checkbox. Erase/download "
         "also need the <b>stable 12V+ attestation</b> — a human promise, "
         "<b>not</b> a measurement (ATRV is uncalibrated).<br>"
         "&bull; Seed/key is a stub: <b>no key algorithm exists here</b> — you "
         "supply the key from your own tooling.<br>"
         "&bull; Power loss mid-flash is <b>unrecoverable by firmware</b>.</div>";
    if (!progSt.ok) {
        b += "<p class='warn'>M2 unreachable.</p>";
    } else {
        if (!m2status.ok || m2status.mode != 6)
            b += "<p class='warn'>M2 is not in PROG mode (currently " +
                 String(m2status.ok ? modeName(m2status.mode) : "?") +
                 "). Switch mode first; bus commands below will be refused.</p>";
        char ch[9];
        snprintf(ch, sizeof(ch), "%08lX", (unsigned long)progSt.txCrc);
        b += "<table><tr><th>Item</th><th>Value</th></tr>";
        b += "<tr><td>State</td><td><b>" + String(progStateName(progSt.state)) +
             "</b></td></tr>";
        b += "<tr><td>Session</td><td>0x" + String(progSt.session, HEX) + "</td></tr>";
        b += "<tr><td>Bus</td><td>CAN" + String(progSt.bus) + " @ " +
             String(progSt.baud) + "</td></tr>";
        b += "<tr><td>TX/RX IDs</td><td>0x" + String(progSt.txId, HEX) +
             " / 0x" + String(progSt.rxId, HEX) + "</td></tr>";
        b += "<tr><td>Addressing configured</td><td>" +
             String(progSt.configured ? "yes" : "<span class='warn'>NO</span>") +
             "</td></tr>";
        b += "<tr><td>Armed</td><td>" + String(progSt.armed ? "yes" : "no") +
             "</td></tr>";
        b += "<tr><td>Power attested</td><td>" +
             String(progSt.powerOk ? "yes" : "<span class='warn'>NO</span>") +
             "</td></tr>";
        b += "<tr><td>Bytes / chunks sent</td><td>" + String(progSt.bytesRx) +
             " / " + String(progSt.chunksRx) + "</td></tr>";
        b += "<tr><td>TX CRC32</td><td>0x" + String(ch) + "</td></tr>";
        b += "<tr><td>MITM rules suspended on entry</td><td>" +
             String(progSt.mitmSuspended) + "</td></tr></table>";

        b += "<h2>1. Addressing / bus</h2>"
             "<form method='POST' action='/prog_cfg'>"
             "Bus: <select name='bus'>"
             "<option value='0'" + String(progSt.bus == 0 ? " selected" : "") + ">CAN0</option>"
             "<option value='1'" + String(progSt.bus == 1 ? " selected" : "") + ">CAN1</option></select><br>"
             "Baud: " + baudSelect("baud", progSt.baud) + "<br>"
             "TX ID (hex): <input name='txid' size='8' value='" + String(progSt.txId, HEX) + "'><br>"
             "RX ID (hex): <input name='rxid' size='8' value='" + String(progSt.rxId, HEX) + "'><br>"
             "<button>Apply</button></form>";

        b += "<h2>2. Session + security</h2>"
             "<form method='POST' action='/prog_session' style='display:inline'>"
             "<button>0x10 programming session</button></form> "
             "<form method='POST' action='/prog_seed' style='display:inline'>"
             "Level (hex): <input name='level' size='4' value='01'> "
             "<button>0x27 request seed</button></form><br>"
             "<form method='POST' action='/prog_key'>"
             "Level (hex): <input name='level' size='4' value='01'> "
             "Key (hex bytes): <input name='key' size='32' placeholder='A1 B2 ...'><br>"
             "<label><input type='checkbox' name='confirm' value='1'> I confirm "
             "(stub: key is transported, never computed)</label><br>"
             "<button>0x27 send key</button></form>";

        b += "<h2>3. Erase (optional)</h2>"
             "<form method='POST' action='/prog_erase'>"
             "Routine ID (hex): <input name='rid' size='8' placeholder='FF00'><br>"
             "<label><input type='checkbox' name='confirm' value='1'> I confirm</label><br>"
             "<label><input type='checkbox' name='power' value='1'> Stable 12V+ "
             "supply confirmed (attestation, not a measurement)</label><br>"
             "<button>0x31 start erase routine</button></form>";

        b += "<h2>4. Download + upload</h2>"
             "<form method='POST' action='/prog_dl'>"
             "Address (hex): <input name='addr' size='10' placeholder='08000000'><br>"
             "Length (hex): <input name='len' size='10' placeholder='8000'><br>"
             "ALFID (hex, default 44): <input name='alfid' size='4' value='44'><br>"
             "<label><input type='checkbox' name='confirm' value='1'> I confirm</label><br>"
             "<label><input type='checkbox' name='power' value='1'> Stable 12V+ "
             "supply confirmed (attestation, not a measurement)</label><br>"
             "<button>0x34 start download</button></form>"
             "<h3>Image upload</h3>"
             "<p>Streams the file in 41-byte chunks (CRC16 per chunk); each chunk "
             "becomes one 0x36 TransferData immediately — the M2 holds no image "
             "buffer. Run step 4 first.</p>"
             "<form id='upform'>"
             "<input type='file' name='firmware' id='upfile'> "
             "<button type='submit'>Upload</button></form>"
             "<progress id='upbar' value='0' max='100' style='width:100%'></progress>"
             "<div id='upmsg'></div>"
             "<script>"
             "document.getElementById('upform').addEventListener('submit',function(e){"
             "e.preventDefault();"
             "var f=document.getElementById('upfile').files[0];if(!f)return;"
             "var x=new XMLHttpRequest();"
             "x.upload.onprogress=function(e){"
             "if(e.lengthComputable)document.getElementById('upbar').value=(e.loaded*100/e.total);};"
             "x.onload=function(){"
             "var j=null;try{j=JSON.parse(x.responseText);}catch(err){}"
             "var m=document.getElementById('upmsg');"
             "if(j&&j.ok){"
             "m.innerHTML='Uploaded '+j.bytes+' bytes in '+j.chunks+' chunks. File CRC32: <b>'+j.crc32+'</b>';"
             "document.getElementById('donecrc').value=j.crc32;"
             "}else{"
             "m.innerHTML='<span class=\"warn\">Upload failed: '+(j?j.error:'bad response')+'</span>';}"
             "document.getElementById('upbar').value=0;};"
             "x.onerror=function(){"
             "document.getElementById('upmsg').innerHTML='<span class=\"warn\">Upload request failed.</span>';};"
             "var fd=new FormData();fd.append('firmware',f);"
             "x.open('POST','/prog_upload');x.send(fd);});"
             "</script>";

        b += "<h2>5. Finalize</h2>"
             "<form method='POST' action='/prog_done'>"
             "File CRC32 (hex, prefilled from upload): "
             "<input name='crc32' id='donecrc' size='10'><br>"
             "<label><input type='checkbox' name='confirm' value='1'> I confirm — "
             "compare CRCs and send 0x37</label><br>"
             "<button>Finalize transfer</button></form>";

        b += "<h2>6. Verify (optional, INFERRED)</h2>"
             "<form method='POST' action='/prog_verify'>"
             "Address (hex): <input name='addr' size='10'><br>"
             "Length (hex): <input name='len' size='10'><br>"
             "ALFID (hex, default 44): <input name='alfid' size='4' value='44'><br>"
             "<button>0x23 read-back CRC compare</button></form>"
             "<p>Not all ECUs support 0x23 in programming session — absence is "
             "reported, not papered over.</p>";

        b += "<h2>7. Reset / abort</h2>"
             "<form method='POST' action='/prog_reset' style='display:inline'>"
             "<label><input type='checkbox' name='confirm' value='1'> I confirm</label> "
             "<button>0x11 reset ECU</button></form> "
             "<form method='POST' action='/prog_abort' style='display:inline'>"
             "<button style='border:2px solid #a00;font-weight:bold'>ABORT</button></form>"
             "<p>Abort sends best-effort 0x37, clears transfer state, and disarms. "
             "It never needs a checkbox.</p>";
    }
    webServer.sendContent(b);
    pageFoot();
    webServer.sendContent("");
}

void handleProgCfg()
{
    if (!requireRole(auth::Role::ADMIN)) {
        denyPage(auth::Role::ADMIN);
        return;
    }
    uint8_t req[14];
    req[0] = webServer.hasArg("bus") ? (uint8_t)webServer.arg("bus").toInt() : 0;
    uint32_t baud = webServer.hasArg("baud") ? (uint32_t)webServer.arg("baud").toInt() : 500000;
    req[1] = (uint8_t)(baud & 0xFF); req[2] = (uint8_t)((baud >> 8) & 0xFF);
    req[3] = (uint8_t)((baud >> 16) & 0xFF); req[4] = (uint8_t)((baud >> 24) & 0xFF);
    uint32_t txId = 0x7E0, rxId = 0x7E8;
    if (webServer.hasArg("txid")) txId = (uint32_t)strtoul(webServer.arg("txid").c_str(), nullptr, 16);
    if (webServer.hasArg("rxid")) rxId = (uint32_t)strtoul(webServer.arg("rxid").c_str(), nullptr, 16);
    req[5] = (uint8_t)(txId & 0xFF); req[6] = (uint8_t)((txId >> 8) & 0xFF);
    req[7] = (uint8_t)((txId >> 16) & 0xFF); req[8] = (uint8_t)((txId >> 24) & 0xFF);
    req[9] = (uint8_t)(rxId & 0xFF); req[10] = (uint8_t)((rxId >> 8) & 0xFF);
    req[11] = (uint8_t)((rxId >> 16) & 0xFF); req[12] = (uint8_t)((rxId >> 24) & 0xFF);
    req[13] = 0;
    uint8_t resp[64]; uint8_t rlen = 0;
    bool ok = mmcTransact(mmc::CMD_PROG_CFG, req, 14, resp, sizeof(resp), rlen);
    progResultPage("PROG",
        (ok && rlen >= 2 && resp[1] == mmc::ST_OK)
            ? "<p>Addressing applied (explicit selection recorded).</p>"
            : "<p class='warn'>Failed (bad args?).</p>");
}

void handleProgSession()
{
    if (!requireRole(auth::Role::ADMIN)) {
        denyPage(auth::Role::ADMIN);
        return;
    }
    String out;
    uint8_t p[1] = { 0x02 };
    progSendRaw(0x10, p, 1, out);
    progResultPage("PROG", "<p>" + out + "</p>");
}

void handleProgSeed()
{
    if (!requireRole(auth::Role::ADMIN)) {
        denyPage(auth::Role::ADMIN);
        return;
    }
    String out;
    uint8_t lvl = 1;
    if (webServer.hasArg("level"))
        lvl = (uint8_t)strtoul(webServer.arg("level").c_str(), nullptr, 16);
    uint8_t p[1] = { lvl };
    progSendRaw(0x27, p, 1, out);
    out += "<br>Compute the key with your own tooling — no algorithm exists here.";
    progResultPage("PROG", "<p>" + out + "</p>");
}

void handleProgKey()
{
    if (!requireRole(auth::Role::ADMIN)) {
        denyPage(auth::Role::ADMIN);
        return;
    }
    String why;
    bool confirmed = webServer.hasArg("confirm");
    if (!confirmed) {
        progResultPage("PROG",
            "<p class='warn'>Refused: the confirm checkbox is required.</p>");
        return;
    }
    if (!progArmWeb(false, why)) {
        progResultPage("PROG", "<p class='warn'>" + why + "</p>");
        return;
    }
    uint8_t lvl = 1;
    if (webServer.hasArg("level"))
        lvl = (uint8_t)strtoul(webServer.arg("level").c_str(), nullptr, 16);
    uint8_t key[64]; int n = 0;
    if (webServer.hasArg("key"))
        n = hexToBytes(webServer.arg("key"), key, sizeof(key));
    String out;
    if (n <= 0) {
        out = "<span class='warn'>Bad key hex.</span>";
    } else {
        uint8_t p[1 + 64];
        p[0] = (uint8_t)(lvl + 1);
        for (int i = 0; i < n; i++) p[1 + i] = key[i];
        progSendRaw(0x27, p, (uint8_t)(1 + n), out);
    }
    progResultPage("PROG", "<p>" + out + "</p>");
}

void handleProgErase()
{
    if (!requireRole(auth::Role::ADMIN)) {
        denyPage(auth::Role::ADMIN);
        return;
    }
    String why;
    bool confirmed = webServer.hasArg("confirm");
    bool power = webServer.hasArg("power");
    if (!confirmed || !power) {
        progResultPage("PROG",
            "<p class='warn'>Refused: confirm + stable-12V+ attestation required.</p>");
        return;
    }
    if (!progArmWeb(true, why)) {
        progResultPage("PROG", "<p class='warn'>" + why + "</p>");
        return;
    }
    uint32_t rid = webServer.hasArg("rid")
        ? (uint32_t)strtoul(webServer.arg("rid").c_str(), nullptr, 16) : 0x10000;
    String out;
    if (rid > 0xFFFF) {
        out = "<span class='warn'>Bad routine ID.</span>";
    } else {
        uint8_t p[3] = { 0x01, (uint8_t)(rid >> 8), (uint8_t)(rid & 0xFF) };
        progSendRaw(0x31, p, 3, out, 35000);  // erase can take seconds
    }
    progResultPage("PROG", "<p>" + out + "</p>");
}

void handleProgDl()
{
    if (!requireRole(auth::Role::ADMIN)) {
        denyPage(auth::Role::ADMIN);
        return;
    }
    String why;
    bool confirmed = webServer.hasArg("confirm");
    bool power = webServer.hasArg("power");
    if (!confirmed || !power) {
        progResultPage("PROG",
            "<p class='warn'>Refused: confirm + stable-12V+ attestation required.</p>");
        return;
    }
    if (!progArmWeb(true, why)) {
        progResultPage("PROG", "<p class='warn'>" + why + "</p>");
        return;
    }
    uint32_t addr = webServer.hasArg("addr")
        ? (uint32_t)strtoul(webServer.arg("addr").c_str(), nullptr, 16) : 0;
    uint32_t len = webServer.hasArg("len")
        ? (uint32_t)strtoul(webServer.arg("len").c_str(), nullptr, 16) : 0;
    uint8_t alfid = webServer.hasArg("alfid")
        ? (uint8_t)strtoul(webServer.arg("alfid").c_str(), nullptr, 16) : 0x44;
    String out;
    if (len == 0) {
        out = "<span class='warn'>Bad address/length.</span>";
    } else {
        uint8_t req[9];
        req[0] = (uint8_t)(addr & 0xFF); req[1] = (uint8_t)((addr >> 8) & 0xFF);
        req[2] = (uint8_t)((addr >> 16) & 0xFF); req[3] = (uint8_t)((addr >> 24) & 0xFF);
        req[4] = (uint8_t)(len & 0xFF); req[5] = (uint8_t)((len >> 8) & 0xFF);
        req[6] = (uint8_t)((len >> 16) & 0xFF); req[7] = (uint8_t)((len >> 24) & 0xFF);
        req[8] = alfid;
        uint8_t resp[64]; uint8_t rlen = 0;
        bool ok = mmcTransact(mmc::CMD_PROG_DL, req, 9, resp, sizeof(resp), rlen, 3000);
        if (ok && rlen >= 2 && resp[1] == mmc::ST_OK)
            out = "Download opened (0x34 positive). Upload the image now — "
                  "each chunk becomes one 0x36 TransferData.";
        else
            out = "<span class='warn'>0x34 refused (check armed/configured/power, "
                  "ECU state, and NRC).</span>";
    }
    progResultPage("PROG", "<p>" + out + "</p>");
}

void handleProgDone()
{
    if (!requireRole(auth::Role::ADMIN)) {
        denyPage(auth::Role::ADMIN);
        return;
    }
    String why;
    bool confirmed = webServer.hasArg("confirm");
    if (!confirmed) {
        progResultPage("PROG",
            "<p class='warn'>Refused: the confirm checkbox is required.</p>");
        return;
    }
    if (!progArmWeb(false, why)) {
        progResultPage("PROG", "<p class='warn'>" + why + "</p>");
        return;
    }
    uint32_t fcrc = webServer.hasArg("crc32")
        ? (uint32_t)strtoul(webServer.arg("crc32").c_str(), nullptr, 16) : 0xFFFFFFFFUL;
    uint8_t req[4];
    req[0] = (uint8_t)(fcrc & 0xFF); req[1] = (uint8_t)((fcrc >> 8) & 0xFF);
    req[2] = (uint8_t)((fcrc >> 16) & 0xFF); req[3] = (uint8_t)((fcrc >> 24) & 0xFF);
    uint8_t resp[64]; uint8_t rlen = 0;
    bool ok = mmcTransact(mmc::CMD_PROG_DONE, req, 4, resp, sizeof(resp), rlen, 3000);
    String out;
    if (ok && rlen >= 7 && resp[1] == mmc::ST_OK && resp[2]) {
        char ch[9];
        snprintf(ch, sizeof(ch), "%08lX",
                 (unsigned long)((uint32_t)resp[3] | ((uint32_t)resp[4] << 8) |
                                 ((uint32_t)resp[5] << 16) | ((uint32_t)resp[6] << 24)));
        out = "Transfer <b>complete and verified</b> (CRC32 0x" + String(ch) +
              "). 0x37 sent. Disarmed.";
    } else {
        out = "<span class='warn'>Finalize FAILED — CRC mismatch or 0x37 "
              "refused. The transfer was aborted. Do NOT trust this flash.</span>";
    }
    progResultPage("PROG", "<p>" + out + "</p>");
}

void handleProgVerify()
{
    if (!requireRole(auth::Role::ADMIN)) {
        denyPage(auth::Role::ADMIN);
        return;
    }
    uint32_t addr = webServer.hasArg("addr")
        ? (uint32_t)strtoul(webServer.arg("addr").c_str(), nullptr, 16) : 0;
    uint32_t len = webServer.hasArg("len")
        ? (uint32_t)strtoul(webServer.arg("len").c_str(), nullptr, 16) : 0;
    uint8_t alfid = webServer.hasArg("alfid")
        ? (uint8_t)strtoul(webServer.arg("alfid").c_str(), nullptr, 16) : 0x44;
    String out;
    if (len == 0) {
        out = "<span class='warn'>Bad address/length.</span>";
    } else {
        uint8_t req[9];
        req[0] = (uint8_t)(addr & 0xFF); req[1] = (uint8_t)((addr >> 8) & 0xFF);
        req[2] = (uint8_t)((addr >> 16) & 0xFF); req[3] = (uint8_t)((addr >> 24) & 0xFF);
        req[4] = (uint8_t)(len & 0xFF); req[5] = (uint8_t)((len >> 8) & 0xFF);
        req[6] = (uint8_t)((len >> 16) & 0xFF); req[7] = (uint8_t)((len >> 24) & 0xFF);
        req[8] = alfid;
        // Reads are 128 B each on the M2 side; allow ~2.5 s per read.
        uint16_t tmo = (uint16_t)(5000 + (len / 128) * 2500);
        if (tmo > 60000) tmo = 60000;
        uint8_t resp[64]; uint8_t rlen = 0;
        bool ok = mmcTransact(mmc::CMD_PROG_VERIFY, req, 9, resp, sizeof(resp), rlen, tmo);
        if (ok && rlen >= 7 && resp[1] == mmc::ST_OK) {
            char ch[9];
            snprintf(ch, sizeof(ch), "%08lX",
                     (unsigned long)((uint32_t)resp[3] | ((uint32_t)resp[4] << 8) |
                                     ((uint32_t)resp[5] << 16) | ((uint32_t)resp[6] << 24)));
            out = resp[2]
                ? "VERIFY: <b>MATCH</b> — ECU content equals the transmitted image "
                  "(read-back CRC32 0x" + String(ch) + ")."
                : "<span class='warn'>VERIFY: MISMATCH (read-back CRC32 0x" +
                  String(ch) + ") — do NOT trust this flash.</span>";
        } else {
            out = "<span class='warn'>Verify failed: ECU may not support 0x23 "
                  "in programming session (INFERRED availability).</span>";
        }
    }
    progResultPage("PROG", "<p>" + out + "</p>");
}

void handleProgReset()
{
    if (!requireRole(auth::Role::ADMIN)) {
        denyPage(auth::Role::ADMIN);
        return;
    }
    String why;
    if (!webServer.hasArg("confirm")) {
        progResultPage("PROG",
            "<p class='warn'>Refused: the confirm checkbox is required.</p>");
        return;
    }
    if (!progArmWeb(false, why)) {
        progResultPage("PROG", "<p class='warn'>" + why + "</p>");
        return;
    }
    String out;
    uint8_t p[1] = { 0x01 };
    progSendRaw(0x11, p, 1, out);
    progResultPage("PROG", "<p>" + out + "</p>");
}

void handleProgAbort()
{
    if (!requireRole(auth::Role::ADMIN)) {
        denyPage(auth::Role::ADMIN);
        return;
    }
    uint8_t resp[64]; uint8_t rlen = 0;
    bool ok = mmcTransact(mmc::CMD_PROG_ABORT, nullptr, 0, resp, sizeof(resp), rlen);
    progResultPage("PROG",
        (ok && rlen >= 2 && resp[1] == mmc::ST_OK)
            ? "<p>Abort sent: best-effort 0x37, transfer state cleared, disarmed.</p>"
            : "<p class='warn'>M2 did not answer.</p>");
}

void handleApiProg()
{
    fetchProgStatus();
    String j = "{\"ok\":";
    j += progSt.ok ? "true" : "false";
    if (progSt.ok) {
        j += ",\"state\":" + String(progSt.state);
        j += ",\"stateName\":\"" + String(progStateName(progSt.state)) + "\"";
        j += ",\"session\":" + String(progSt.session);
        j += ",\"bus\":" + String(progSt.bus);
        j += ",\"baud\":" + String(progSt.baud);
        j += ",\"txId\":" + String(progSt.txId);
        j += ",\"rxId\":" + String(progSt.rxId);
        j += ",\"configured\":" + String(progSt.configured ? "true" : "false");
        j += ",\"powerOk\":" + String(progSt.powerOk ? "true" : "false");
        j += ",\"armed\":" + String(progSt.armed ? "true" : "false");
        j += ",\"bytesRx\":" + String(progSt.bytesRx);
        j += ",\"chunksRx\":" + String(progSt.chunksRx);
        j += ",\"txCrc\":" + String(progSt.txCrc);
        j += ",\"mitmSuspended\":" + String(progSt.mitmSuspended);
    }
    j += ",\"upActive\":" + String(progUp.active ? "true" : "false");
    j += ",\"upBytes\":" + String(progUp.bytes);
    j += ",\"upTotal\":" + String(progUp.total);
    j += ",\"upChunks\":" + String(progUp.chunks);
    j += ",\"upError\":" + String(progUp.error ? "true" : "false");
    j += "}";
    webServer.send(200, "application/json", j);
}

// ---- Phase 11: auth / pairing / clients / OTA / power web UI ----

void handleAuth()
{
    webServer.setContentLength(CONTENT_LENGTH_UNKNOWN);
    webServer.send(200, "text/html", "");
    pageHead("Authentication");
    String b;
    auth::Role r = auth::webRole();
    b += "<p>Device <b>" + appl::devIdStr + "</b> · your role: <b>" +
         String(auth::roleName(r)) + "</b></p>";
    if (!auth::configured()) {
        b += "<p class='warn'>No admin password set — the device is UNSECURED. "
             "Open <a href='/pair'>/pair</a> to set one.</p>";
    }
    b += "<h2>Log in</h2><form method='POST' action='/auth_login'>"
         "Password: <input name='pw' type='password' size='24'><br>"
         "<button>Log in</button></form>";
    b += "<h2>Log out</h2><form method='POST' action='/auth_logout'>"
         "<button>Log out</button></form>";
    b += "<h2>Pairing</h2><p>Hold the M2's <b>Button2</b> for 3 s (SuperB "
         "GPIO0 via Bee pin 7) to open a 120 s pairing window — then "
         "<a href='/pair'>/pair</a> can set or reset the admin password. "
         "Do not hold Button2 across a SuperB reboot (GPIO0 low at boot = "
         "ESP32 download mode).</p>";
    b += "<p>Roles: <b>viewer</b> = read-only web, no raw-pipe TX; "
         "<b>operator</b> = diagnostics, mode/config, PASS maps; "
         "<b>admin</b> = PROG destructive steps, MODIFY maps, OTA, WiFi, "
         "auth, power. Raw pipes (TCP:23/BT) have no app login — their "
         "perimeter is WPA2/BT-pairing plus the single-owner policy.</p>";
    webServer.sendContent(b);
    pageFoot();
    webServer.sendContent("");
}

void handleAuthLogin()
{
    String pw = webServer.hasArg("pw") ? webServer.arg("pw") : "";
    auth::Role r = auth::Role::VIEWER;
    if (auth::checkPw("adm", pw))
        r = auth::Role::ADMIN;
    else if (auth::checkPw("opr", pw))
        r = auth::Role::OPERATOR;
    webServer.setContentLength(CONTENT_LENGTH_UNKNOWN);
    if (r == auth::Role::VIEWER) {
        webServer.send(200, "text/html", "");
        pageHead("Authentication");
        webServer.sendContent(
            "<p class='warn'>Login failed.</p><p><a href='/auth'>Back</a></p>");
    } else {
        String tok = auth::newSession(r);
        webServer.sendHeader("Set-Cookie",
                             "M2SB_SESS=" + tok + "; Path=/; HttpOnly");
        webServer.send(200, "text/html", "");
        pageHead("Authentication");
        webServer.sendContent("<p>Logged in as <b>" + String(auth::roleName(r)) +
                             "</b>.</p><p><a href='/'>Status</a></p>");
    }
    pageFoot();
    webServer.sendContent("");
}

void handleAuthLogout()
{
    auth::logoutWeb();
    webServer.sendHeader("Set-Cookie", "M2SB_SESS=; Path=/; Max-Age=0");
    webServer.setContentLength(CONTENT_LENGTH_UNKNOWN);
    webServer.send(200, "text/html", "");
    pageHead("Authentication");
    webServer.sendContent("<p>Logged out.</p>");
    pageFoot();
    webServer.sendContent("");
}

void handlePair()
{
    webServer.setContentLength(CONTENT_LENGTH_UNKNOWN);
    webServer.send(200, "text/html", "");
    pageHead("Pairing");
    String b;
    bool canSet = !auth::configured() || pair_::open();
    b += "<p>Admin password: <b>" +
         String(auth::configured() ? "set" : "NOT SET") + "</b><br>";
    b += "Pairing window: <b>" + String(pair_::open() ? "OPEN" : "closed") +
         "</b></p>";
    if (canSet) {
        b += "<form method='POST' action='/pair_set'>"
             "New admin password (8+ chars): "
             "<input name='pw1' type='password' size='24'><br>"
             "Repeat: <input name='pw2' type='password' size='24'><br>"
             "Operator password (optional, empty = unchanged): "
             "<input name='opr' type='password' size='24'><br>"
             "<button>Set passwords</button></form>";
    } else {
        b += "<p class='warn'>Hold the M2's Button2 for 3 s to open the "
             "pairing window, then reload this page.</p>";
    }
    webServer.sendContent(b);
    pageFoot();
    webServer.sendContent("");
}

void handlePairSet()
{
    bool canSet = false;
#ifndef SIM_SUPERB
    canSet = !auth::configured() || pair_::open();
#else
    canSet = true;
#endif
    String pw1 = webServer.hasArg("pw1") ? webServer.arg("pw1") : "";
    String pw2 = webServer.hasArg("pw2") ? webServer.arg("pw2") : "";
    String opr = webServer.hasArg("opr") ? webServer.arg("opr") : "";
    webServer.setContentLength(CONTENT_LENGTH_UNKNOWN);
    webServer.send(200, "text/html", "");
    pageHead("Pairing");
    String b;
    if (!canSet) {
        b = "<p class='warn'>Refused: pairing window is not open.</p>";
    } else if (pw1.length() < 8 || pw1 != pw2) {
        b = "<p class='warn'>Refused: passwords must match and be 8+ chars.</p>";
    } else {
        auth::setPw("adm", pw1);
        if (opr.length() > 0) {
            if (opr.length() < 8)
                b += "<p class='warn'>Operator password too short — not set.</p>";
            else
                auth::setPw("opr", opr);
        }
        pair_::window = false;  // consume the window
        b += "<p>Admin password set. <a href='/auth'>Log in</a>.</p>";
    }
    webServer.sendContent(b);
    pageFoot();
    webServer.sendContent("");
}

void handleClients()
{
    webServer.setContentLength(CONTENT_LENGTH_UNKNOWN);
    webServer.send(200, "text/html", "");
    pageHead("Clients");
    String b = "<p>Control owner: <b>" + own::desc() + "</b> "
               "(first TX claims; idle timeout " +
               String(prefs.getUInt("own_tmo", 300)) + " s)</p>";
    b += "<p>Monitor TX bytes dropped by policy: <b>" + String(own::droppedTx) +
         "</b></p>";
    b += "<table><tr><th>Client</th><th>State</th><th>Owner?</th></tr>";
    for (int i = 0; i < MAX_TCP_CLIENTS; i++) {
        bool c = tcpClients[i] && tcpClients[i].connected();
        b += "<tr><td>tcp" + String(i) + " (:23)</td><td>" +
             String(c ? "connected" : "-") + "</td><td>" +
             String(own::owner.t == own::T::TCP && own::owner.idx == i
                        ? "<b>yes</b>"
                        : "no") +
             "</td></tr>";
    }
    b += "<tr><td>bt (SPP)</td><td>" +
         String(SerialBT.hasClient() ? "connected" : "-") + "</td><td>" +
         String(own::owner.t == own::T::BT ? "<b>yes</b>" : "no") +
         "</td></tr>";
    for (uint8_t i = 0; i < ws::MAXW; i++) {
        if (!ws::slots[i].used) continue;
        b += "<tr><td>ws" + String(i) + " (:81)</td><td>connected, role " +
             String(auth::roleName(ws::slots[i].role)) + "</td><td>" +
             String(own::owner.t == own::T::WS && own::owner.idx == i
                        ? "<b>yes</b>"
                        : "no") +
             "</td></tr>";
    }
    b += "</table>";
    b += "<form method='POST' action='/clients_release'>"
         "<button>Release control</button></form>"
         "<p>Releasing drops ownership; the next client to transmit claims it. "
         "There is no silent preemption.</p>";
    webServer.sendContent(b);
    pageFoot();
    webServer.sendContent("");
}

void handleClientsRelease()
{
    if (!requireRole(auth::Role::OPERATOR)) {
        denyPage(auth::Role::OPERATOR);
        return;
    }
    own::release();
    webServer.setContentLength(CONTENT_LENGTH_UNKNOWN);
    webServer.send(200, "text/html", "");
    pageHead("Clients");
    webServer.sendContent("<p>Control released.</p><p><a href='/clients'>Back</a></p>");
    pageFoot();
    webServer.sendContent("");
}

void handleOta()
{
    webServer.setContentLength(CONTENT_LENGTH_UNKNOWN);
    webServer.send(200, "text/html", "");
    pageHead("OTA firmware update");
    String b;
    b += "<table><tr><th>Item</th><th>Value</th></tr>";
    b += "<tr><td>Device</td><td>" + appl::devIdStr + "</td></tr>";
    b += "<tr><td>Installed OTA version</td><td><b>" +
         String(ota::storedVer()) + "</b></td></tr>";
    b += "<tr><td>Signing key fingerprint</td><td><code>" +
         String(OTA_KEY_FP) + "</code></td></tr>";
    b += "<tr><td>Last OTA result</td><td>";
    uint32_t last = prefs.getUInt("ota_last", 0);
    b += (last == 1 ? "ok" : last == 2 ? "<span class='warn'>failed</span>"
                                       : "none yet");
    b += "</td></tr></table>";
    b += "<h2>Install signed image</h2>"
         "<form method='POST' action='/ota_upload' enctype='multipart/form-data'>"
         "<input type='file' name='ota' accept='.ota'> "
         "<button>Upload &amp; verify</button></form>"
         "<p>Build the package on your machine:<br><code>python3 "
         "scripts/sign_ota.py --bin .pio/build/superb/firmware.bin "
         "--version N --key ~/.ota-keys/superb_ota_priv.pem "
         "--out superb-ota-vN.ota</code></p>"
         "<p>The image is signature-checked (ECDSA P-256) and "
         "version-checked (must exceed the installed version — "
         "anti-rollback) <b>before</b> it can become bootable. A failed "
         "check aborts the update; the running firmware is untouched.</p>";
    b += "<h2>Reboot</h2><form method='POST' action='/ota_reboot'>"
         "<button>Reboot SuperB</button></form>";
    b += "<h2>Recovery</h2><p>If an update ever leaves the SuperB unbootable, "
         "reflash over USB (the private key never leaves your machine, so "
         "only you can produce signed images):<br>"
         "<code>esptool.py --chip esp32 --port /dev/ttyUSB0 erase_flash</code><br>"
         "<code>pio run -e superb -t upload --upload-port /dev/ttyUSB0</code><br>"
         "Then re-apply a known-good .ota. There is no automatic rollback — "
         "the failed image stays in its slot until you replace it.</p>";
    webServer.sendContent(b);
    pageFoot();
    webServer.sendContent("");
}

void handleOtaUploadData()
{
    HTTPUpload& up = webServer.upload();
    if (up.status == UPLOAD_FILE_START) {
        if (!requireRole(auth::Role::ADMIN)) {
            ota::up.error = true;
            ota::up.msg = "login required (admin)";
            ota::up.active = false;
            return;
        }
        // Defensive: a previous upload abandoned mid-stream (client
        // disconnected before UPLOAD_FILE_END) leaves Update begun.
        if (ota::up.begun) Update.abort();
        ota::up.active = true;
        ota::up.error = false;
        ota::up.msg = "";
        ota::up.headN = 0;
        ota::up.begun = false;
        ota::up.version = 0;
        ota::up.imgLen = 0;
        ota::up.got = 0;
    } else if (up.status == UPLOAD_FILE_WRITE) {
        if (ota::up.error || !ota::up.active) return;
        pwr::markActivity();  // Phase 11: an in-progress upload is activity
        const uint8_t* d = up.buf;
        size_t n = up.currentSize;
        while (n > 0 && ota::up.headN < sizeof(ota::up.head)) {
            ota::up.head[ota::up.headN++] = *d++;
            n--;
        }
        if (ota::up.headN < sizeof(ota::up.head)) return;  // header incomplete
        if (!ota::up.begun) {
            if (memcmp(ota::up.head, "M2SBOTA1", 8) != 0) {
                ota::fail("bad magic (not a SuperB OTA package)");
                return;
            }
            uint32_t ver = (uint32_t)ota::up.head[8] |
                           ((uint32_t)ota::up.head[9] << 8) |
                           ((uint32_t)ota::up.head[10] << 16) |
                           ((uint32_t)ota::up.head[11] << 24);
            uint32_t len = (uint32_t)ota::up.head[12] |
                           ((uint32_t)ota::up.head[13] << 8) |
                           ((uint32_t)ota::up.head[14] << 16) |
                           ((uint32_t)ota::up.head[15] << 24);
            if (ver == 0 || ver <= ota::storedVer()) {
                ota::fail("anti-rollback: version not newer than installed");
                return;
            }
            if (len < ota::MIN_IMG || len > ota::MAX_IMG) {
                ota::fail("bad image length");
                return;
            }
            if (!Update.begin(len)) {
                ota::fail("Update.begin failed (OTA partitions present?)");
                return;
            }
            ota::up.version = ver;
            ota::up.imgLen = len;
            mbedtls_sha256_init(&ota::up.sha);
            mbedtls_sha256_starts_ret(&ota::up.sha, 0);
            // Signature covers header (16B) || image — not the sig itself.
            mbedtls_sha256_update_ret(&ota::up.sha, ota::up.head,
                                      ota::HDR_LEN);
            ota::up.begun = true;
        }
        if (n > 0) {
            mbedtls_sha256_update_ret(&ota::up.sha, d, n);
            if (Update.write((uint8_t*)d, n) != n) {
                ota::fail("Update.write failed");
                return;
            }
            ota::up.got += (uint32_t)n;
        }
    } else if (up.status == UPLOAD_FILE_ABORTED) {
        // Reviewer m3: client disconnected mid-upload. Fail explicitly so
        // a stale begun Update can't poison the next attempt (the START
        // handler also defensively aborts).
        ota::fail("upload aborted by client");
    } else if (up.status == UPLOAD_FILE_END) {
        if (ota::up.error || !ota::up.active) {
            ota::up.active = false;
            return;
        }
        if (!ota::up.begun || ota::up.got != ota::up.imgLen) {
            ota::fail("short image");
            return;
        }
        uint8_t hash[32];
        mbedtls_sha256_finish_ret(&ota::up.sha, hash);
        mbedtls_sha256_free(&ota::up.sha);
        if (!ota::verifySig(hash, ota::up.head + ota::HDR_LEN)) {
            ota::fail("signature invalid (wrong key?)");
            return;
        }
        // Reviewer m4: record the version BEFORE Update.end() commits the
        // image. A power loss in the reverse order would boot the new
        // image with a stale ota_ver, weakening the next anti-rollback
        // check. (If end() then fails, a same-version retry is rejected —
        // bump the version and retry; the old image still boots.)
        prefs.putUInt("ota_ver", ota::up.version);
        if (!Update.end() || Update.hasError()) {
            ota::fail("Update.end failed");
            return;
        }
        prefs.putUInt("ota_last", 1);
        ota::up.active = false;
        ota::up.msg = "verified + staged (version " +
                      String(ota::up.version) + "); reboot to run it";
    }
}

void handleOtaUpload()
{
    webServer.setContentLength(CONTENT_LENGTH_UNKNOWN);
    webServer.send(200, "text/html", "");
    pageHead("OTA firmware update");
    String b;
    if (ota::up.error)
        b = "<p class='warn'>Update FAILED: " + ota::up.msg +
            ". Running firmware untouched.</p>";
    else
        b = "<p>Update staged: " + ota::up.msg + ".</p>";
    b += "<p><a href='/ota'>Back</a></p>";
    webServer.sendContent(b);
    pageFoot();
    webServer.sendContent("");
}

void handleOtaReboot()
{
    if (!requireRole(auth::Role::ADMIN)) {
        denyPage(auth::Role::ADMIN);
        return;
    }
    webServer.send(200, "text/html",
                   "<p>Rebooting…</p><script>setTimeout(function(){"
                   "location.href='/';},4000);</script>");
    delay(500);
    ESP.restart();
}

const char* wakeCauseName(uint32_t c)
{
    // esp_sleep_wakeup_cause_t values (ESP-IDF); INFERRED mapping.
    switch (c) {
        case 1: return "ext0 (Button2)";
        case 2: return "ext1";
        case 3: return "timer (voltage re-poll)";
        case 4: return "touch";
        case 5: return "ULP";
        case 8: return "UART (M2 traffic)";
        default: return "power-on / unknown";
    }
}

void handlePower()
{
    webServer.setContentLength(CONTENT_LENGTH_UNKNOWN);
    webServer.send(200, "text/html", "");
    pageHead("Power / sleep");
    String b;
    b += "<table><tr><th>Item</th><th>Value</th></tr>";
    b += "<tr><td>Vehicle voltage (M2 V_SENSE)</td><td>";
    b += pwr::voltOk ? ("<b>" + String(pwr::lastMV) + " mV</b>") : "<span class='warn'>M2 unreachable</span>";
    b += " <span style='font-size:.85em'>(INFERRED calibration until per-unit measured)</span></td></tr>";
    b += "<tr><td>Sleep manager</td><td>" +
         String(pwr::enabled() ? "enabled" : "disabled") + "</td></tr>";
    b += "<tr><td>Last wake cause</td><td>" +
         String(wakeCauseName(pwr::wakeCause)) + "</td></tr>";
    b += "<tr><td>Thresholds</td><td>sleep below " + String(pwr::vOff()) +
         " mV for " + String(pwr::offMin()) + " min + idle " +
         String(pwr::idleMin()) + " min; full wake above " + String(pwr::vOn()) +
         " mV</td></tr></table>";
    b += "<p>No sleep-current claims are made — currents are unmeasured. "
         "Sleep = ESP32 light sleep (radios off), wake every 60 s to re-poll "
         "voltage, or on Button2, or on M2 UART traffic.</p>";
    b += "<h2>Configuration</h2><form method='POST' action='/power_set'>"
         "Sleep-below mV: <input name='v_off' size='7' value='" +
         String(pwr::vOff()) + "'><br>"
         "Wake-above mV: <input name='v_on' size='7' value='" + String(pwr::vOn()) +
         "'><br>"
         "Engine-off minutes: <input name='off_min' size='4' value='" +
         String(pwr::offMin()) + "'><br>"
         "Idle minutes: <input name='idle' size='4' value='" + String(pwr::idleMin()) +
         "'><br>"
         "<label><input type='checkbox' name='sleep_en' value='1'" +
         String(pwr::enabled() ? " checked" : "") + "> Sleep manager enabled</label><br>"
         "Ownership idle timeout s: <input name='own_tmo' size='6' value='" +
         String(prefs.getUInt("own_tmo", 300)) + "'><br>"
         "Web session timeout s: <input name='sess_tmo' size='6' value='" +
         String(prefs.getUInt("sess_tmo", 1800)) + "'><br>"
         "<button>Apply</button></form>";
    b += "<h2>Manual</h2><form method='POST' action='/power_sleep'>"
         "<button>Sleep now</button></form>";
    webServer.sendContent(b);
    pageFoot();
    webServer.sendContent("");
}

void handlePowerSet()
{
    if (!requireRole(auth::Role::ADMIN)) {
        denyPage(auth::Role::ADMIN);
        return;
    }
    long v;
    if (webServer.hasArg("v_off")) {
        v = webServer.arg("v_off").toInt();
        if (v >= 9000 && v <= 16000) prefs.putUShort("v_off", (uint16_t)v);
    }
    if (webServer.hasArg("v_on")) {
        v = webServer.arg("v_on").toInt();
        if (v >= 9000 && v <= 16000) prefs.putUShort("v_on", (uint16_t)v);
    }
    if (webServer.hasArg("off_min")) {
        v = webServer.arg("off_min").toInt();
        if (v >= 1 && v <= 240) prefs.putUShort("off_min", (uint16_t)v);
    }
    if (webServer.hasArg("idle")) {
        v = webServer.arg("idle").toInt();
        if (v >= 1 && v <= 240) prefs.putUShort("idle_min", (uint16_t)v);
    }
    prefs.putBool("sleep_en", webServer.hasArg("sleep_en"));
    if (webServer.hasArg("own_tmo")) {
        v = webServer.arg("own_tmo").toInt();
        if (v >= 30 && v <= 3600) {
            prefs.putUInt("own_tmo", (uint32_t)v);
            own::timeoutMs = (uint32_t)v * 1000UL;
        }
    }
    if (webServer.hasArg("sess_tmo")) {
        v = webServer.arg("sess_tmo").toInt();
        if (v >= 60 && v <= 86400) prefs.putUInt("sess_tmo", (uint32_t)v);
    }
    webServer.setContentLength(CONTENT_LENGTH_UNKNOWN);
    webServer.send(200, "text/html", "");
    pageHead("Power / sleep");
    webServer.sendContent("<p>Saved.</p><p><a href='/power'>Back</a></p>");
    pageFoot();
    webServer.sendContent("");
}

void handlePowerSleep()
{
    if (!requireRole(auth::Role::ADMIN)) {
        denyPage(auth::Role::ADMIN);
        return;
    }
    webServer.send(200, "text/html", "<p>Sleeping…</p>");
    delay(300);
    pwr::enterSleep();
}


// ============ bridging ============

// Bee UART -> clients, with the control-channel diverter.
void pumpBeeRx()
{
    size_t n = 0;
    // S2: stop one byte short of PIPE_CHUNK. The RX diverter's GOT_F1
    // state needs TWO output slots to replay a held F1 plus the current
    // byte; with n == PIPE_CHUNK - 1 both would be silently discarded.
    // One byte of headroom guarantees every diverter output path fits.
    while (Serial.available() > 0 && n < PIPE_CHUNK - 1) {
        mmc::rxByte((uint8_t)Serial.read(), pipeBuf, n, PIPE_CHUNK);
    }
    if (n > 0) {
        // Phase 3: in OBD2 mode the Bee link carries poller CSV lines —
        // sniff them into the ring buffer for the web live view. (The mode
        // is cached from the last web status fetch; INFERRED timing.)
        if (m2status.ok && m2status.mode == 5) csvFeed(pipeBuf, n);
        // Phase 4: in MITM mode the Bee link carries MITMLOG lines from
        // LOG-action rules — sniff them for the /mitm live view.
        if (m2status.ok && m2status.mode == 4) mitmLogFeed(pipeBuf, n);
        if (SerialBT.hasClient()) SerialBT.write(pipeBuf, n);
        for (int i = 0; i < MAX_TCP_CLIENTS; i++)
            if (tcpClients[i] && tcpClients[i].connected())
                tcpClients[i].write(pipeBuf, n);
        // Phase 11: WebSocket binary clients join the broadcast (monitors
        // and owner alike — RX is never gated, only TX is).
        if (n > 0 && ws::nClients() > 0) webSocket.broadcastBIN(pipeBuf, n);
    }
}

// One client -> Bee UART, through the injection filter.
// Phase 11: single-owner policy — a non-owner's bytes never reach the M2.
bool pumpClientToUart(WiFiClient& client, uint8_t idx)
{
    if (!client.connected()) return false;
    size_t n = 0;
    while (client.available() > 0 && n < PIPE_CHUNK) {
        pipeBuf[n++] = (uint8_t)client.read();
    }
    if (n > 0) {
        if (own::txAllowed(own::T::TCP, idx)) {
            pwr::markActivity();
            mmc::uartWriteFiltered(pipeBuf, n);
        } else {
            own::dropped(n);
        }
    }
    return true;
}

void pumpBtToUart()
{
    if (!SerialBT.hasClient()) return;
    size_t n = 0;
    while (SerialBT.available() > 0 && n < PIPE_CHUNK) {
        pipeBuf[n++] = (uint8_t)SerialBT.read();
    }
    // Phase 11: single-owner policy — a non-owner's bytes never reach the M2.
    if (n > 0) {
        if (own::txAllowed(own::T::BT, 0)) {
            pwr::markActivity();
            mmc::uartWriteFiltered(pipeBuf, n);
        } else {
            own::dropped(n);
        }
    }
}

// Phase 11: (re)initialize the radios. Called from setup() and after
// every light-sleep wake (pwr::enterSleep stops them before sleeping).
namespace pwr {
void netInit()
{
    String apPass = prefs.getString("ap_pass", "M2SuperB!");
    String staSsid = prefs.getString("sta_ssid", "");
    String staPass = prefs.getString("sta_pass", "");

    SerialBT.begin(BT_DEVICE_NAME);

    // WiFi AP (WPA2) + STA (credentials from NVS; empty = don't join).
    WiFi.mode(WIFI_AP_STA);
    WiFi.softAP(AP_SSID, apPass.c_str());
    if (staSsid.length() > 0) WiFi.begin(staSsid.c_str(), staPass.c_str());

    tcpServer.begin();

    webSocket.begin();
    webSocket.onEvent(ws::onEvent);
}
}  // namespace pwr

} // namespace

// ============================================================================
// Phase 12: log sink + supervision web UI (profiles, auto-detect, harness,
// DBC, logs). LEAN by design: the SuperB flash budget is at 85.5%.
//
// Log sink: the M2 produces 23-byte log records into its RAM ring; this
// side POLLS them (CMD_LOG_POLL, 2 per reply) and appends to SPIFFS with
// rotation. Native binary is stored; GVRET/CRTD/CSV are converted at
// download time. Privacy: logs may contain VINs — they stay local
// (SPIFFS + web download only); nothing is uploaded anywhere.
// ============================================================================
namespace p12 {

constexpr uint8_t REC_BYTES = 23;
constexpr uint32_t LOG_FILE_MAX = 65536;  // 64 KB per file
constexpr uint8_t LOG_FILE_N = 2;         // ping-pong (fits 192 KB SPIFFS)
constexpr uint32_t LOG_POLL_MS = 500;

bool sinkOn = false;
File logFile;
uint8_t logIdx = 0;
uint32_t logBytes = 0;      // bytes in the current file
uint32_t logRecords = 0;    // records persisted (all files)
uint32_t logPollMiss = 0;   // poll transactions that failed
uint32_t logWriteFail = 0;  // SPIFFS write failures
uint32_t lastPoll = 0;

void logPath(uint8_t i, char* out, size_t cap)
{
    snprintf(out, cap, "/logs/log_%02u.bin", i);
}

bool openLog(uint8_t i)
{
    char p[32];
    logPath(i, p, sizeof(p));
    if (logFile) logFile.close();
    logFile = SPIFFS.open(p, "w");
    logIdx = i;
    logBytes = 0;
    return (bool)logFile;
}

void rotateLog()
{
    uint8_t next = (logIdx + 1) % LOG_FILE_N;
    char p[32];
    logPath(next, p, sizeof(p));
    SPIFFS.remove(p);  // make room; never silent (counted below)
    if (!openLog(next)) logWriteFail++;
}

// Called from loop(). Polls the M2 and persists records.
void sinkTick()
{
    if (!sinkOn) return;
    uint32_t now = millis();
    if (now - lastPoll < LOG_POLL_MS) return;
    lastPoll = now;
    if (!logFile && !openLog(0)) {
        logWriteFail++;
        return;
    }
    // Drain with repeated polls (1 record per reply — the mm payload cap
    // is 48 bytes; 3 + 1*23 = 26 fits). Up to 4 polls per tick.
    for (uint8_t p = 0; p < 4; p++) {
        uint8_t resp[64];
        uint8_t rlen = 0;
        if (!mmcTransact(mmc::CMD_LOG_POLL, nullptr, 0, resp, sizeof(resp), rlen)) {
            logPollMiss++;
            return;
        }
        if (rlen < 3 || resp[0] != (mmc::CMD_LOG_POLL | 0x80) ||
            resp[1] != mmc::ST_OK)
            return;
        uint8_t nRec = resp[2];
        if (nRec == 0) return;  // drained
        if (nRec != 1 || rlen < (uint8_t)(3 + REC_BYTES)) return;
        const uint8_t* rec = resp + 3;
        if (logFile.write(rec, REC_BYTES) != REC_BYTES) {
            logWriteFail++;
            continue;
        }
        logBytes += REC_BYTES;
        logRecords++;
        if (logBytes >= LOG_FILE_MAX) rotateLog();
    }
    logFile.flush();
}

}  // namespace p12

// ---- Phase 12 web UI ----
void handlePhase12()
{
    webServer.setContentLength(CONTENT_LENGTH_UNKNOWN);
    webServer.send(200, "text/html", "");
    pageHead("Profiles / Detect / Harness / Logs");
    String b;
    // Profile info.
    uint8_t resp[64];
    uint8_t rlen = 0;
    bool m2ok = mmcTransact(mmc::CMD_PROFILE_INFO, nullptr, 0, resp, sizeof(resp), rlen);
    b += "<h2>Vehicle profile</h2>";
    if (!m2ok || rlen < 24 || resp[1] != mmc::ST_OK) {
        b += "<p class='warn'>M2 unreachable.</p>";
    } else {
        char pname[17];
        memcpy(pname, resp + 8, 16);
        pname[16] = '\0';
        uint32_t writes = (uint32_t)resp[4] | ((uint32_t)resp[5] << 8) |
                          ((uint32_t)resp[6] << 16) | ((uint32_t)resp[7] << 24);
        b += "<p>Stored: <b>";
        b += resp[2] ? String(pname) : "(none)";
        b += "</b> · writes: <b>" + String(writes) + "</b></p>";
        b += "<form method='POST' action='/p12_profile_save'>Name: "
             "<input name='name' maxlength='15' size='16'>"
             "<input type='submit' value='Save current settings'></form>";
        b += "<form method='POST' action='/p12_profile_load'>"
             "<input type='submit' value='Load stored profile'></form>";
    }
    // Auto-detect.
    b += "<h2>Auto-detect</h2>";
    b += "<p class='warn'>Explicit only: never runs on boot or in the "
         "background. CAN is listen-only; K-line/J1850/SWCAN <b>transmit</b> "
         "— tick TX consent to enable those stages.</p>";
    b += "<form method='POST' action='/p12_autodet_start'>"
         "<label><input type='checkbox' name='tx' value='1'> TX consent "
         "(K-line init + active probes)</label><br>"
         "<input type='submit' value='Start auto-detect'></form>";
    // Harness.
    b += "<h2>Self-test harness</h2>";
    b += "<p>Runs on the CAN0&harr;CAN1 loopback pair only "
         "(wire CAN0H&harr;CAN1H, CAN0L&harr;CAN1L first).</p>";
    b += "<form method='POST' action='/p12_harness_run'>"
         "<input type='submit' value='Run suite (all tests)'></form>";
    // DBC.
    b += "<h2>DBC signals</h2>";
    if (mmcTransact(mmc::CMD_DBC_INFO, nullptr, 0, resp, sizeof(resp), rlen) && rlen >= 9 &&
        resp[1] == mmc::ST_OK) {
        uint16_t nMsg = resp[3] | ((uint16_t)resp[4] << 8);
        uint16_t nSig = resp[5] | ((uint16_t)resp[6] << 8);
        b += "<p>DBCs: <b>" + String(resp[2]) + "</b> · messages: <b>" +
             String(nMsg) + "</b> · signals: <b>" + String(nSig) + "</b></p>";
    } else {
        b += "<p class='warn'>DBC info unavailable.</p>";
    }
    // Log sink.
    b += "<h2>Session logging</h2>";
    b += "<p>Sink: <b>" + String(p12::sinkOn ? "ON" : "off") + "</b> · "
         "records persisted: <b>" + String(p12::logRecords) + "</b> · "
         "poll misses: <b>" + String(p12::logPollMiss) + "</b> · "
         "write fails: <b>" + String(p12::logWriteFail) + "</b></p>";
    b += "<form method='POST' action='/p12_logsink'>"
         "<input type='submit' name='on' value='Sink on'> "
         "<input type='submit' name='off' value='Sink off'></form>";
    b += "<p><a href='/logs'>Browse / download logs</a> (native, GVRET, "
         "CRTD, CSV)</p>";
    b += "<p class='warn'>Privacy: logs may contain VINs and vehicle data. "
         "They stay local — SPIFFS + web download only.</p>";
    webServer.sendContent(b);
    pageFoot();
    webServer.sendContent("");
}

void handleP12ProfileSave()
{
    if (!requireRole(auth::Role::OPERATOR)) {
        webServer.send(403, "text/plain", "forbidden");
        return;
    }
    String name = webServer.arg("name");
    uint8_t payload[16] = {0};
    for (uint8_t i = 0; i < 16 && i < name.length(); i++)
        payload[i] = (uint8_t)name[i];
    uint8_t resp[64];
    uint8_t rlen = 0;
    bool ok = mmcTransact(mmc::CMD_PROFILE_SAVE, payload, 16, resp, sizeof(resp), rlen) &&
              rlen >= 2 && resp[1] == mmc::ST_OK;
    webServer.sendHeader("Location", "/phase12");
    webServer.send(303, "text/plain", ok ? "saved" : "FAILED");
}

void handleP12ProfileLoad()
{
    if (!requireRole(auth::Role::OPERATOR)) {
        webServer.send(403, "text/plain", "forbidden");
        return;
    }
    uint8_t resp[64];
    uint8_t rlen = 0;
    bool ok = mmcTransact(mmc::CMD_PROFILE_LOAD, nullptr, 0, resp, sizeof(resp), rlen) &&
              rlen >= 2 && resp[1] == mmc::ST_OK;
    webServer.sendHeader("Location", "/phase12");
    webServer.send(303, "text/plain", ok ? "loaded" : "FAILED");
}

void handleP12AutodetStart()
{
    if (!requireRole(auth::Role::OPERATOR)) {
        webServer.send(403, "text/plain", "forbidden");
        return;
    }
    // Explicit TX consent: the checkbox is the second factor (the first
    // being the operator clicking Start at all). Without it the M2 runs
    // listen-only + passive stages only.
    uint8_t allowTx = webServer.hasArg("tx") ? 1 : 0;
    uint8_t resp[64];
    uint8_t rlen = 0;
    // Operation-specific timeout (not the 800 ms default): the M2 runs the
    // scan synchronously — worst case 4 CAN bauds x 2 formats x 350 ms =
    // 2.8 s, plus J1850 VPW/PWM (2 x 350 ms) and SWCAN (700 ms) = ~4.2 s
    // before setup overhead. 8000 ms covers it with margin.
    bool ok = mmcTransact(mmc::CMD_AUTODET_START, &allowTx, 1, resp, sizeof(resp), rlen,
                          8000) &&
              rlen >= 2 && resp[1] == mmc::ST_OK;
    // Fetch the result for the confirmation page.
    String b;
    if (ok && mmcTransact(mmc::CMD_AUTODET_STATUS, nullptr, 0, resp, sizeof(resp), rlen) &&
        rlen >= 10 && resp[1] == mmc::ST_OK) {
        uint32_t baud = (uint32_t)resp[5] | ((uint32_t)resp[6] << 8) |
                        ((uint32_t)resp[7] << 16) | ((uint32_t)resp[8] << 24);
        b = resp[3] ? "FOUND" : "NOT FOUND";
        b += " proto=" + String(resp[4]) + " baud=" + String(baud) +
             " conf=" + String(resp[9]) + "%";
    } else {
        b = ok ? "run finished (status unavailable)" : "START FAILED";
    }
    webServer.setContentLength(CONTENT_LENGTH_UNKNOWN);
    webServer.send(200, "text/html", "");
    pageHead("Auto-detect result");
    webServer.sendContent("<p><b>" + b + "</b></p><p><a href='/phase12'>back</a></p>");
    pageFoot();
    webServer.sendContent("");
}

void handleP12HarnessRun()
{
    if (!requireRole(auth::Role::OPERATOR)) {
        webServer.send(403, "text/plain", "forbidden");
        return;
    }
    uint8_t mask[2] = {0xFF, 0x00};  // T_ALL
    uint8_t resp[64];
    uint8_t rlen = 0;
    bool ok = mmcTransact(mmc::CMD_HARNESS_RUN, mask, 2, resp, sizeof(resp), rlen);
    String b;
    if (ok && rlen >= 4 && resp[1] == mmc::ST_OK)
        b = String(resp[3]) + "/" + String(resp[2]) + " passed";
    else
        b = "REFUSED — loopback selfcheck has not passed "
            "(wire CAN0<->CAN1, enter HARNESS mode, run selfcheck)";
    webServer.setContentLength(CONTENT_LENGTH_UNKNOWN);
    webServer.send(200, "text/html", "");
    pageHead("Harness result");
    webServer.sendContent("<p><b>" + b + "</b></p><p><a href='/phase12'>back</a></p>");
    pageFoot();
    webServer.sendContent("");
}

void handleP12LogSink()
{
    if (!requireRole(auth::Role::OPERATOR)) {
        webServer.send(403, "text/plain", "forbidden");
        return;
    }
    if (webServer.hasArg("on")) {
        if (!p12::sinkOn) {
            p12::sinkOn = true;
            if (!p12::logFile) p12::openLog(0);
        }
    } else {
        p12::sinkOn = false;
        if (p12::logFile) p12::logFile.close();
    }
    webServer.sendHeader("Location", "/phase12");
    webServer.send(303, "text/plain", "ok");
}

// Download one log file with format conversion.
void handleLogDl()
{
    String f = webServer.arg("f");      // "00".."01"
    String fmt = webServer.arg("fmt");  // native|gvret|crtd|csv
    int idx = f.toInt();
    if (idx < 0 || idx >= p12::LOG_FILE_N) {
        webServer.send(400, "text/plain", "bad file");
        return;
    }
    char path[32];
    p12::logPath((uint8_t)idx, path, sizeof(path));
    File fh = SPIFFS.open(path, "r");
    if (!fh) {
        webServer.send(404, "text/plain", "no such log");
        return;
    }
    if (fmt == "native") {
        webServer.sendHeader("Content-Disposition",
                             ("attachment; filename=log_" + f + ".bin").c_str());
        // Files are <= 64 KB; read-and-send works on real + sim WebServer.
        String blob;
        uint8_t chunk[256];
        size_t n;
        while ((n = fh.read(chunk, sizeof(chunk))) > 0)
            for (size_t i = 0; i < n; i++) blob += (char)chunk[i];
        fh.close();
        webServer.send(200, "application/octet-stream", blob);
        return;
    }
    // Converted formats: stream text built in RAM (files are <= 64 KB).
    String out;
    uint8_t rec[p12::REC_BYTES];
    char line[128];
    while (fh.read(rec, p12::REC_BYTES) == p12::REC_BYTES) {
        uint32_t tsMs = (uint32_t)rec[0] | ((uint32_t)rec[1] << 8) |
                        ((uint32_t)rec[2] << 16) | ((uint32_t)rec[3] << 24);
        uint8_t bus = rec[4], dir = rec[5], kind = rec[6], ecu = rec[7];
        uint16_t svc = rec[8] | ((uint16_t)rec[9] << 8);
        int32_t val = (int32_t)((uint32_t)rec[10] | ((uint32_t)rec[11] << 8) |
                                ((uint32_t)rec[12] << 16) | ((uint32_t)rec[13] << 24));
        uint8_t rawLen = rec[14] > 8 ? 8 : rec[14];
        char rawHex[17];
        for (uint8_t i = 0; i < rawLen; i++)
            snprintf(rawHex + i * 2, 3, "%02X", rec[15 + i]);
        rawHex[rawLen * 2] = '\0';
        if (fmt == "csv") {
            snprintf(line, sizeof(line), "%lu,%u,%u,%u,%u,0x%04X,%ld,%s\r\n",
                     (unsigned long)tsMs, bus, dir, kind, ecu, svc,
                     (long)val, rawHex);
            out += line;
        } else if (fmt == "crtd") {
            // SavvyCAN capture text. kind 0 carries a CAN frame (ID low
            // 16 in svc — documented truncation); others become comments.
            if (kind == 0) {
                snprintf(line, sizeof(line), "(%lu.%03lu) can%u %X#%s\r\n",
                         (unsigned long)(tsMs / 1000),
                         (unsigned long)(tsMs % 1000), bus, svc, rawHex);
            } else {
                snprintf(line, sizeof(line),
                         "# %lu kind=%u ecu=%u svc=0x%04X val=%ld %s\r\n",
                         (unsigned long)tsMs, kind, ecu, svc, (long)val,
                         rawHex);
            }
            out += line;
        } else if (fmt == "gvret") {
            // M2RET binary frame: F1 00 <tsUs LE32> <id LE32> <bus>
            // <len> <data>. kind-0 only; others are skipped (binary has
            // no comments). ID is the low 16 bits (record truncation).
            if (kind != 0) continue;
            uint8_t fr[16];
            fr[0] = 0xF1;
            fr[1] = 0x00;
            uint32_t tsUs = tsMs * 1000UL;
            fr[2] = tsUs & 0xFF; fr[3] = (tsUs >> 8) & 0xFF;
            fr[4] = (tsUs >> 16) & 0xFF; fr[5] = (tsUs >> 24) & 0xFF;
            fr[6] = svc & 0xFF; fr[7] = (svc >> 8) & 0xFF;
            fr[8] = 0; fr[9] = 0;
            fr[10] = bus;
            fr[11] = rawLen;
            for (uint8_t i = 0; i < rawLen; i++) fr[12 + i] = rec[15 + i];
            // Accumulate as Latin-1 chars (binary-safe for String).
            for (uint8_t i = 0; i < 12 + rawLen; i++) out += (char)fr[i];
        } else {
            webServer.send(400, "text/plain", "bad fmt");
            fh.close();
            return;
        }
    }
    fh.close();
    webServer.sendHeader("Content-Disposition",
                         ("attachment; filename=log_" + f + "." + fmt).c_str());
    webServer.send(200, "text/plain", out);
}

void handleLogs()
{
    webServer.setContentLength(CONTENT_LENGTH_UNKNOWN);
    webServer.send(200, "text/html", "");
    pageHead("Session logs");
    String b;
    b += "<p class='warn'>Logs may contain VINs and vehicle data — local "
         "only, never uploaded.</p>";
    b += "<table><tr><th>File</th><th>Size</th><th colspan='4'>Download</th></tr>";
    for (uint8_t i = 0; i < p12::LOG_FILE_N; i++) {
        char path[32], idx[4];
        p12::logPath(i, path, sizeof(path));
        snprintf(idx, sizeof(idx), "%02u", i);
        b += "<tr><td>" + String(path) + "</td>";
        if (SPIFFS.exists(path)) {
            File fh = SPIFFS.open(path, "r");
            size_t sz = fh.size();
            fh.close();
            b += "<td>" + String(sz) + " B</td>";
            b += "<td><a href='/log_dl?f=" + String(idx) + "&fmt=native'>native</a></td>";
            b += "<td><a href='/log_dl?f=" + String(idx) + "&fmt=crtd'>CRTD</a></td>";
            b += "<td><a href='/log_dl?f=" + String(idx) + "&fmt=csv'>CSV</a></td>";
            b += "<td><a href='/log_dl?f=" + String(idx) + "&fmt=gvret'>GVRET*</a></td>";
        } else {
            b += "<td colspan='5'>(empty)</td>";
        }
        b += "</tr>";
    }
    b += "</table>";
    b += "<p>*GVRET download: kind-0 records as 0xF1 binary frames "
         "(CAN ID low 16 bits — the 23-byte record truncates full 29-bit "
         "IDs; see docs).</p>";
    b += "<p><a href='/phase12'>back</a></p>";
    webServer.sendContent(b);
    pageFoot();
    webServer.sendContent("");
}

void setup()
{
    // Bee UART to the M2. 115200 is immutable.
    Serial.setRxBufferSize(1024);
    Serial.begin(115200);

    pinMode(SUPERB_LED, OUTPUT);
    digitalWrite(SUPERB_LED, LOW);

    prefs.begin(NVS_NS, false);

    // Phase 11: device identity, pairing pin, ownership timeout, activity.
    appl::initIdentity();
    pinMode(pair_::PIN, INPUT_PULLUP);
    own::loadCfg();
    pwr::markActivity();

    pwr::netInit();  // BT + WiFi + TCP:23 + WS:81 (also re-run after sleep)

    webServer.on("/", handleRoot);
    webServer.on("/mode", handleMode);
    webServer.on("/mode_set", HTTP_POST, handleModeSet);
    webServer.on("/settings", handleSettings);
    webServer.on("/settings_set", HTTP_POST, handleSettingsSet);
    webServer.on("/wifi", handleWifi);
    webServer.on("/wifi_set", HTTP_POST, handleWifiSet);
    webServer.on("/api/status", handleApiStatus);
    // Phase 3: UDS + OBD2.
    webServer.on("/uds", handleUds);
    webServer.on("/uds_send", HTTP_POST, handleUdsSend);
    webServer.on("/uds_session", HTTP_POST, handleUdsSession);
    webServer.on("/uds_tp", HTTP_POST, handleUdsTp);
    webServer.on("/uds_cfg", HTTP_POST, handleUdsCfg);
    webServer.on("/obd2", handleObd2);
    webServer.on("/obd2_cfg", HTTP_POST, handleObd2Cfg);
    webServer.on("/obd2_ctl", HTTP_POST, handleObd2Ctl);
    webServer.on("/api/obd2", handleApiObd2);
    // Phase 4: MITM.
    webServer.on("/mitm", handleMitm);
    webServer.on("/mitm_rule_add", HTTP_POST, handleMitmRuleAdd);
    webServer.on("/mitm_rule_del", HTTP_POST, handleMitmRuleDel);
    webServer.on("/mitm_cfg", HTTP_POST, handleMitmCfg);
    webServer.on("/api/mitm", handleApiMitm);
    // Phase 10: gateway (CAN0 <-> SWCAN).
    webServer.on("/gateway", handleGateway);
    webServer.on("/gw_map_add", HTTP_POST, handleGwMapAdd);
    webServer.on("/gw_map_add_confirm", HTTP_POST, handleGwMapAddConfirm);
    webServer.on("/gw_map_del", HTTP_POST, handleGwMapDel);
    webServer.on("/gw_cfg", HTTP_POST, handleGwCfg);

    webServer.on("/prog", handleProg);
    webServer.on("/prog_cfg", HTTP_POST, handleProgCfg);
    webServer.on("/prog_session", HTTP_POST, handleProgSession);
    webServer.on("/prog_seed", HTTP_POST, handleProgSeed);
    webServer.on("/prog_key", HTTP_POST, handleProgKey);
    webServer.on("/prog_erase", HTTP_POST, handleProgErase);
    webServer.on("/prog_dl", HTTP_POST, handleProgDl);
    webServer.on("/prog_upload", HTTP_POST, handleProgUpload, handleProgUploadData);
    webServer.on("/prog_done", HTTP_POST, handleProgDone);
    webServer.on("/prog_verify", HTTP_POST, handleProgVerify);
    webServer.on("/prog_reset", HTTP_POST, handleProgReset);
    webServer.on("/prog_abort", HTTP_POST, handleProgAbort);
    webServer.on("/api/prog", handleApiProg);
    // Phase 11: appliance (auth, pairing, clients, OTA, power).
    webServer.on("/auth", handleAuth);
    webServer.on("/auth_login", HTTP_POST, handleAuthLogin);
    webServer.on("/auth_logout", HTTP_POST, handleAuthLogout);
    webServer.on("/pair", handlePair);
    webServer.on("/pair_set", HTTP_POST, handlePairSet);
    webServer.on("/clients", handleClients);
    webServer.on("/clients_release", HTTP_POST, handleClientsRelease);
    webServer.on("/ota", handleOta);
    webServer.on("/ota_upload", HTTP_POST, handleOtaUpload, handleOtaUploadData);
    webServer.on("/ota_reboot", HTTP_POST, handleOtaReboot);
    webServer.on("/power", handlePower);
    webServer.on("/power_set", HTTP_POST, handlePowerSet);
    webServer.on("/power_sleep", HTTP_POST, handlePowerSleep);
    // Phase 12: profiles / auto-detect / harness / logs.
    webServer.on("/phase12", handlePhase12);
    webServer.on("/p12_profile_save", HTTP_POST, handleP12ProfileSave);
    webServer.on("/p12_profile_load", HTTP_POST, handleP12ProfileLoad);
    webServer.on("/p12_autodet_start", HTTP_POST, handleP12AutodetStart);
    webServer.on("/p12_harness_run", HTTP_POST, handleP12HarnessRun);
    webServer.on("/p12_logsink", HTTP_POST, handleP12LogSink);
    webServer.on("/logs", handleLogs);
    webServer.on("/log_dl", handleLogDl);
    // Phase 12: SPIFFS for the log sink (192 KB partition, Phase 11 table).
    if (!SPIFFS.begin(true)) {
        // Non-fatal: the sink just won't persist until the next boot.
    }
    {
        // Session cookie for role lookup (real WebServer; sim keeps all).
        static const char* cookieHdr[] = { "Cookie" };
        webServer.collectHeaders(cookieHdr, 1);
    }
    webServer.begin();
}


void loop()
{
    pumpBeeRx();       // M2 -> clients (diverts control frames)
    pumpBtToUart();    // BT -> M2 (filtered, owner-gated)

    // Phase 11: BT disconnect releases ownership.
    static bool btWas = false;
    bool btNow = SerialBT.hasClient();
    if (btWas && !btNow) own::onDisconnect(own::T::BT, 0);
    btWas = btNow;

    for (int i = 0; i < MAX_TCP_CLIENTS; i++) {
        if (tcpClients[i]) {
            if (!pumpClientToUart(tcpClients[i], (uint8_t)i)) {
                tcpClients[i].stop();
                own::onDisconnect(own::T::TCP, (uint8_t)i);
                mmc::txFilterReset();
            }
        }
    }
    mmc::txFilterIdle();

    WiFiClient newcomer = tcpServer.available();
    if (newcomer) {
        int slot = -1;
        for (int i = 0; i < MAX_TCP_CLIENTS; i++) {
            if (!tcpClients[i] || !tcpClients[i].connected()) { slot = i; break; }
        }
        if (slot < 0) {
            own::onDisconnect(own::T::TCP, 0);
            tcpClients[0].stop(); slot = 0;
        }  // evict oldest
        tcpClients[slot] = newcomer;
    }

    webServer.handleClient();
    webSocket.loop();  // Phase 11: WebSocket transport

    // Phase 11: appliance supervision.
    own::poll();    // ownership idle timeout
    pair_::poll();   // pairing window (Button2)
    pwr::poll();     // voltage / modem doze / light sleep

    p12::sinkTick();  // Phase 12: log sink poll + SPIFFS rotation

    static uint32_t lastBlink = 0;
    static bool ledOn = false;
    uint32_t now = millis();
    // Phase 11: fast blink while the pairing window is open.
    uint32_t blinkMs = pair_::open() ? 150 : 1000;
    if (now - lastBlink >= blinkMs) {
        lastBlink = now;
        ledOn = !ledOn;
        digitalWrite(SUPERB_LED, ledOn ? HIGH : LOW);
    }
}
